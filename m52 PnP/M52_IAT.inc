; Generated By Pazi88
;
; BMW M52 Intake Air Temp sensor inc file to be used with Speeduino 202008 FW or newer
;
; File generated for use with stock 2490 ohm resistor
;
; Steinhart-Hart coefficients:  A= 1,310204E-03   B=2,251336E-04   C= 1,728273E-07
;
; Input Data     Temp, degC     Resistance
;		   -22		   53000
;		    21		    6400
;		   100		     374
;

MATFACTOR:
			;    ADC  Temp, degF
	DB	70.00T	;     0    Sensor Failure - use 70 degF as default
	DB	316.21T	;     1    316.21
	DB	262.56T	;     2    262.56
	DB	233.16T	;     3    233.16
	DB	212.84T	;     4    212.84
	DB	197.21T	;     5    197.21
	DB	184.42T	;     6    184.42
	DB	173.51T	;     7    173.51
	DB	163.93T	;     8    163.93
	DB	155.30T	;     9    155.30
	DB	147.41T	;    10    147.41
	DB	140.08T	;    11    140.08
	DB	133.17T	;    12    133.17
	DB	126.60T	;    13    126.60
	DB	120.28T	;    14    120.28
	DB	114.15T	;    15    114.15
	DB	108.15T	;    16    108.15
	DB	102.23T	;    17    102.23
	DB	96.33T	;    18    96.33
	DB	90.40T	;    19    90.40
	DB	84.39T	;    20    84.39
	DB	78.24T	;    21    78.24
	DB	71.88T	;    22    71.88
	DB	65.21T	;    23    65.21
	DB	58.11T	;    24    58.11
	DB	50.43T	;    25    50.43
	DB	41.91T	;    26    41.91
	DB	32.15T	;    27    32.15
	DB	20.43T	;    28    20.43
	DB	5.14T	;    29    5.14
	DB	-18.57T	;    30    -18.57
	DB	-40.00T	;    31    -40.00
