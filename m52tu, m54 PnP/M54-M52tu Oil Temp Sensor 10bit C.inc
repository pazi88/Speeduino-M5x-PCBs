; Generated using EasyTherm4.exe
;
; M54/M52tu Oil Temp Sensor
;
; File generated for use with stock 2490 ohm resistor at R7
;
; Steinhart-Hart coefficients:  A= 1.438153E-03   B=2.475882E-04   C= 3.593371E-08
;
; Input Data     Temp. degC     Resistance
;		   -40		   81236
;		    20		    2691
;		   100		     148
;

THERMFACTOR:
            ;    ADC  Temp. degC
	DB	80.00T	;    0    Sensor Failure - use 80 degC as default
	DB	80.00T	;    1    80.00
	DB	80.00T	;    2    80.00
	DB	80.00T	;    3    80.00
	DB	80.00T	;    4    80.00
	DB	80.00T	;    5    80.00
	DB	80.00T	;    6    80.00
	DB	80.00T	;    7    80.00
	DB	80.00T	;    8    80.00
	DB	80.00T	;    9    80.00
	DB	175.49T	;    10    175.49
	DB	170.71T	;    11    170.71
	DB	166.42T	;    12    166.42
	DB	162.54T	;    13    162.54
	DB	159.01T	;    14    159.01
	DB	155.77T	;    15    155.77
	DB	152.78T	;    16    152.78
	DB	150.01T	;    17    150.01
	DB	147.42T	;    18    147.42
	DB	144.99T	;    19    144.99
	DB	142.72T	;    20    142.72
	DB	140.58T	;    21    140.58
	DB	138.56T	;    22    138.56
	DB	136.64T	;    23    136.64
	DB	134.82T	;    24    134.82
	DB	133.08T	;    25    133.08
	DB	131.43T	;    26    131.43
	DB	129.84T	;    27    129.84
	DB	128.33T	;    28    128.33
	DB	126.88T	;    29    126.88
	DB	125.49T	;    30    125.49
	DB	124.14T	;    31    124.14
	DB	122.86T	;    32    122.86
	DB	121.61T	;    33    121.61
	DB	120.41T	;    34    120.41
	DB	119.25T	;    35    119.25
	DB	118.13T	;    36    118.13
	DB	117.04T	;    37    117.04
	DB	115.99T	;    38    115.99
	DB	114.97T	;    39    114.97
	DB	113.97T	;    40    113.97
	DB	113.01T	;    41    113.01
	DB	112.07T	;    42    112.07
	DB	111.16T	;    43    111.16
	DB	110.27T	;    44    110.27
	DB	109.41T	;    45    109.41
	DB	108.57T	;    46    108.57
	DB	107.74T	;    47    107.74
	DB	106.94T	;    48    106.94
	DB	106.16T	;    49    106.16
	DB	105.40T	;    50    105.40
	DB	104.65T	;    51    104.65
	DB	103.92T	;    52    103.92
	DB	103.21T	;    53    103.21
	DB	102.51T	;    54    102.51
	DB	101.82T	;    55    101.82
	DB	101.15T	;    56    101.15
	DB	100.49T	;    57    100.49
	DB	99.84T	;    58    99.84
	DB	99.22T	;    59    99.22
	DB	98.59T	;    60    98.59
	DB	97.98T	;    61    97.98
	DB	97.39T	;    62    97.39
	DB	96.80T	;    63    96.80
	DB	96.23T	;    64    96.23
	DB	95.66T	;    65    95.66
	DB	95.10T	;    66    95.10
	DB	94.56T	;    67    94.56
	DB	94.02T	;    68    94.02
	DB	93.49T	;    69    93.49
	DB	92.97T	;    70    92.97
	DB	92.46T	;    71    92.46
	DB	91.95T	;    72    91.95
	DB	91.46T	;    73    91.46
	DB	90.97T	;    74    90.97
	DB	90.48T	;    75    90.48
	DB	90.01T	;    76    90.01
	DB	89.54T	;    77    89.54
	DB	89.08T	;    78    89.08
	DB	88.63T	;    79    88.63
	DB	88.18T	;    80    88.18
	DB	87.74T	;    81    87.74
	DB	87.30T	;    82    87.30
	DB	86.87T	;    83    86.87
	DB	86.44T	;    84    86.44
	DB	86.03T	;    85    86.03
	DB	85.61T	;    86    85.61
	DB	85.21T	;    87    85.21
	DB	84.80T	;    88    84.80
	DB	84.41T	;    89    84.41
	DB	84.01T	;    90    84.01
	DB	83.62T	;    91    83.62
	DB	83.24T	;    92    83.24
	DB	82.86T	;    93    82.86
	DB	82.48T	;    94    82.48
	DB	82.11T	;    95    82.11
	DB	81.74T	;    96    81.74
	DB	81.38T	;    97    81.38
	DB	81.03T	;    98    81.03
	DB	80.67T	;    99    80.67
	DB	80.32T	;    100    80.32
	DB	79.98T	;    101    79.98
	DB	79.63T	;    102    79.63
	DB	79.29T	;    103    79.29
	DB	78.96T	;    104    78.96
	DB	78.63T	;    105    78.63
	DB	78.29T	;    106    78.29
	DB	77.97T	;    107    77.97
	DB	77.65T	;    108    77.65
	DB	77.33T	;    109    77.33
	DB	77.01T	;    110    77.01
	DB	76.70T	;    111    76.70
	DB	76.39T	;    112    76.39
	DB	76.08T	;    113    76.08
	DB	75.78T	;    114    75.78
	DB	75.48T	;    115    75.48
	DB	75.18T	;    116    75.18
	DB	74.88T	;    117    74.88
	DB	74.59T	;    118    74.59
	DB	74.30T	;    119    74.30
	DB	74.01T	;    120    74.01
	DB	73.73T	;    121    73.73
	DB	73.44T	;    122    73.44
	DB	73.17T	;    123    73.17
	DB	72.89T	;    124    72.89
	DB	72.61T	;    125    72.61
	DB	72.34T	;    126    72.34
	DB	72.07T	;    127    72.07
	DB	71.80T	;    128    71.80
	DB	71.53T	;    129    71.53
	DB	71.27T	;    130    71.27
	DB	71.01T	;    131    71.01
	DB	70.74T	;    132    70.74
	DB	70.49T	;    133    70.49
	DB	70.23T	;    134    70.23
	DB	69.98T	;    135    69.98
	DB	69.72T	;    136    69.72
	DB	69.47T	;    137    69.47
	DB	69.22T	;    138    69.22
	DB	68.98T	;    139    68.98
	DB	68.73T	;    140    68.73
	DB	68.49T	;    141    68.49
	DB	68.25T	;    142    68.25
	DB	68.01T	;    143    68.01
	DB	67.77T	;    144    67.77
	DB	67.54T	;    145    67.54
	DB	67.30T	;    146    67.30
	DB	67.07T	;    147    67.07
	DB	66.84T	;    148    66.84
	DB	66.61T	;    149    66.61
	DB	66.38T	;    150    66.38
	DB	66.16T	;    151    66.16
	DB	65.93T	;    152    65.93
	DB	65.71T	;    153    65.71
	DB	65.48T	;    154    65.48
	DB	65.27T	;    155    65.27
	DB	65.04T	;    156    65.04
	DB	64.83T	;    157    64.83
	DB	64.61T	;    158    64.61
	DB	64.40T	;    159    64.40
	DB	64.18T	;    160    64.18
	DB	63.97T	;    161    63.97
	DB	63.76T	;    162    63.76
	DB	63.55T	;    163    63.55
	DB	63.34T	;    164    63.34
	DB	63.14T	;    165    63.14
	DB	62.93T	;    166    62.93
	DB	62.73T	;    167    62.73
	DB	62.52T	;    168    62.52
	DB	62.32T	;    169    62.32
	DB	62.12T	;    170    62.12
	DB	61.92T	;    171    61.92
	DB	61.72T	;    172    61.72
	DB	61.53T	;    173    61.53
	DB	61.33T	;    174    61.33
	DB	61.13T	;    175    61.13
	DB	60.94T	;    176    60.94
	DB	60.75T	;    177    60.75
	DB	60.56T	;    178    60.56
	DB	60.37T	;    179    60.37
	DB	60.18T	;    180    60.18
	DB	59.99T	;    181    59.99
	DB	59.80T	;    182    59.80
	DB	59.62T	;    183    59.62
	DB	59.43T	;    184    59.43
	DB	59.24T	;    185    59.24
	DB	59.06T	;    186    59.06
	DB	58.88T	;    187    58.88
	DB	58.69T	;    188    58.69
	DB	58.52T	;    189    58.52
	DB	58.34T	;    190    58.34
	DB	58.16T	;    191    58.16
	DB	57.98T	;    192    57.98
	DB	57.80T	;    193    57.80
	DB	57.63T	;    194    57.63
	DB	57.45T	;    195    57.45
	DB	57.28T	;    196    57.28
	DB	57.10T	;    197    57.10
	DB	56.93T	;    198    56.93
	DB	56.76T	;    199    56.76
	DB	56.59T	;    200    56.59
	DB	56.42T	;    201    56.42
	DB	56.24T	;    202    56.24
	DB	56.08T	;    203    56.08
	DB	55.91T	;    204    55.91
	DB	55.74T	;    205    55.74
	DB	55.58T	;    206    55.58
	DB	55.41T	;    207    55.41
	DB	55.24T	;    208    55.24
	DB	55.08T	;    209    55.08
	DB	54.92T	;    210    54.92
	DB	54.76T	;    211    54.76
	DB	54.59T	;    212    54.59
	DB	54.43T	;    213    54.43
	DB	54.27T	;    214    54.27
	DB	54.11T	;    215    54.11
	DB	53.96T	;    216    53.96
	DB	53.79T	;    217    53.79
	DB	53.64T	;    218    53.64
	DB	53.48T	;    219    53.48
	DB	53.33T	;    220    53.33
	DB	53.17T	;    221    53.17
	DB	53.02T	;    222    53.02
	DB	52.86T	;    223    52.86
	DB	52.71T	;    224    52.71
	DB	52.56T	;    225    52.56
	DB	52.40T	;    226    52.40
	DB	52.25T	;    227    52.25
	DB	52.10T	;    228    52.10
	DB	51.95T	;    229    51.95
	DB	51.80T	;    230    51.80
	DB	51.65T	;    231    51.65
	DB	51.50T	;    232    51.50
	DB	51.35T	;    233    51.35
	DB	51.21T	;    234    51.21
	DB	51.06T	;    235    51.06
	DB	50.91T	;    236    50.91
	DB	50.76T	;    237    50.76
	DB	50.62T	;    238    50.62
	DB	50.47T	;    239    50.47
	DB	50.33T	;    240    50.33
	DB	50.18T	;    241    50.18
	DB	50.04T	;    242    50.04
	DB	49.90T	;    243    49.90
	DB	49.76T	;    244    49.76
	DB	49.62T	;    245    49.62
	DB	49.47T	;    246    49.47
	DB	49.33T	;    247    49.33
	DB	49.19T	;    248    49.19
	DB	49.06T	;    249    49.06
	DB	48.92T	;    250    48.92
	DB	48.78T	;    251    48.78
	DB	48.64T	;    252    48.64
	DB	48.50T	;    253    48.50
	DB	48.36T	;    254    48.36
	DB	48.23T	;    255    48.23
	DB	48.09T	;    256    48.09
	DB	47.96T	;    257    47.96
	DB	47.82T	;    258    47.82
	DB	47.68T	;    259    47.68
	DB	47.55T	;    260    47.55
	DB	47.42T	;    261    47.42
	DB	47.28T	;    262    47.28
	DB	47.15T	;    263    47.15
	DB	47.02T	;    264    47.02
	DB	46.88T	;    265    46.88
	DB	46.76T	;    266    46.76
	DB	46.62T	;    267    46.62
	DB	46.49T	;    268    46.49
	DB	46.36T	;    269    46.36
	DB	46.23T	;    270    46.23
	DB	46.10T	;    271    46.10
	DB	45.97T	;    272    45.97
	DB	45.84T	;    273    45.84
	DB	45.71T	;    274    45.71
	DB	45.58T	;    275    45.58
	DB	45.46T	;    276    45.46
	DB	45.33T	;    277    45.33
	DB	45.21T	;    278    45.21
	DB	45.08T	;    279    45.08
	DB	44.95T	;    280    44.95
	DB	44.83T	;    281    44.83
	DB	44.70T	;    282    44.70
	DB	44.57T	;    283    44.57
	DB	44.45T	;    284    44.45
	DB	44.33T	;    285    44.33
	DB	44.20T	;    286    44.20
	DB	44.08T	;    287    44.08
	DB	43.96T	;    288    43.96
	DB	43.83T	;    289    43.83
	DB	43.71T	;    290    43.71
	DB	43.59T	;    291    43.59
	DB	43.47T	;    292    43.47
	DB	43.34T	;    293    43.34
	DB	43.22T	;    294    43.22
	DB	43.10T	;    295    43.10
	DB	42.98T	;    296    42.98
	DB	42.86T	;    297    42.86
	DB	42.74T	;    298    42.74
	DB	42.62T	;    299    42.62
	DB	42.51T	;    300    42.51
	DB	42.38T	;    301    42.38
	DB	42.27T	;    302    42.27
	DB	42.15T	;    303    42.15
	DB	42.03T	;    304    42.03
	DB	41.91T	;    305    41.91
	DB	41.79T	;    306    41.79
	DB	41.68T	;    307    41.68
	DB	41.56T	;    308    41.56
	DB	41.44T	;    309    41.44
	DB	41.33T	;    310    41.33
	DB	41.21T	;    311    41.21
	DB	41.09T	;    312    41.09
	DB	40.98T	;    313    40.98
	DB	40.87T	;    314    40.87
	DB	40.75T	;    315    40.75
	DB	40.64T	;    316    40.64
	DB	40.52T	;    317    40.52
	DB	40.41T	;    318    40.41
	DB	40.29T	;    319    40.29
	DB	40.18T	;    320    40.18
	DB	40.07T	;    321    40.07
	DB	39.96T	;    322    39.96
	DB	39.84T	;    323    39.84
	DB	39.73T	;    324    39.73
	DB	39.62T	;    325    39.62
	DB	39.51T	;    326    39.51
	DB	39.40T	;    327    39.40
	DB	39.29T	;    328    39.29
	DB	39.18T	;    329    39.18
	DB	39.07T	;    330    39.07
	DB	38.96T	;    331    38.96
	DB	38.84T	;    332    38.84
	DB	38.73T	;    333    38.73
	DB	38.62T	;    334    38.62
	DB	38.52T	;    335    38.52
	DB	38.41T	;    336    38.41
	DB	38.30T	;    337    38.30
	DB	38.19T	;    338    38.19
	DB	38.08T	;    339    38.08
	DB	37.97T	;    340    37.97
	DB	37.87T	;    341    37.87
	DB	37.76T	;    342    37.76
	DB	37.65T	;    343    37.65
	DB	37.54T	;    344    37.54
	DB	37.43T	;    345    37.43
	DB	37.33T	;    346    37.33
	DB	37.22T	;    347    37.22
	DB	37.12T	;    348    37.12
	DB	37.01T	;    349    37.01
	DB	36.90T	;    350    36.90
	DB	36.79T	;    351    36.79
	DB	36.69T	;    352    36.69
	DB	36.58T	;    353    36.58
	DB	36.48T	;    354    36.48
	DB	36.38T	;    355    36.38
	DB	36.27T	;    356    36.27
	DB	36.17T	;    357    36.17
	DB	36.06T	;    358    36.06
	DB	35.96T	;    359    35.96
	DB	35.86T	;    360    35.86
	DB	35.75T	;    361    35.75
	DB	35.64T	;    362    35.64
	DB	35.54T	;    363    35.54
	DB	35.44T	;    364    35.44
	DB	35.34T	;    365    35.34
	DB	35.23T	;    366    35.23
	DB	35.13T	;    367    35.13
	DB	35.03T	;    368    35.03
	DB	34.93T	;    369    34.93
	DB	34.83T	;    370    34.83
	DB	34.72T	;    371    34.72
	DB	34.62T	;    372    34.62
	DB	34.52T	;    373    34.52
	DB	34.42T	;    374    34.42
	DB	34.32T	;    375    34.32
	DB	34.22T	;    376    34.22
	DB	34.12T	;    377    34.12
	DB	34.02T	;    378    34.02
	DB	33.92T	;    379    33.92
	DB	33.82T	;    380    33.82
	DB	33.72T	;    381    33.72
	DB	33.62T	;    382    33.62
	DB	33.52T	;    383    33.52
	DB	33.42T	;    384    33.42
	DB	33.32T	;    385    33.32
	DB	33.22T	;    386    33.22
	DB	33.12T	;    387    33.12
	DB	33.02T	;    388    33.02
	DB	32.92T	;    389    32.92
	DB	32.82T	;    390    32.82
	DB	32.72T	;    391    32.72
	DB	32.63T	;    392    32.63
	DB	32.53T	;    393    32.53
	DB	32.43T	;    394    32.43
	DB	32.33T	;    395    32.33
	DB	32.23T	;    396    32.23
	DB	32.14T	;    397    32.14
	DB	32.04T	;    398    32.04
	DB	31.94T	;    399    31.94
	DB	31.84T	;    400    31.84
	DB	31.75T	;    401    31.75
	DB	31.65T	;    402    31.65
	DB	31.56T	;    403    31.56
	DB	31.46T	;    404    31.46
	DB	31.36T	;    405    31.36
	DB	31.27T	;    406    31.27
	DB	31.17T	;    407    31.17
	DB	31.08T	;    408    31.08
	DB	30.98T	;    409    30.98
	DB	30.88T	;    410    30.88
	DB	30.79T	;    411    30.79
	DB	30.69T	;    412    30.69
	DB	30.60T	;    413    30.60
	DB	30.50T	;    414    30.50
	DB	30.41T	;    415    30.41
	DB	30.31T	;    416    30.31
	DB	30.22T	;    417    30.22
	DB	30.12T	;    418    30.12
	DB	30.03T	;    419    30.03
	DB	29.93T	;    420    29.93
	DB	29.84T	;    421    29.84
	DB	29.74T	;    422    29.74
	DB	29.65T	;    423    29.65
	DB	29.56T	;    424    29.56
	DB	29.47T	;    425    29.47
	DB	29.37T	;    426    29.37
	DB	29.28T	;    427    29.28
	DB	29.18T	;    428    29.18
	DB	29.09T	;    429    29.09
	DB	29.00T	;    430    29.00
	DB	28.91T	;    431    28.91
	DB	28.81T	;    432    28.81
	DB	28.72T	;    433    28.72
	DB	28.63T	;    434    28.63
	DB	28.53T	;    435    28.53
	DB	28.44T	;    436    28.44
	DB	28.35T	;    437    28.35
	DB	28.26T	;    438    28.26
	DB	28.17T	;    439    28.17
	DB	28.07T	;    440    28.07
	DB	27.98T	;    441    27.98
	DB	27.89T	;    442    27.89
	DB	27.80T	;    443    27.80
	DB	27.71T	;    444    27.71
	DB	27.62T	;    445    27.62
	DB	27.52T	;    446    27.52
	DB	27.43T	;    447    27.43
	DB	27.34T	;    448    27.34
	DB	27.25T	;    449    27.25
	DB	27.16T	;    450    27.16
	DB	27.07T	;    451    27.07
	DB	26.98T	;    452    26.98
	DB	26.89T	;    453    26.89
	DB	26.79T	;    454    26.79
	DB	26.71T	;    455    26.71
	DB	26.62T	;    456    26.62
	DB	26.52T	;    457    26.52
	DB	26.43T	;    458    26.43
	DB	26.34T	;    459    26.34
	DB	26.26T	;    460    26.26
	DB	26.17T	;    461    26.17
	DB	26.07T	;    462    26.07
	DB	25.98T	;    463    25.98
	DB	25.89T	;    464    25.89
	DB	25.81T	;    465    25.81
	DB	25.72T	;    466    25.72
	DB	25.63T	;    467    25.63
	DB	25.54T	;    468    25.54
	DB	25.45T	;    469    25.45
	DB	25.36T	;    470    25.36
	DB	25.27T	;    471    25.27
	DB	25.18T	;    472    25.18
	DB	25.09T	;    473    25.09
	DB	25.00T	;    474    25.00
	DB	24.91T	;    475    24.91
	DB	24.82T	;    476    24.82
	DB	24.73T	;    477    24.73
	DB	24.65T	;    478    24.65
	DB	24.56T	;    479    24.56
	DB	24.47T	;    480    24.47
	DB	24.38T	;    481    24.38
	DB	24.29T	;    482    24.29
	DB	24.21T	;    483    24.21
	DB	24.12T	;    484    24.12
	DB	24.03T	;    485    24.03
	DB	23.94T	;    486    23.94
	DB	23.86T	;    487    23.86
	DB	23.77T	;    488    23.77
	DB	23.68T	;    489    23.68
	DB	23.59T	;    490    23.59
	DB	23.50T	;    491    23.50
	DB	23.42T	;    492    23.42
	DB	23.33T	;    493    23.33
	DB	23.24T	;    494    23.24
	DB	23.15T	;    495    23.15
	DB	23.07T	;    496    23.07
	DB	22.98T	;    497    22.98
	DB	22.89T	;    498    22.89
	DB	22.80T	;    499    22.80
	DB	22.72T	;    500    22.72
	DB	22.63T	;    501    22.63
	DB	22.54T	;    502    22.54
	DB	22.46T	;    503    22.46
	DB	22.37T	;    504    22.37
	DB	22.28T	;    505    22.28
	DB	22.19T	;    506    22.19
	DB	22.11T	;    507    22.11
	DB	22.02T	;    508    22.02
	DB	21.93T	;    509    21.93
	DB	21.84T	;    510    21.84
	DB	21.76T	;    511    21.76
	DB	21.67T	;    512    21.67
	DB	21.59T	;    513    21.59
	DB	21.50T	;    514    21.50
	DB	21.42T	;    515    21.42
	DB	21.33T	;    516    21.33
	DB	21.24T	;    517    21.24
	DB	21.16T	;    518    21.16
	DB	21.07T	;    519    21.07
	DB	20.98T	;    520    20.98
	DB	20.89T	;    521    20.89
	DB	20.81T	;    522    20.81
	DB	20.72T	;    523    20.72
	DB	20.64T	;    524    20.64
	DB	20.55T	;    525    20.55
	DB	20.47T	;    526    20.47
	DB	20.38T	;    527    20.38
	DB	20.29T	;    528    20.29
	DB	20.21T	;    529    20.21
	DB	20.12T	;    530    20.12
	DB	20.04T	;    531    20.04
	DB	19.95T	;    532    19.95
	DB	19.87T	;    533    19.87
	DB	19.78T	;    534    19.78
	DB	19.69T	;    535    19.69
	DB	19.61T	;    536    19.61
	DB	19.52T	;    537    19.52
	DB	19.44T	;    538    19.44
	DB	19.36T	;    539    19.36
	DB	19.27T	;    540    19.27
	DB	19.18T	;    541    19.18
	DB	19.09T	;    542    19.09
	DB	19.01T	;    543    19.01
	DB	18.93T	;    544    18.93
	DB	18.84T	;    545    18.84
	DB	18.76T	;    546    18.76
	DB	18.67T	;    547    18.67
	DB	18.58T	;    548    18.58
	DB	18.50T	;    549    18.50
	DB	18.42T	;    550    18.42
	DB	18.33T	;    551    18.33
	DB	18.24T	;    552    18.24
	DB	18.16T	;    553    18.16
	DB	18.07T	;    554    18.07
	DB	17.99T	;    555    17.99
	DB	17.91T	;    556    17.91
	DB	17.82T	;    557    17.82
	DB	17.73T	;    558    17.73
	DB	17.65T	;    559    17.65
	DB	17.57T	;    560    17.57
	DB	17.48T	;    561    17.48
	DB	17.39T	;    562    17.39
	DB	17.31T	;    563    17.31
	DB	17.22T	;    564    17.22
	DB	17.14T	;    565    17.14
	DB	17.06T	;    566    17.06
	DB	16.97T	;    567    16.97
	DB	16.88T	;    568    16.88
	DB	16.80T	;    569    16.80
	DB	16.72T	;    570    16.72
	DB	16.63T	;    571    16.63
	DB	16.54T	;    572    16.54
	DB	16.46T	;    573    16.46
	DB	16.38T	;    574    16.38
	DB	16.29T	;    575    16.29
	DB	16.21T	;    576    16.21
	DB	16.12T	;    577    16.12
	DB	16.04T	;    578    16.04
	DB	15.95T	;    579    15.95
	DB	15.87T	;    580    15.87
	DB	15.78T	;    581    15.78
	DB	15.69T	;    582    15.69
	DB	15.61T	;    583    15.61
	DB	15.53T	;    584    15.53
	DB	15.44T	;    585    15.44
	DB	15.36T	;    586    15.36
	DB	15.27T	;    587    15.27
	DB	15.19T	;    588    15.19
	DB	15.11T	;    589    15.11
	DB	15.02T	;    590    15.02
	DB	14.93T	;    591    14.93
	DB	14.85T	;    592    14.85
	DB	14.77T	;    593    14.77
	DB	14.68T	;    594    14.68
	DB	14.59T	;    595    14.59
	DB	14.51T	;    596    14.51
	DB	14.43T	;    597    14.43
	DB	14.34T	;    598    14.34
	DB	14.26T	;    599    14.26
	DB	14.17T	;    600    14.17
	DB	14.08T	;    601    14.08
	DB	14.00T	;    602    14.00
	DB	13.92T	;    603    13.92
	DB	13.83T	;    604    13.83
	DB	13.74T	;    605    13.74
	DB	13.66T	;    606    13.66
	DB	13.58T	;    607    13.58
	DB	13.49T	;    608    13.49
	DB	13.41T	;    609    13.41
	DB	13.32T	;    610    13.32
	DB	13.23T	;    611    13.23
	DB	13.15T	;    612    13.15
	DB	13.07T	;    613    13.07
	DB	12.98T	;    614    12.98
	DB	12.89T	;    615    12.89
	DB	12.81T	;    616    12.81
	DB	12.73T	;    617    12.73
	DB	12.64T	;    618    12.64
	DB	12.56T	;    619    12.56
	DB	12.47T	;    620    12.47
	DB	12.38T	;    621    12.38
	DB	12.30T	;    622    12.30
	DB	12.22T	;    623    12.22
	DB	12.13T	;    624    12.13
	DB	12.04T	;    625    12.04
	DB	11.96T	;    626    11.96
	DB	11.87T	;    627    11.87
	DB	11.79T	;    628    11.79
	DB	11.70T	;    629    11.70
	DB	11.62T	;    630    11.62
	DB	11.53T	;    631    11.53
	DB	11.44T	;    632    11.44
	DB	11.36T	;    633    11.36
	DB	11.27T	;    634    11.27
	DB	11.19T	;    635    11.19
	DB	11.10T	;    636    11.10
	DB	11.02T	;    637    11.02
	DB	10.93T	;    638    10.93
	DB	10.84T	;    639    10.84
	DB	10.76T	;    640    10.76
	DB	10.67T	;    641    10.67
	DB	10.59T	;    642    10.59
	DB	10.50T	;    643    10.50
	DB	10.42T	;    644    10.42
	DB	10.33T	;    645    10.33
	DB	10.24T	;    646    10.24
	DB	10.16T	;    647    10.16
	DB	10.07T	;    648    10.07
	DB	9.98T	;    649    9.98
	DB	9.90T	;    650    9.90
	DB	9.81T	;    651    9.81
	DB	9.72T	;    652    9.72
	DB	9.64T	;    653    9.64
	DB	9.55T	;    654    9.55
	DB	9.47T	;    655    9.47
	DB	9.38T	;    656    9.38
	DB	9.29T	;    657    9.29
	DB	9.21T	;    658    9.21
	DB	9.12T	;    659    9.12
	DB	9.03T	;    660    9.03
	DB	8.94T	;    661    8.94
	DB	8.86T	;    662    8.86
	DB	8.77T	;    663    8.77
	DB	8.68T	;    664    8.68
	DB	8.59T	;    665    8.59
	DB	8.51T	;    666    8.51
	DB	8.42T	;    667    8.42
	DB	8.33T	;    668    8.33
	DB	8.25T	;    669    8.25
	DB	8.16T	;    670    8.16
	DB	8.07T	;    671    8.07
	DB	7.98T	;    672    7.98
	DB	7.90T	;    673    7.90
	DB	7.81T	;    674    7.81
	DB	7.72T	;    675    7.72
	DB	7.63T	;    676    7.63
	DB	7.54T	;    677    7.54
	DB	7.46T	;    678    7.46
	DB	7.37T	;    679    7.37
	DB	7.28T	;    680    7.28
	DB	7.19T	;    681    7.19
	DB	7.11T	;    682    7.11
	DB	7.02T	;    683    7.02
	DB	6.93T	;    684    6.93
	DB	6.84T	;    685    6.84
	DB	6.75T	;    686    6.75
	DB	6.66T	;    687    6.66
	DB	6.57T	;    688    6.57
	DB	6.48T	;    689    6.48
	DB	6.39T	;    690    6.39
	DB	6.31T	;    691    6.31
	DB	6.22T	;    692    6.22
	DB	6.13T	;    693    6.13
	DB	6.04T	;    694    6.04
	DB	5.95T	;    695    5.95
	DB	5.86T	;    696    5.86
	DB	5.77T	;    697    5.77
	DB	5.68T	;    698    5.68
	DB	5.59T	;    699    5.59
	DB	5.50T	;    700    5.50
	DB	5.41T	;    701    5.41
	DB	5.32T	;    702    5.32
	DB	5.23T	;    703    5.23
	DB	5.14T	;    704    5.14
	DB	5.05T	;    705    5.05
	DB	4.96T	;    706    4.96
	DB	4.87T	;    707    4.87
	DB	4.78T	;    708    4.78
	DB	4.69T	;    709    4.69
	DB	4.60T	;    710    4.60
	DB	4.51T	;    711    4.51
	DB	4.42T	;    712    4.42
	DB	4.33T	;    713    4.33
	DB	4.23T	;    714    4.23
	DB	4.14T	;    715    4.14
	DB	4.05T	;    716    4.05
	DB	3.96T	;    717    3.96
	DB	3.87T	;    718    3.87
	DB	3.78T	;    719    3.78
	DB	3.68T	;    720    3.68
	DB	3.59T	;    721    3.59
	DB	3.50T	;    722    3.50
	DB	3.41T	;    723    3.41
	DB	3.32T	;    724    3.32
	DB	3.22T	;    725    3.22
	DB	3.13T	;    726    3.13
	DB	3.04T	;    727    3.04
	DB	2.94T	;    728    2.94
	DB	2.85T	;    729    2.85
	DB	2.76T	;    730    2.76
	DB	2.67T	;    731    2.67
	DB	2.57T	;    732    2.57
	DB	2.48T	;    733    2.48
	DB	2.38T	;    734    2.38
	DB	2.29T	;    735    2.29
	DB	2.20T	;    736    2.20
	DB	2.11T	;    737    2.11
	DB	2.01T	;    738    2.01
	DB	1.92T	;    739    1.92
	DB	1.82T	;    740    1.82
	DB	1.73T	;    741    1.73
	DB	1.63T	;    742    1.63
	DB	1.53T	;    743    1.53
	DB	1.44T	;    744    1.44
	DB	1.34T	;    745    1.34
	DB	1.25T	;    746    1.25
	DB	1.16T	;    747    1.16
	DB	1.06T	;    748    1.06
	DB	0.96T	;    749    0.96
	DB	0.87T	;    750    0.87
	DB	0.77T	;    751    0.77
	DB	0.67T	;    752    0.67
	DB	0.58T	;    753    0.58
	DB	0.48T	;    754    0.48
	DB	0.38T	;    755    0.38
	DB	0.29T	;    756    0.29
	DB	0.19T	;    757    0.19
	DB	0.09T	;    758    0.09
	DB	-0.01T	;    759    -0.01
	DB	-0.10T	;    760    -0.10
	DB	-0.20T	;    761    -0.20
	DB	-0.30T	;    762    -0.30
	DB	-0.39T	;    763    -0.39
	DB	-0.49T	;    764    -0.49
	DB	-0.59T	;    765    -0.59
	DB	-0.69T	;    766    -0.69
	DB	-0.79T	;    767    -0.79
	DB	-0.89T	;    768    -0.89
	DB	-0.99T	;    769    -0.99
	DB	-1.09T	;    770    -1.09
	DB	-1.19T	;    771    -1.19
	DB	-1.29T	;    772    -1.29
	DB	-1.39T	;    773    -1.39
	DB	-1.49T	;    774    -1.49
	DB	-1.59T	;    775    -1.59
	DB	-1.69T	;    776    -1.69
	DB	-1.79T	;    777    -1.79
	DB	-1.89T	;    778    -1.89
	DB	-1.99T	;    779    -1.99
	DB	-2.09T	;    780    -2.09
	DB	-2.20T	;    781    -2.20
	DB	-2.30T	;    782    -2.30
	DB	-2.40T	;    783    -2.40
	DB	-2.51T	;    784    -2.51
	DB	-2.61T	;    785    -2.61
	DB	-2.71T	;    786    -2.71
	DB	-2.81T	;    787    -2.81
	DB	-2.92T	;    788    -2.92
	DB	-3.02T	;    789    -3.02
	DB	-3.12T	;    790    -3.12
	DB	-3.23T	;    791    -3.23
	DB	-3.33T	;    792    -3.33
	DB	-3.44T	;    793    -3.44
	DB	-3.54T	;    794    -3.54
	DB	-3.64T	;    795    -3.64
	DB	-3.75T	;    796    -3.75
	DB	-3.86T	;    797    -3.86
	DB	-3.96T	;    798    -3.96
	DB	-4.07T	;    799    -4.07
	DB	-4.18T	;    800    -4.18
	DB	-4.28T	;    801    -4.28
	DB	-4.39T	;    802    -4.39
	DB	-4.49T	;    803    -4.49
	DB	-4.61T	;    804    -4.61
	DB	-4.71T	;    805    -4.71
	DB	-4.82T	;    806    -4.82
	DB	-4.93T	;    807    -4.93
	DB	-5.04T	;    808    -5.04
	DB	-5.14T	;    809    -5.14
	DB	-5.26T	;    810    -5.26
	DB	-5.36T	;    811    -5.36
	DB	-5.47T	;    812    -5.47
	DB	-5.58T	;    813    -5.58
	DB	-5.69T	;    814    -5.69
	DB	-5.81T	;    815    -5.81
	DB	-5.92T	;    816    -5.92
	DB	-6.03T	;    817    -6.03
	DB	-6.14T	;    818    -6.14
	DB	-6.25T	;    819    -6.25
	DB	-6.36T	;    820    -6.36
	DB	-6.47T	;    821    -6.47
	DB	-6.59T	;    822    -6.59
	DB	-6.70T	;    823    -6.70
	DB	-6.82T	;    824    -6.82
	DB	-6.93T	;    825    -6.93
	DB	-7.04T	;    826    -7.04
	DB	-7.16T	;    827    -7.16
	DB	-7.27T	;    828    -7.27
	DB	-7.39T	;    829    -7.39
	DB	-7.50T	;    830    -7.50
	DB	-7.62T	;    831    -7.62
	DB	-7.73T	;    832    -7.73
	DB	-7.85T	;    833    -7.85
	DB	-7.97T	;    834    -7.97
	DB	-8.09T	;    835    -8.09
	DB	-8.21T	;    836    -8.21
	DB	-8.32T	;    837    -8.32
	DB	-8.44T	;    838    -8.44
	DB	-8.56T	;    839    -8.56
	DB	-8.68T	;    840    -8.68
	DB	-8.80T	;    841    -8.80
	DB	-8.92T	;    842    -8.92
	DB	-9.04T	;    843    -9.04
	DB	-9.16T	;    844    -9.16
	DB	-9.28T	;    845    -9.28
	DB	-9.41T	;    846    -9.41
	DB	-9.53T	;    847    -9.53
	DB	-9.65T	;    848    -9.65
	DB	-9.77T	;    849    -9.77
	DB	-9.90T	;    850    -9.90
	DB	-10.02T	;    851    -10.02
	DB	-10.14T	;    852    -10.14
	DB	-10.27T	;    853    -10.27
	DB	-10.40T	;    854    -10.40
	DB	-10.52T	;    855    -10.52
	DB	-10.65T	;    856    -10.65
	DB	-10.78T	;    857    -10.78
	DB	-10.91T	;    858    -10.91
	DB	-11.03T	;    859    -11.03
	DB	-11.16T	;    860    -11.16
	DB	-11.29T	;    861    -11.29
	DB	-11.42T	;    862    -11.42
	DB	-11.55T	;    863    -11.55
	DB	-11.68T	;    864    -11.68
	DB	-11.81T	;    865    -11.81
	DB	-11.94T	;    866    -11.94
	DB	-12.08T	;    867    -12.08
	DB	-12.21T	;    868    -12.21
	DB	-12.34T	;    869    -12.34
	DB	-12.48T	;    870    -12.48
	DB	-12.61T	;    871    -12.61
	DB	-12.75T	;    872    -12.75
	DB	-12.88T	;    873    -12.88
	DB	-13.02T	;    874    -13.02
	DB	-13.16T	;    875    -13.16
	DB	-13.29T	;    876    -13.29
	DB	-13.43T	;    877    -13.43
	DB	-13.57T	;    878    -13.57
	DB	-13.71T	;    879    -13.71
	DB	-13.86T	;    880    -13.86
	DB	-13.99T	;    881    -13.99
	DB	-14.14T	;    882    -14.14
	DB	-14.28T	;    883    -14.28
	DB	-14.42T	;    884    -14.42
	DB	-14.57T	;    885    -14.57
	DB	-14.71T	;    886    -14.71
	DB	-14.86T	;    887    -14.86
	DB	-15.00T	;    888    -15.00
	DB	-15.15T	;    889    -15.15
	DB	-15.30T	;    890    -15.30
	DB	-15.44T	;    891    -15.44
	DB	-15.59T	;    892    -15.59
	DB	-15.74T	;    893    -15.74
	DB	-15.89T	;    894    -15.89
	DB	-16.05T	;    895    -16.05
	DB	-16.20T	;    896    -16.20
	DB	-16.36T	;    897    -16.36
	DB	-16.51T	;    898    -16.51
	DB	-16.66T	;    899    -16.66
	DB	-16.82T	;    900    -16.82
	DB	-16.98T	;    901    -16.98
	DB	-17.13T	;    902    -17.13
	DB	-17.29T	;    903    -17.29
	DB	-17.46T	;    904    -17.46
	DB	-17.62T	;    905    -17.62
	DB	-17.78T	;    906    -17.78
	DB	-17.94T	;    907    -17.94
	DB	-18.11T	;    908    -18.11
	DB	-18.27T	;    909    -18.27
	DB	-18.43T	;    910    -18.43
	DB	-18.60T	;    911    -18.60
	DB	-18.77T	;    912    -18.77
	DB	-18.94T	;    913    -18.94
	DB	-19.11T	;    914    -19.11
	DB	-19.28T	;    915    -19.28
	DB	-19.46T	;    916    -19.46
	DB	-19.63T	;    917    -19.63
	DB	-19.81T	;    918    -19.81
	DB	-19.98T	;    919    -19.98
	DB	-20.16T	;    920    -20.16
	DB	-20.34T	;    921    -20.34
	DB	-20.52T	;    922    -20.52
	DB	-20.70T	;    923    -20.70
	DB	-20.88T	;    924    -20.88
	DB	-21.07T	;    925    -21.07
	DB	-21.26T	;    926    -21.26
	DB	-21.44T	;    927    -21.44
	DB	-21.63T	;    928    -21.63
	DB	-21.82T	;    929    -21.82
	DB	-22.01T	;    930    -22.01
	DB	-22.21T	;    931    -22.21
	DB	-22.40T	;    932    -22.40
	DB	-22.60T	;    933    -22.60
	DB	-22.80T	;    934    -22.80
	DB	-23.00T	;    935    -23.00
	DB	-23.20T	;    936    -23.20
	DB	-23.41T	;    937    -23.41
	DB	-23.61T	;    938    -23.61
	DB	-23.82T	;    939    -23.82
	DB	-24.03T	;    940    -24.03
	DB	-24.24T	;    941    -24.24
	DB	-24.46T	;    942    -24.46
	DB	-24.67T	;    943    -24.67
	DB	-24.89T	;    944    -24.89
	DB	-25.11T	;    945    -25.11
	DB	-25.33T	;    946    -25.33
	DB	-25.56T	;    947    -25.56
	DB	-25.78T	;    948    -25.78
	DB	-26.01T	;    949    -26.01
	DB	-26.24T	;    950    -26.24
	DB	-26.48T	;    951    -26.48
	DB	-26.71T	;    952    -26.71
	DB	-26.95T	;    953    -26.95
	DB	-27.19T	;    954    -27.19
	DB	-27.44T	;    955    -27.44
	DB	-27.69T	;    956    -27.69
	DB	-27.94T	;    957    -27.94
	DB	-28.19T	;    958    -28.19
	DB	-28.45T	;    959    -28.45
	DB	-28.71T	;    960    -28.71
	DB	-28.97T	;    961    -28.97
	DB	-29.24T	;    962    -29.24
	DB	-29.51T	;    963    -29.51
	DB	-29.79T	;    964    -29.79
	DB	-30.07T	;    965    -30.07
	DB	-30.35T	;    966    -30.35
	DB	-30.63T	;    967    -30.63
	DB	-30.92T	;    968    -30.92
	DB	-31.22T	;    969    -31.22
	DB	-31.52T	;    970    -31.52
	DB	-31.82T	;    971    -31.82
	DB	-32.13T	;    972    -32.13
	DB	-32.44T	;    973    -32.44
	DB	-32.77T	;    974    -32.77
	DB	-33.09T	;    975    -33.09
	DB	-33.42T	;    976    -33.42
	DB	-33.76T	;    977    -33.76
	DB	-34.10T	;    978    -34.10
	DB	-34.45T	;    979    -34.45
	DB	-34.81T	;    980    -34.81
	DB	-35.17T	;    981    -35.17
	DB	-35.54T	;    982    -35.54
	DB	-35.91T	;    983    -35.91
	DB	-36.30T	;    984    -36.30
	DB	-36.69T	;    985    -36.69
	DB	-37.09T	;    986    -37.09
	DB	-37.51T	;    987    -37.51
	DB	-37.93T	;    988    -37.93
	DB	-38.36T	;    989    -38.36
	DB	-38.81T	;    990    -38.81
	DB	-39.26T	;    991    -39.26
	DB	-39.73T	;    992    -39.73
	DB	80.00T	;    993    80.00
	DB	80.00T	;    994    80.00
	DB	80.00T	;    995    80.00
	DB	80.00T	;    996    80.00
	DB	80.00T	;    997    80.00
	DB	80.00T	;    998    80.00
	DB	80.00T	;    999    80.00
	DB	80.00T	;    1000    80.00
	DB	80.00T	;    1001    80.00
	DB	80.00T	;    1002    80.00
	DB	80.00T	;    1003    80.00
	DB	80.00T	;    1004    80.00
	DB	80.00T	;    1005    80.00
	DB	80.00T	;    1006    80.00
	DB	80.00T	;    1007    80.00
	DB	80.00T	;    1008    80.00
	DB	80.00T	;    1009    80.00
	DB	80.00T	;    1010    80.00
	DB	80.00T	;    1011    80.00
	DB	80.00T	;    1012    80.00
	DB	80.00T	;    1013    80.00
	DB	80.00T	;    1014    80.00
	DB	80.00T	;    1015    80.00
	DB	80.00T	;    1016    80.00
	DB	80.00T	;    1017    80.00
	DB	80.00T	;    1018    80.00
	DB	80.00T	;    1019    80.00
	DB	80.00T	;    1020    80.00
	DB	80.00T	;    1021    80.00
	DB	80.00T	;    1022    80.00
	DB	80.00T	;    1023    Sensor Failure - use 80 degC as default

