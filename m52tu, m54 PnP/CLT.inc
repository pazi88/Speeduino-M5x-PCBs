; Generated By Pazi88
;
; BMW M52 Coolant Temp sensor inc file to be used with Speeduino 202008 FW or newer
;
; File generated for use with stock 2490 ohm resistor
;
;
; Input Data     Temp, degC     Resistance
;		   -48		   141931
;		  20.3		    2826
;		 110.3		     115
;

MATFACTOR:
			;    ADC  Temp, degF
	DB	180.00T	;     0    Sensor Failure - use 180 degF as default
	DB	252.35T	;     1    252.35
	DB	205.41T	;     2    205.41
	DB	179.72T	;     3    179.72
	DB	161.98T	;     4    161.98
	DB	148.36T	;     5    148.36
	DB	137.22T	;     6    137.22
	DB	127.72T	;     7    127.72
	DB	119.38T	;     8    119.38
	DB	111.89T	;     9    111.89
	DB	105.03	;    10    105.03
	DB	98.66T	;    11    98.66
	DB	92.68T	;    12    92.68
	DB	86.98T	;    13    86.98
	DB	81.51T	;    14    81.51
	DB	76.20T	;    15    76.20
	DB	71.00T	;    16    71.00
	DB	65.88T	;    17    65.88
	DB	60.78T	;    18    60.78
	DB	55.66T	;    19    55.66
	DB	50.47T	;    20    50.47
	DB	45.17T	;    21    45.17
	DB	39.68T	;    22    39.68
	DB	33.94T	;    23    33.94
	DB	27.83T	;    24    27.83
	DB	21.23T	;    25    21.23
	DB	13.91T	;    26    13.91
	DB	5.54T	;    27    5.54
	DB	-4.51T	;    28    -4.51
	DB	-17.59T	;    29    -17.59
	DB	-37.81T	;    30    -37.81
	DB	180.00T	;     0    Sensor Failure - use 180 degF as default
