; Generated using EasyTherm4.exe
;
; M54/M52tu Oil Temp Sensor
;
; File generated for use with stock 2490 ohm resistor
;
;
; Input Data     Temp. degC     Resistance
;		   -48		   102672
;		    20		    2804
;		   140		     51
;

THERMFACTOR;
            ;    ADC  Temp. degC
	DB	80.00T	;    0    Sensor Failure - use 80 degC as default
	DB	80.00T	;    1    80.00
	DB	80.00T	;    2    80.00
	DB	80.00T	;    3    80.00
	DB	80.00T	;    4    80.00
	DB	80.00T	;    5    80.00
	DB	80.00T	;    6    80.00
	DB	80.00T	;    7    80.00
	DB	80.00T	;    8    80.00
	DB	175.91T	;    9    175.91
	DB	171.03T	;    10    171.03
	DB	166.70T	;    11    166.70
	DB	162.81T	;    12    162.81
	DB	159.28T	;    13    159.28
	DB	156.06T	;    14    156.06
	DB	153.09T	;    15    153.09
	DB	150.34T	;    16    150.34
	DB	147.79T	;    17    147.79
	DB	145.41T	;    18    145.41
	DB	143.17T	;    19    143.17
	DB	141.07T	;    20    141.07
	DB	139.08T	;    21    139.08
	DB	137.21T	;    22    137.21
	DB	135.42T	;    23    135.42
	DB	133.73T	;    24    133.73
	DB	132.11T	;    25    132.11
	DB	130.57T	;    26    130.57
	DB	129.09T	;    27    129.09
	DB	127.67T	;    28    127.67
	DB	126.32T	;    29    126.32
	DB	125.01T	;    30    125.01
	DB	123.75T	;    31    123.75
	DB	122.54T	;    32    122.54
	DB	121.37T	;    33    121.37
	DB	120.23T	;    34    120.23
	DB	119.14T	;    35    119.14
	DB	118.08T	;    36    118.08
	DB	117.06T	;    37    117.06
	DB	116.06T	;    38    116.06
	DB	115.09T	;    39    115.09
	DB	114.15T	;    40    114.15
	DB	113.24T	;    41    113.24
	DB	112.35T	;    42    112.35
	DB	111.48T	;    43    111.48
	DB	110.64T	;    44    110.64
	DB	109.82T	;    45    109.82
	DB	109.02T	;    46    109.02
	DB	108.23T	;    47    108.23
	DB	107.47T	;    48    107.47
	DB	106.73T	;    49    106.73
	DB	105.99T	;    50    105.99
	DB	105.28T	;    51    105.28
	DB	104.58T	;    52    104.58
	DB	103.90T	;    53    103.90
	DB	103.23T	;    54    103.23
	DB	102.57T	;    55    102.57
	DB	101.93T	;    56    101.93
	DB	101.30T	;    57    101.30
	DB	100.68T	;    58    100.68
	DB	100.08T	;    59    100.08
	DB	99.48T	;    60    99.48
	DB	98.89T	;    61    98.89
	DB	98.32T	;    62    98.32
	DB	97.76T	;    63    97.76
	DB	97.21T	;    64    97.21
	DB	96.66T	;    65    96.66
	DB	96.12T	;    66    96.12
	DB	95.59T	;    67    95.59
	DB	95.08T	;    68    95.08
	DB	94.57T	;    69    94.57
	DB	94.06T	;    70    94.06
	DB	93.57T	;    71    93.57
	DB	93.08T	;    72    93.08
	DB	92.60T	;    73    92.60
	DB	92.13T	;    74    92.13
	DB	91.66T	;    75    91.66
	DB	91.21T	;    76    91.21
	DB	90.75T	;    77    90.75
	DB	90.31T	;    78    90.31
	DB	89.86T	;    79    89.86
	DB	89.43T	;    80    89.43
	DB	89.00T	;    81    89.00
	DB	88.58T	;    82    88.58
	DB	88.16T	;    83    88.16
	DB	87.75T	;    84    87.75
	DB	87.34T	;    85    87.34
	DB	86.94T	;    86    86.94
	DB	86.54T	;    87    86.54
	DB	86.15T	;    88    86.15
	DB	85.76T	;    89    85.76
	DB	85.38T	;    90    85.38
	DB	85.00T	;    91    85.00
	DB	84.63T	;    92    84.63
	DB	84.26T	;    93    84.26
	DB	83.89T	;    94    83.89
	DB	83.53T	;    95    83.53
	DB	83.17T	;    96    83.17
	DB	82.82T	;    97    82.82
	DB	82.47T	;    98    82.47
	DB	82.12T	;    99    82.12
	DB	81.78T	;    100    81.78
	DB	81.44T	;    101    81.44
	DB	81.11T	;    102    81.11
	DB	80.78T	;    103    80.78
	DB	80.45T	;    104    80.45
	DB	80.12T	;    105    80.12
	DB	79.80T	;    106    79.80
	DB	79.48T	;    107    79.48
	DB	79.17T	;    108    79.17
	DB	78.86T	;    109    78.86
	DB	78.54T	;    110    78.54
	DB	78.24T	;    111    78.24
	DB	77.93T	;    112    77.93
	DB	77.63T	;    113    77.63
	DB	77.33T	;    114    77.33
	DB	77.04T	;    115    77.04
	DB	76.74T	;    116    76.74
	DB	76.46T	;    117    76.46
	DB	76.17T	;    118    76.17
	DB	75.88T	;    119    75.88
	DB	75.60T	;    120    75.60
	DB	75.32T	;    121    75.32
	DB	75.04T	;    122    75.04
	DB	74.76T	;    123    74.76
	DB	74.49T	;    124    74.49
	DB	74.22T	;    125    74.22
	DB	73.95T	;    126    73.95
	DB	73.68T	;    127    73.68
	DB	73.42T	;    128    73.42
	DB	73.16T	;    129    73.16
	DB	72.89T	;    130    72.89
	DB	72.63T	;    131    72.63
	DB	72.38T	;    132    72.38
	DB	72.12T	;    133    72.12
	DB	71.87T	;    134    71.87
	DB	71.62T	;    135    71.62
	DB	71.37T	;    136    71.37
	DB	71.12T	;    137    71.12
	DB	70.88T	;    138    70.88
	DB	70.63T	;    139    70.63
	DB	70.39T	;    140    70.39
	DB	70.16T	;    141    70.16
	DB	69.92T	;    142    69.92
	DB	69.68T	;    143    69.68
	DB	69.44T	;    144    69.44
	DB	69.21T	;    145    69.21
	DB	68.98T	;    146    68.98
	DB	68.75T	;    147    68.75
	DB	68.52T	;    148    68.52
	DB	68.29T	;    149    68.29
	DB	68.07T	;    150    68.07
	DB	67.84T	;    151    67.84
	DB	67.62T	;    152    67.62
	DB	67.40T	;    153    67.40
	DB	67.18T	;    154    67.18
	DB	66.96T	;    155    66.96
	DB	66.74T	;    156    66.74
	DB	66.53T	;    157    66.53
	DB	66.31T	;    158    66.31
	DB	66.10T	;    159    66.10
	DB	65.89T	;    160    65.89
	DB	65.68T	;    161    65.68
	DB	65.47T	;    162    65.47
	DB	65.26T	;    163    65.26
	DB	65.05T	;    164    65.05
	DB	64.84T	;    165    64.84
	DB	64.64T	;    166    64.64
	DB	64.44T	;    167    64.44
	DB	64.24T	;    168    64.24
	DB	64.04T	;    169    64.04
	DB	63.84T	;    170    63.84
	DB	63.64T	;    171    63.64
	DB	63.44T	;    172    63.44
	DB	63.24T	;    173    63.24
	DB	63.05T	;    174    63.05
	DB	62.86T	;    175    62.86
	DB	62.66T	;    176    62.66
	DB	62.47T	;    177    62.47
	DB	62.28T	;    178    62.28
	DB	62.09T	;    179    62.09
	DB	61.90T	;    180    61.90
	DB	61.71T	;    181    61.71
	DB	61.52T	;    182    61.52
	DB	61.34T	;    183    61.34
	DB	61.16T	;    184    61.16
	DB	60.97T	;    185    60.97
	DB	60.78T	;    186    60.78
	DB	60.61T	;    187    60.61
	DB	60.42T	;    188    60.42
	DB	60.24T	;    189    60.24
	DB	60.06T	;    190    60.06
	DB	59.88T	;    191    59.88
	DB	59.71T	;    192    59.71
	DB	59.53T	;    193    59.53
	DB	59.35T	;    194    59.35
	DB	59.18T	;    195    59.18
	DB	59.00T	;    196    59.00
	DB	58.83T	;    197    58.83
	DB	58.66T	;    198    58.66
	DB	58.48T	;    199    58.48
	DB	58.31T	;    200    58.31
	DB	58.14T	;    201    58.14
	DB	57.97T	;    202    57.97
	DB	57.81T	;    203    57.81
	DB	57.63T	;    204    57.63
	DB	57.47T	;    205    57.47
	DB	57.30T	;    206    57.30
	DB	57.13T	;    207    57.13
	DB	56.97T	;    208    56.97
	DB	56.81T	;    209    56.81
	DB	56.64T	;    210    56.64
	DB	56.48T	;    211    56.48
	DB	56.32T	;    212    56.32
	DB	56.16T	;    213    56.16
	DB	55.99T	;    214    55.99
	DB	55.83T	;    215    55.83
	DB	55.67T	;    216    55.67
	DB	55.52T	;    217    55.52
	DB	55.36T	;    218    55.36
	DB	55.20T	;    219    55.20
	DB	55.04T	;    220    55.04
	DB	54.89T	;    221    54.89
	DB	54.73T	;    222    54.73
	DB	54.58T	;    223    54.58
	DB	54.42T	;    224    54.42
	DB	54.27T	;    225    54.27
	DB	54.11T	;    226    54.11
	DB	53.96T	;    227    53.96
	DB	53.81T	;    228    53.81
	DB	53.66T	;    229    53.66
	DB	53.51T	;    230    53.51
	DB	53.36T	;    231    53.36
	DB	53.21T	;    232    53.21
	DB	53.06T	;    233    53.06
	DB	52.91T	;    234    52.91
	DB	52.76T	;    235    52.76
	DB	52.61T	;    236    52.61
	DB	52.47T	;    237    52.47
	DB	52.32T	;    238    52.32
	DB	52.17T	;    239    52.17
	DB	52.03T	;    240    52.03
	DB	51.88T	;    241    51.88
	DB	51.74T	;    242    51.74
	DB	51.59T	;    243    51.59
	DB	51.45T	;    244    51.45
	DB	51.31T	;    245    51.31
	DB	51.17T	;    246    51.17
	DB	51.02T	;    247    51.02
	DB	50.88T	;    248    50.88
	DB	50.74T	;    249    50.74
	DB	50.60T	;    250    50.60
	DB	50.46T	;    251    50.46
	DB	50.32T	;    252    50.32
	DB	50.18T	;    253    50.18
	DB	50.04T	;    254    50.04
	DB	49.91T	;    255    49.91
	DB	49.77T	;    256    49.77
	DB	49.63T	;    257    49.63
	DB	49.49T	;    258    49.49
	DB	49.36T	;    259    49.36
	DB	49.22T	;    260    49.22
	DB	49.09T	;    261    49.09
	DB	48.95T	;    262    48.95
	DB	48.82T	;    263    48.82
	DB	48.68T	;    264    48.68
	DB	48.55T	;    265    48.55
	DB	48.42T	;    266    48.42
	DB	48.28T	;    267    48.28
	DB	48.15T	;    268    48.15
	DB	48.02T	;    269    48.02
	DB	47.89T	;    270    47.89
	DB	47.76T	;    271    47.76
	DB	47.63T	;    272    47.63
	DB	47.49T	;    273    47.49
	DB	47.37T	;    274    47.37
	DB	47.23T	;    275    47.23
	DB	47.11T	;    276    47.11
	DB	46.98T	;    277    46.98
	DB	46.85T	;    278    46.85
	DB	46.72T	;    279    46.72
	DB	46.59T	;    280    46.59
	DB	46.47T	;    281    46.47
	DB	46.34T	;    282    46.34
	DB	46.21T	;    283    46.21
	DB	46.08T	;    284    46.08
	DB	45.96T	;    285    45.96
	DB	45.83T	;    286    45.83
	DB	45.71T	;    287    45.71
	DB	45.58T	;    288    45.58
	DB	45.46T	;    289    45.46
	DB	45.33T	;    290    45.33
	DB	45.21T	;    291    45.21
	DB	45.08T	;    292    45.08
	DB	44.96T	;    293    44.96
	DB	44.84T	;    294    44.84
	DB	44.72T	;    295    44.72
	DB	44.59T	;    296    44.59
	DB	44.47T	;    297    44.47
	DB	44.35T	;    298    44.35
	DB	44.23T	;    299    44.23
	DB	44.11T	;    300    44.11
	DB	43.99T	;    301    43.99
	DB	43.87T	;    302    43.87
	DB	43.74T	;    303    43.74
	DB	43.63T	;    304    43.63
	DB	43.51T	;    305    43.51
	DB	43.39T	;    306    43.39
	DB	43.27T	;    307    43.27
	DB	43.15T	;    308    43.15
	DB	43.03T	;    309    43.03
	DB	42.91T	;    310    42.91
	DB	42.79T	;    311    42.79
	DB	42.68T	;    312    42.68
	DB	42.56T	;    313    42.56
	DB	42.44T	;    314    42.44
	DB	42.33T	;    315    42.33
	DB	42.21T	;    316    42.21
	DB	42.09T	;    317    42.09
	DB	41.98T	;    318    41.98
	DB	41.86T	;    319    41.86
	DB	41.74T	;    320    41.74
	DB	41.63T	;    321    41.63
	DB	41.52T	;    322    41.52
	DB	41.40T	;    323    41.40
	DB	41.29T	;    324    41.29
	DB	41.17T	;    325    41.17
	DB	41.06T	;    326    41.06
	DB	40.94T	;    327    40.94
	DB	40.83T	;    328    40.83
	DB	40.72T	;    329    40.72
	DB	40.61T	;    330    40.61
	DB	40.49T	;    331    40.49
	DB	40.38T	;    332    40.38
	DB	40.27T	;    333    40.27
	DB	40.16T	;    334    40.16
	DB	40.04T	;    335    40.04
	DB	39.93T	;    336    39.93
	DB	39.82T	;    337    39.82
	DB	39.71T	;    338    39.71
	DB	39.60T	;    339    39.60
	DB	39.49T	;    340    39.49
	DB	39.38T	;    341    39.38
	DB	39.27T	;    342    39.27
	DB	39.16T	;    343    39.16
	DB	39.05T	;    344    39.05
	DB	38.94T	;    345    38.94
	DB	38.83T	;    346    38.83
	DB	38.72T	;    347    38.72
	DB	38.61T	;    348    38.61
	DB	38.51T	;    349    38.51
	DB	38.39T	;    350    38.39
	DB	38.29T	;    351    38.29
	DB	38.18T	;    352    38.18
	DB	38.07T	;    353    38.07
	DB	37.96T	;    354    37.96
	DB	37.86T	;    355    37.86
	DB	37.75T	;    356    37.75
	DB	37.64T	;    357    37.64
	DB	37.53T	;    358    37.53
	DB	37.43T	;    359    37.43
	DB	37.32T	;    360    37.32
	DB	37.22T	;    361    37.22
	DB	37.11T	;    362    37.11
	DB	37.01T	;    363    37.01
	DB	36.90T	;    364    36.90
	DB	36.79T	;    365    36.79
	DB	36.69T	;    366    36.69
	DB	36.58T	;    367    36.58
	DB	36.48T	;    368    36.48
	DB	36.37T	;    369    36.37
	DB	36.27T	;    370    36.27
	DB	36.17T	;    371    36.17
	DB	36.06T	;    372    36.06
	DB	35.96T	;    373    35.96
	DB	35.85T	;    374    35.85
	DB	35.75T	;    375    35.75
	DB	35.64T	;    376    35.64
	DB	35.54T	;    377    35.54
	DB	35.44T	;    378    35.44
	DB	35.33T	;    379    35.33
	DB	35.23T	;    380    35.23
	DB	35.13T	;    381    35.13
	DB	35.03T	;    382    35.03
	DB	34.92T	;    383    34.92
	DB	34.82T	;    384    34.82
	DB	34.72T	;    385    34.72
	DB	34.62T	;    386    34.62
	DB	34.52T	;    387    34.52
	DB	34.42T	;    388    34.42
	DB	34.31T	;    389    34.31
	DB	34.21T	;    390    34.21
	DB	34.11T	;    391    34.11
	DB	34.01T	;    392    34.01
	DB	33.91T	;    393    33.91
	DB	33.81T	;    394    33.81
	DB	33.71T	;    395    33.71
	DB	33.61T	;    396    33.61
	DB	33.51T	;    397    33.51
	DB	33.41T	;    398    33.41
	DB	33.31T	;    399    33.31
	DB	33.21T	;    400    33.21
	DB	33.11T	;    401    33.11
	DB	33.01T	;    402    33.01
	DB	32.91T	;    403    32.91
	DB	32.81T	;    404    32.81
	DB	32.71T	;    405    32.71
	DB	32.61T	;    406    32.61
	DB	32.51T	;    407    32.51
	DB	32.41T	;    408    32.41
	DB	32.32T	;    409    32.32
	DB	32.22T	;    410    32.22
	DB	32.12T	;    411    32.12
	DB	32.02T	;    412    32.02
	DB	31.92T	;    413    31.92
	DB	31.82T	;    414    31.82
	DB	31.73T	;    415    31.73
	DB	31.63T	;    416    31.63
	DB	31.53T	;    417    31.53
	DB	31.43T	;    418    31.43
	DB	31.33T	;    419    31.33
	DB	31.24T	;    420    31.24
	DB	31.14T	;    421    31.14
	DB	31.04T	;    422    31.04
	DB	30.94T	;    423    30.94
	DB	30.85T	;    424    30.85
	DB	30.76T	;    425    30.76
	DB	30.66T	;    426    30.66
	DB	30.56T	;    427    30.56
	DB	30.47T	;    428    30.47
	DB	30.37T	;    429    30.37
	DB	30.27T	;    430    30.27
	DB	30.18T	;    431    30.18
	DB	30.08T	;    432    30.08
	DB	29.98T	;    433    29.98
	DB	29.89T	;    434    29.89
	DB	29.79T	;    435    29.79
	DB	29.69T	;    436    29.69
	DB	29.60T	;    437    29.60
	DB	29.51T	;    438    29.51
	DB	29.41T	;    439    29.41
	DB	29.32T	;    440    29.32
	DB	29.22T	;    441    29.22
	DB	29.13T	;    442    29.13
	DB	29.03T	;    443    29.03
	DB	28.94T	;    444    28.94
	DB	28.84T	;    445    28.84
	DB	28.75T	;    446    28.75
	DB	28.66T	;    447    28.66
	DB	28.56T	;    448    28.56
	DB	28.47T	;    449    28.47
	DB	28.37T	;    450    28.37
	DB	28.28T	;    451    28.28
	DB	28.18T	;    452    28.18
	DB	28.09T	;    453    28.09
	DB	27.99T	;    454    27.99
	DB	27.90T	;    455    27.90
	DB	27.81T	;    456    27.81
	DB	27.71T	;    457    27.71
	DB	27.62T	;    458    27.62
	DB	27.53T	;    459    27.53
	DB	27.43T	;    460    27.43
	DB	27.34T	;    461    27.34
	DB	27.24T	;    462    27.24
	DB	27.16T	;    463    27.16
	DB	27.06T	;    464    27.06
	DB	26.97T	;    465    26.97
	DB	26.88T	;    466    26.88
	DB	26.78T	;    467    26.78
	DB	26.69T	;    468    26.69
	DB	26.59T	;    469    26.59
	DB	26.51T	;    470    26.51
	DB	26.41T	;    471    26.41
	DB	26.32T	;    472    26.32
	DB	26.23T	;    473    26.23
	DB	26.13T	;    474    26.13
	DB	26.04T	;    475    26.04
	DB	25.95T	;    476    25.95
	DB	25.86T	;    477    25.86
	DB	25.77T	;    478    25.77
	DB	25.67T	;    479    25.67
	DB	25.58T	;    480    25.58
	DB	25.49T	;    481    25.49
	DB	25.40T	;    482    25.40
	DB	25.31T	;    483    25.31
	DB	25.22T	;    484    25.22
	DB	25.12T	;    485    25.12
	DB	25.03T	;    486    25.03
	DB	24.94T	;    487    24.94
	DB	24.85T	;    488    24.85
	DB	24.76T	;    489    24.76
	DB	24.67T	;    490    24.67
	DB	24.58T	;    491    24.58
	DB	24.48T	;    492    24.48
	DB	24.39T	;    493    24.39
	DB	24.31T	;    494    24.31
	DB	24.21T	;    495    24.21
	DB	24.12T	;    496    24.12
	DB	24.03T	;    497    24.03
	DB	23.94T	;    498    23.94
	DB	23.85T	;    499    23.85
	DB	23.76T	;    500    23.76
	DB	23.67T	;    501    23.67
	DB	23.58T	;    502    23.58
	DB	23.49T	;    503    23.49
	DB	23.39T	;    504    23.39
	DB	23.31T	;    505    23.31
	DB	23.22T	;    506    23.22
	DB	23.13T	;    507    23.13
	DB	23.03T	;    508    23.03
	DB	22.94T	;    509    22.94
	DB	22.86T	;    510    22.86
	DB	22.77T	;    511    22.77
	DB	22.67T	;    512    22.67
	DB	22.58T	;    513    22.58
	DB	22.49T	;    514    22.49
	DB	22.41T	;    515    22.41
	DB	22.32T	;    516    22.32
	DB	22.22T	;    517    22.22
	DB	22.13T	;    518    22.13
	DB	22.04T	;    519    22.04
	DB	21.96T	;    520    21.96
	DB	21.87T	;    521    21.87
	DB	21.77T	;    522    21.77
	DB	21.68T	;    523    21.68
	DB	21.59T	;    524    21.59
	DB	21.51T	;    525    21.51
	DB	21.42T	;    526    21.42
	DB	21.33T	;    527    21.33
	DB	21.24T	;    528    21.24
	DB	21.15T	;    529    21.15
	DB	21.06T	;    530    21.06
	DB	20.97T	;    531    20.97
	DB	20.88T	;    532    20.88
	DB	20.79T	;    533    20.79
	DB	20.70T	;    534    20.70
	DB	20.61T	;    535    20.61
	DB	20.52T	;    536    20.52
	DB	20.43T	;    537    20.43
	DB	20.34T	;    538    20.34
	DB	20.26T	;    539    20.26
	DB	20.17T	;    540    20.17
	DB	20.07T	;    541    20.07
	DB	19.98T	;    542    19.98
	DB	19.89T	;    543    19.89
	DB	19.81T	;    544    19.81
	DB	19.72T	;    545    19.72
	DB	19.63T	;    546    19.63
	DB	19.54T	;    547    19.54
	DB	19.45T	;    548    19.45
	DB	19.36T	;    549    19.36
	DB	19.27T	;    550    19.27
	DB	19.18T	;    551    19.18
	DB	19.09T	;    552    19.09
	DB	19.01T	;    553    19.01
	DB	18.92T	;    554    18.92
	DB	18.83T	;    555    18.83
	DB	18.74T	;    556    18.74
	DB	18.65T	;    557    18.65
	DB	18.56T	;    558    18.56
	DB	18.47T	;    559    18.47
	DB	18.38T	;    560    18.38
	DB	18.29T	;    561    18.29
	DB	18.21T	;    562    18.21
	DB	18.12T	;    563    18.12
	DB	18.03T	;    564    18.03
	DB	17.94T	;    565    17.94
	DB	17.85T	;    566    17.85
	DB	17.76T	;    567    17.76
	DB	17.67T	;    568    17.67
	DB	17.58T	;    569    17.58
	DB	17.49T	;    570    17.49
	DB	17.41T	;    571    17.41
	DB	17.32T	;    572    17.32
	DB	17.23T	;    573    17.23
	DB	17.14T	;    574    17.14
	DB	17.05T	;    575    17.05
	DB	16.96T	;    576    16.96
	DB	16.87T	;    577    16.87
	DB	16.78T	;    578    16.78
	DB	16.69T	;    579    16.69
	DB	16.61T	;    580    16.61
	DB	16.52T	;    581    16.52
	DB	16.43T	;    582    16.43
	DB	16.33T	;    583    16.33
	DB	16.24T	;    584    16.24
	DB	16.16T	;    585    16.16
	DB	16.07T	;    586    16.07
	DB	15.98T	;    587    15.98
	DB	15.89T	;    588    15.89
	DB	15.80T	;    589    15.80
	DB	15.71T	;    590    15.71
	DB	15.62T	;    591    15.62
	DB	15.53T	;    592    15.53
	DB	15.44T	;    593    15.44
	DB	15.36T	;    594    15.36
	DB	15.27T	;    595    15.27
	DB	15.18T	;    596    15.18
	DB	15.09T	;    597    15.09
	DB	15.00T	;    598    15.00
	DB	14.91T	;    599    14.91
	DB	14.82T	;    600    14.82
	DB	14.73T	;    601    14.73
	DB	14.64T	;    602    14.64
	DB	14.56T	;    603    14.56
	DB	14.47T	;    604    14.47
	DB	14.37T	;    605    14.37
	DB	14.28T	;    606    14.28
	DB	14.19T	;    607    14.19
	DB	14.11T	;    608    14.11
	DB	14.02T	;    609    14.02
	DB	13.93T	;    610    13.93
	DB	13.84T	;    611    13.84
	DB	13.75T	;    612    13.75
	DB	13.66T	;    613    13.66
	DB	13.57T	;    614    13.57
	DB	13.48T	;    615    13.48
	DB	13.39T	;    616    13.39
	DB	13.30T	;    617    13.30
	DB	13.21T	;    618    13.21
	DB	13.12T	;    619    13.12
	DB	13.03T	;    620    13.03
	DB	12.94T	;    621    12.94
	DB	12.85T	;    622    12.85
	DB	12.76T	;    623    12.76
	DB	12.67T	;    624    12.67
	DB	12.58T	;    625    12.58
	DB	12.49T	;    626    12.49
	DB	12.40T	;    627    12.40
	DB	12.31T	;    628    12.31
	DB	12.22T	;    629    12.22
	DB	12.13T	;    630    12.13
	DB	12.04T	;    631    12.04
	DB	11.95T	;    632    11.95
	DB	11.86T	;    633    11.86
	DB	11.77T	;    634    11.77
	DB	11.68T	;    635    11.68
	DB	11.59T	;    636    11.59
	DB	11.50T	;    637    11.50
	DB	11.41T	;    638    11.41
	DB	11.32T	;    639    11.32
	DB	11.23T	;    640    11.23
	DB	11.13T	;    641    11.13
	DB	11.04T	;    642    11.04
	DB	10.96T	;    643    10.96
	DB	10.86T	;    644    10.86
	DB	10.77T	;    645    10.77
	DB	10.68T	;    646    10.68
	DB	10.59T	;    647    10.59
	DB	10.50T	;    648    10.50
	DB	10.41T	;    649    10.41
	DB	10.32T	;    650    10.32
	DB	10.22T	;    651    10.22
	DB	10.13T	;    652    10.13
	DB	10.04T	;    653    10.04
	DB	9.95T	;    654    9.95
	DB	9.86T	;    655    9.86
	DB	9.77T	;    656    9.77
	DB	9.68T	;    657    9.68
	DB	9.58T	;    658    9.58
	DB	9.49T	;    659    9.49
	DB	9.40T	;    660    9.40
	DB	9.31T	;    661    9.31
	DB	9.22T	;    662    9.22
	DB	9.12T	;    663    9.12
	DB	9.03T	;    664    9.03
	DB	8.94T	;    665    8.94
	DB	8.84T	;    666    8.84
	DB	8.76T	;    667    8.76
	DB	8.66T	;    668    8.66
	DB	8.57T	;    669    8.57
	DB	8.48T	;    670    8.48
	DB	8.38T	;    671    8.38
	DB	8.29T	;    672    8.29
	DB	8.20T	;    673    8.20
	DB	8.11T	;    674    8.11
	DB	8.01T	;    675    8.01
	DB	7.92T	;    676    7.92
	DB	7.83T	;    677    7.83
	DB	7.73T	;    678    7.73
	DB	7.64T	;    679    7.64
	DB	7.54T	;    680    7.54
	DB	7.45T	;    681    7.45
	DB	7.36T	;    682    7.36
	DB	7.27T	;    683    7.27
	DB	7.17T	;    684    7.17
	DB	7.08T	;    685    7.08
	DB	6.98T	;    686    6.98
	DB	6.89T	;    687    6.89
	DB	6.79T	;    688    6.79
	DB	6.70T	;    689    6.70
	DB	6.61T	;    690    6.61
	DB	6.51T	;    691    6.51
	DB	6.42T	;    692    6.42
	DB	6.32T	;    693    6.32
	DB	6.23T	;    694    6.23
	DB	6.13T	;    695    6.13
	DB	6.04T	;    696    6.04
	DB	5.94T	;    697    5.94
	DB	5.84T	;    698    5.84
	DB	5.75T	;    699    5.75
	DB	5.66T	;    700    5.66
	DB	5.56T	;    701    5.56
	DB	5.47T	;    702    5.47
	DB	5.37T	;    703    5.37
	DB	5.27T	;    704    5.27
	DB	5.18T	;    705    5.18
	DB	5.08T	;    706    5.08
	DB	4.98T	;    707    4.98
	DB	4.89T	;    708    4.89
	DB	4.79T	;    709    4.79
	DB	4.69T	;    710    4.69
	DB	4.59T	;    711    4.59
	DB	4.50T	;    712    4.50
	DB	4.41T	;    713    4.41
	DB	4.31T	;    714    4.31
	DB	4.21T	;    715    4.21
	DB	4.11T	;    716    4.11
	DB	4.01T	;    717    4.01
	DB	3.92T	;    718    3.92
	DB	3.82T	;    719    3.82
	DB	3.72T	;    720    3.72
	DB	3.62T	;    721    3.62
	DB	3.52T	;    722    3.52
	DB	3.43T	;    723    3.43
	DB	3.33T	;    724    3.33
	DB	3.23T	;    725    3.23
	DB	3.13T	;    726    3.13
	DB	3.03T	;    727    3.03
	DB	2.93T	;    728    2.93
	DB	2.83T	;    729    2.83
	DB	2.73T	;    730    2.73
	DB	2.63T	;    731    2.63
	DB	2.53T	;    732    2.53
	DB	2.43T	;    733    2.43
	DB	2.33T	;    734    2.33
	DB	2.23T	;    735    2.23
	DB	2.13T	;    736    2.13
	DB	2.03T	;    737    2.03
	DB	1.93T	;    738    1.93
	DB	1.83T	;    739    1.83
	DB	1.73T	;    740    1.73
	DB	1.63T	;    741    1.63
	DB	1.53T	;    742    1.53
	DB	1.43T	;    743    1.43
	DB	1.32T	;    744    1.32
	DB	1.22T	;    745    1.22
	DB	1.12T	;    746    1.12
	DB	1.02T	;    747    1.02
	DB	0.92T	;    748    0.92
	DB	0.81T	;    749    0.81
	DB	0.71T	;    750    0.71
	DB	0.61T	;    751    0.61
	DB	0.51T	;    752    0.51
	DB	0.40T	;    753    0.40
	DB	0.30T	;    754    0.30
	DB	0.19T	;    755    0.19
	DB	0.09T	;    756    0.09
	DB	-0.01T	;    757    -0.01
	DB	-0.12T	;    758    -0.12
	DB	-0.22T	;    759    -0.22
	DB	-0.33T	;    760    -0.33
	DB	-0.43T	;    761    -0.43
	DB	-0.54T	;    762    -0.54
	DB	-0.64T	;    763    -0.64
	DB	-0.75T	;    764    -0.75
	DB	-0.86T	;    765    -0.86
	DB	-0.96T	;    766    -0.96
	DB	-1.07T	;    767    -1.07
	DB	-1.17T	;    768    -1.17
	DB	-1.28T	;    769    -1.28
	DB	-1.38T	;    770    -1.38
	DB	-1.49T	;    771    -1.49
	DB	-1.60T	;    772    -1.60
	DB	-1.71T	;    773    -1.71
	DB	-1.82T	;    774    -1.82
	DB	-1.92T	;    775    -1.92
	DB	-2.03T	;    776    -2.03
	DB	-2.14T	;    777    -2.14
	DB	-2.24T	;    778    -2.24
	DB	-2.36T	;    779    -2.36
	DB	-2.47T	;    780    -2.47
	DB	-2.57T	;    781    -2.57
	DB	-2.68T	;    782    -2.68
	DB	-2.79T	;    783    -2.79
	DB	-2.91T	;    784    -2.91
	DB	-3.02T	;    785    -3.02
	DB	-3.13T	;    786    -3.13
	DB	-3.23T	;    787    -3.23
	DB	-3.34T	;    788    -3.34
	DB	-3.46T	;    789    -3.46
	DB	-3.57T	;    790    -3.57
	DB	-3.68T	;    791    -3.68
	DB	-3.79T	;    792    -3.79
	DB	-3.91T	;    793    -3.91
	DB	-4.02T	;    794    -4.02
	DB	-4.13T	;    795    -4.13
	DB	-4.24T	;    796    -4.24
	DB	-4.36T	;    797    -4.36
	DB	-4.47T	;    798    -4.47
	DB	-4.59T	;    799    -4.59
	DB	-4.70T	;    800    -4.70
	DB	-4.82T	;    801    -4.82
	DB	-4.93T	;    802    -4.93
	DB	-5.05T	;    803    -5.05
	DB	-5.16T	;    804    -5.16
	DB	-5.28T	;    805    -5.28
	DB	-5.39T	;    806    -5.39
	DB	-5.51T	;    807    -5.51
	DB	-5.63T	;    808    -5.63
	DB	-5.74T	;    809    -5.74
	DB	-5.87T	;    810    -5.87
	DB	-5.98T	;    811    -5.98
	DB	-6.10T	;    812    -6.10
	DB	-6.22T	;    813    -6.22
	DB	-6.34T	;    814    -6.34
	DB	-6.46T	;    815    -6.46
	DB	-6.58T	;    816    -6.58
	DB	-6.70T	;    817    -6.70
	DB	-6.82T	;    818    -6.82
	DB	-6.94T	;    819    -6.94
	DB	-7.06T	;    820    -7.06
	DB	-7.18T	;    821    -7.18
	DB	-7.31T	;    822    -7.31
	DB	-7.43T	;    823    -7.43
	DB	-7.55T	;    824    -7.55
	DB	-7.67T	;    825    -7.67
	DB	-7.79T	;    826    -7.79
	DB	-7.92T	;    827    -7.92
	DB	-8.04T	;    828    -8.04
	DB	-8.17T	;    829    -8.17
	DB	-8.29T	;    830    -8.29
	DB	-8.42T	;    831    -8.42
	DB	-8.54T	;    832    -8.54
	DB	-8.67T	;    833    -8.67
	DB	-8.80T	;    834    -8.80
	DB	-8.93T	;    835    -8.93
	DB	-9.06T	;    836    -9.06
	DB	-9.18T	;    837    -9.18
	DB	-9.31T	;    838    -9.31
	DB	-9.44T	;    839    -9.44
	DB	-9.57T	;    840    -9.57
	DB	-9.70T	;    841    -9.70
	DB	-9.83T	;    842    -9.83
	DB	-9.96T	;    843    -9.96
	DB	-10.09T	;    844    -10.09
	DB	-10.22T	;    845    -10.22
	DB	-10.36T	;    846    -10.36
	DB	-10.49T	;    847    -10.49
	DB	-10.62T	;    848    -10.62
	DB	-10.76T	;    849    -10.76
	DB	-10.89T	;    850    -10.89
	DB	-11.02T	;    851    -11.02
	DB	-11.16T	;    852    -11.16
	DB	-11.29T	;    853    -11.29
	DB	-11.43T	;    854    -11.43
	DB	-11.57T	;    855    -11.57
	DB	-11.71T	;    856    -11.71
	DB	-11.84T	;    857    -11.84
	DB	-11.98T	;    858    -11.98
	DB	-12.12T	;    859    -12.12
	DB	-12.26T	;    860    -12.26
	DB	-12.41T	;    861    -12.41
	DB	-12.54T	;    862    -12.54
	DB	-12.68T	;    863    -12.68
	DB	-12.83T	;    864    -12.83
	DB	-12.97T	;    865    -12.97
	DB	-13.12T	;    866    -13.12
	DB	-13.26T	;    867    -13.26
	DB	-13.41T	;    868    -13.41
	DB	-13.55T	;    869    -13.55
	DB	-13.69T	;    870    -13.69
	DB	-13.84T	;    871    -13.84
	DB	-13.99T	;    872    -13.99
	DB	-14.14T	;    873    -14.14
	DB	-14.29T	;    874    -14.29
	DB	-14.44T	;    875    -14.44
	DB	-14.59T	;    876    -14.59
	DB	-14.74T	;    877    -14.74
	DB	-14.89T	;    878    -14.89
	DB	-15.04T	;    879    -15.04
	DB	-15.19T	;    880    -15.19
	DB	-15.35T	;    881    -15.35
	DB	-15.51T	;    882    -15.51
	DB	-15.66T	;    883    -15.66
	DB	-15.82T	;    884    -15.82
	DB	-15.97T	;    885    -15.97
	DB	-16.13T	;    886    -16.13
	DB	-16.29T	;    887    -16.29
	DB	-16.45T	;    888    -16.45
	DB	-16.61T	;    889    -16.61
	DB	-16.77T	;    890    -16.77
	DB	-16.93T	;    891    -16.93
	DB	-17.10T	;    892    -17.10
	DB	-17.26T	;    893    -17.26
	DB	-17.43T	;    894    -17.43
	DB	-17.59T	;    895    -17.59
	DB	-17.76T	;    896    -17.76
	DB	-17.93T	;    897    -17.93
	DB	-18.10T	;    898    -18.10
	DB	-18.27T	;    899    -18.27
	DB	-18.44T	;    900    -18.44
	DB	-18.61T	;    901    -18.61
	DB	-18.78T	;    902    -18.78
	DB	-18.96T	;    903    -18.96
	DB	-19.13T	;    904    -19.13
	DB	-19.31T	;    905    -19.31
	DB	-19.49T	;    906    -19.49
	DB	-19.67T	;    907    -19.67
	DB	-19.85T	;    908    -19.85
	DB	-20.03T	;    909    -20.03
	DB	-20.21T	;    910    -20.21
	DB	-20.39T	;    911    -20.39
	DB	-20.58T	;    912    -20.58
	DB	-20.77T	;    913    -20.77
	DB	-20.96T	;    914    -20.96
	DB	-21.14T	;    915    -21.14
	DB	-21.33T	;    916    -21.33
	DB	-21.53T	;    917    -21.53
	DB	-21.72T	;    918    -21.72
	DB	-21.91T	;    919    -21.91
	DB	-22.11T	;    920    -22.11
	DB	-22.31T	;    921    -22.31
	DB	-22.51T	;    922    -22.51
	DB	-22.71T	;    923    -22.71
	DB	-22.91T	;    924    -22.91
	DB	-23.11T	;    925    -23.11
	DB	-23.32T	;    926    -23.32
	DB	-23.52T	;    927    -23.52
	DB	-23.73T	;    928    -23.73
	DB	-23.94T	;    929    -23.94
	DB	-24.16T	;    930    -24.16
	DB	-24.37T	;    931    -24.37
	DB	-24.58T	;    932    -24.58
	DB	-24.80T	;    933    -24.80
	DB	-25.02T	;    934    -25.02
	DB	-25.24T	;    935    -25.24
	DB	-25.47T	;    936    -25.47
	DB	-25.69T	;    937    -25.69
	DB	-25.92T	;    938    -25.92
	DB	-26.15T	;    939    -26.15
	DB	-26.38T	;    940    -26.38
	DB	-26.62T	;    941    -26.62
	DB	-26.85T	;    942    -26.85
	DB	-27.09T	;    943    -27.09
	DB	-27.33T	;    944    -27.33
	DB	-27.58T	;    945    -27.58
	DB	-27.82T	;    946    -27.82
	DB	-28.07T	;    947    -28.07
	DB	-28.32T	;    948    -28.32
	DB	-28.58T	;    949    -28.58
	DB	-28.83T	;    950    -28.83
	DB	-29.09T	;    951    -29.09
	DB	-29.36T	;    952    -29.36
	DB	-29.63T	;    953    -29.63
	DB	-29.89T	;    954    -29.89
	DB	-30.17T	;    955    -30.17
	DB	-30.44T	;    956    -30.44
	DB	-30.72T	;    957    -30.72
	DB	-31.01T	;    958    -31.01
	DB	-31.29T	;    959    -31.29
	DB	-31.58T	;    960    -31.58
	DB	-31.88T	;    961    -31.88
	DB	-32.18T	;    962    -32.18
	DB	-32.48T	;    963    -32.48
	DB	-32.78T	;    964    -32.78
	DB	-33.09T	;    965    -33.09
	DB	-33.41T	;    966    -33.41
	DB	-33.73T	;    967    -33.73
	DB	-34.06T	;    968    -34.06
	DB	-34.39T	;    969    -34.39
	DB	-34.72T	;    970    -34.72
	DB	-35.06T	;    971    -35.06
	DB	-35.41T	;    972    -35.41
	DB	-35.76T	;    973    -35.76
	DB	-36.12T	;    974    -36.12
	DB	-36.48T	;    975    -36.48
	DB	-36.86T	;    976    -36.86
	DB	-37.23T	;    977    -37.23
	DB	-37.62T	;    978    -37.62
	DB	-38.01T	;    979    -38.01
	DB	-38.41T	;    980    -38.41
	DB	-38.82T	;    981    -38.82
	DB	-39.23T	;    982    -39.23
	DB	-39.66T	;    983    -39.66
	DB	80.00T	;    984    80.00
	DB	80.00T	;    985    80.00
	DB	80.00T	;    986    80.00
	DB	80.00T	;    987    80.00
	DB	80.00T	;    988    80.00
	DB	80.00T	;    989    80.00
	DB	80.00T	;    990    80.00
	DB	80.00T	;    991    80.00
	DB	80.00T	;    992    80.00
	DB	80.00T	;    993    80.00
	DB	80.00T	;    994    80.00
	DB	80.00T	;    995    80.00
	DB	80.00T	;    996    80.00
	DB	80.00T	;    997    80.00
	DB	80.00T	;    998    80.00
	DB	80.00T	;    999    80.00
	DB	80.00T	;    1000    80.00
	DB	80.00T	;    1001    80.00
	DB	80.00T	;    1002    80.00
	DB	80.00T	;    1003    80.00
	DB	80.00T	;    1004    80.00
	DB	80.00T	;    1005    80.00
	DB	80.00T	;    1006    80.00
	DB	80.00T	;    1007    80.00
	DB	80.00T	;    1008    80.00
	DB	80.00T	;    1009    80.00
	DB	80.00T	;    1010    80.00
	DB	80.00T	;    1011    80.00
	DB	80.00T	;    1012    80.00
	DB	80.00T	;    1013    80.00
	DB	80.00T	;    1014    80.00
	DB	80.00T	;    1015    80.00
	DB	80.00T	;    1016    80.00
	DB	80.00T	;    1017    80.00
	DB	80.00T	;    1018    80.00
	DB	80.00T	;    1019    80.00
	DB	80.00T	;    1020    80.00
	DB	80.00T	;    1021    80.00
	DB	80.00T	;    1022    80.00
	DB	80.00T	;    1023    Sensor Failure - use 80 degC as default

