; Generated By Pazi88
;
; BMW M52 Intake Air Temp sensor inc file to be used with Speeduino 202008 FW or newer
;
; File generated for use with stock 2490 ohm resistor
;
; Steinhart-Hart coefficients:  A= 1,310204E-03   B=2,251336E-04   C= 1,728273E-07
;
; Input Data     Temp, degC     Resistance
;		   -48		   363686
;		  20.3		    4025
;		  100.3		     258
;

MATFACTOR:
			;    ADC  Temp, degF
	DB	70.00T	;     0    Sensor Failure - use 70 degF as default
	DB	339.59T	;     1    339.59
	DB	265.66T	;     2    265.66
	DB	227.82T	;     3    227.82
	DB	202.73T	;     4    202.73
	DB	184.03T	;     5    184.03
	DB	169.09T	;     6    169.09
	DB	156.61T	;     7    156.61
	DB	145.84T	;     8    145.84
	DB	136.32T	;     9    136.32
	DB	127.73	;    10    127.73
	DB	119.86T	;    11    119.86
	DB	112.55T	;    12    112.55
	DB	105.69T	;    13    105.69
	DB	99.17T	;    14    99.17
	DB	92.92T	;    15    92.92
	DB	86.87T	;    16    86.87
	DB	80.98T	;    17    80.98
	DB	75.17T	;    18    75.17
	DB	69.41T	;    19    69.41
	DB	63.65T	;    20    63.65
	DB	57.82T	;    21    57.82
	DB	51.88T	;    22    51.88
	DB	45.73T	;    23    45.73
	DB	39.30T	;    24    39.30
	DB	32.45T	;    25    32.45
	DB	25.00T	;    26    25.00
	DB	16.65T	;    27    16.65
	DB	6.88T	;    28    6.88
	DB	-5.39T	;    29    -5.39
	DB	-23.39T	;    30    -23.39
	DB	-40.00T	;    31    -40.00
