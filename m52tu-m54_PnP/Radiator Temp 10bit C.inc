; Generated using EasyTherm4.exe
;
; M54/M52tu Radiator Temp Sensor
;
; File generated for use with stock 2490 ohm resistor
;
;
; Input Data     Temp. degC     Resistance
;		   -48		   141931
;		    20		    2826
;		   140		     115
;

THERMFACTOR:
            ;    ADC  Temp. degC
	DB	80.00T	;    0    Sensor Failure - use 80 degC as default
	DB	80.00T	;    1    80.00
	DB	80.00T	;    2    80.00
	DB	80.00T	;    3    80.00
	DB	80.00T	;    4    80.00
	DB	80.00T	;    5    80.00
	DB	80.00T	;    6    80.00
	DB	80.00T	;    7    80.00
	DB	80.00T	;    8    80.00
	DB	80.00T	;    9    80.00
	DB	174.91T	;    10    174.91
	DB	170.27T	;    11    170.27
	DB	166.12T	;    12    166.12
	DB	162.35T	;    13    162.35
	DB	158.92T	;    14    158.92
	DB	155.77T	;    15    155.77
	DB	152.86T	;    16    152.86
	DB	150.16T	;    17    150.16
	DB	147.64T	;    18    147.64
	DB	145.28T	;    19    145.28
	DB	143.06T	;    20    143.06
	DB	140.97T	;    21    140.97
	DB	138.99T	;    22    138.99
	DB	137.12T	;    23    137.12
	DB	135.34T	;    24    135.34
	DB	133.64T	;    25    133.64
	DB	132.03T	;    26    132.03
	DB	130.48T	;    27    130.48
	DB	129.00T	;    28    129.00
	DB	127.58T	;    29    127.58
	DB	126.21T	;    30    126.21
	DB	124.90T	;    31    124.90
	DB	123.63T	;    32    123.63
	DB	122.42T	;    33    122.42
	DB	121.24T	;    34    121.24
	DB	120.10T	;    35    120.10
	DB	119.00T	;    36    119.00
	DB	117.93T	;    37    117.93
	DB	116.89T	;    38    116.89
	DB	115.89T	;    39    115.89
	DB	114.92T	;    40    114.92
	DB	113.97T	;    41    113.97
	DB	113.05T	;    42    113.05
	DB	112.16T	;    43    112.16
	DB	111.28T	;    44    111.28
	DB	110.43T	;    45    110.43
	DB	109.61T	;    46    109.61
	DB	108.80T	;    47    108.80
	DB	108.01T	;    48    108.01
	DB	107.24T	;    49    107.24
	DB	106.49T	;    50    106.49
	DB	105.75T	;    51    105.75
	DB	105.03T	;    52    105.03
	DB	104.33T	;    53    104.33
	DB	103.64T	;    54    103.64
	DB	102.96T	;    55    102.96
	DB	102.30T	;    56    102.30
	DB	101.66T	;    57    101.66
	DB	101.02T	;    58    101.02
	DB	100.39T	;    59    100.39
	DB	99.78T	;    60    99.78
	DB	99.18T	;    61    99.18
	DB	98.59T	;    62    98.59
	DB	98.02T	;    63    98.02
	DB	97.44T	;    64    97.44
	DB	96.89T	;    65    96.89
	DB	96.34T	;    66    96.34
	DB	95.80T	;    67    95.80
	DB	95.27T	;    68    95.27
	DB	94.74T	;    69    94.74
	DB	94.23T	;    70    94.23
	DB	93.72T	;    71    93.72
	DB	93.23T	;    72    93.23
	DB	92.73T	;    73    92.73
	DB	92.25T	;    74    92.25
	DB	91.78T	;    75    91.78
	DB	91.31T	;    76    91.31
	DB	90.84T	;    77    90.84
	DB	90.39T	;    78    90.39
	DB	89.94T	;    79    89.94
	DB	89.49T	;    80    89.49
	DB	89.06T	;    81    89.06
	DB	88.63T	;    82    88.63
	DB	88.20T	;    83    88.20
	DB	87.78T	;    84    87.78
	DB	87.37T	;    85    87.37
	DB	86.96T	;    86    86.96
	DB	86.56T	;    87    86.56
	DB	86.16T	;    88    86.16
	DB	85.76T	;    89    85.76
	DB	85.37T	;    90    85.37
	DB	84.99T	;    91    84.99
	DB	84.61T	;    92    84.61
	DB	84.23T	;    93    84.23
	DB	83.86T	;    94    83.86
	DB	83.49T	;    95    83.49
	DB	83.13T	;    96    83.13
	DB	82.77T	;    97    82.77
	DB	82.42T	;    98    82.42
	DB	82.07T	;    99    82.07
	DB	81.72T	;    100    81.72
	DB	81.37T	;    101    81.37
	DB	81.03T	;    102    81.03
	DB	80.70T	;    103    80.70
	DB	80.37T	;    104    80.37
	DB	80.04T	;    105    80.04
	DB	79.71T	;    106    79.71
	DB	79.39T	;    107    79.39
	DB	79.07T	;    108    79.07
	DB	78.75T	;    109    78.75
	DB	78.44T	;    110    78.44
	DB	78.13T	;    111    78.13
	DB	77.82T	;    112    77.82
	DB	77.52T	;    113    77.52
	DB	77.21T	;    114    77.21
	DB	76.92T	;    115    76.92
	DB	76.62T	;    116    76.62
	DB	76.32T	;    117    76.32
	DB	76.03T	;    118    76.03
	DB	75.74T	;    119    75.74
	DB	75.46T	;    120    75.46
	DB	75.18T	;    121    75.18
	DB	74.89T	;    122    74.89
	DB	74.62T	;    123    74.62
	DB	74.34T	;    124    74.34
	DB	74.07T	;    125    74.07
	DB	73.79T	;    126    73.79
	DB	73.53T	;    127    73.53
	DB	73.26T	;    128    73.26
	DB	72.99T	;    129    72.99
	DB	72.73T	;    130    72.73
	DB	72.47T	;    131    72.47
	DB	72.21T	;    132    72.21
	DB	71.96T	;    133    71.96
	DB	71.70T	;    134    71.70
	DB	71.45T	;    135    71.45
	DB	71.20T	;    136    71.20
	DB	70.95T	;    137    70.95
	DB	70.70T	;    138    70.70
	DB	70.46T	;    139    70.46
	DB	70.21T	;    140    70.21
	DB	69.97T	;    141    69.97
	DB	69.73T	;    142    69.73
	DB	69.49T	;    143    69.49
	DB	69.26T	;    144    69.26
	DB	69.02T	;    145    69.02
	DB	68.79T	;    146    68.79
	DB	68.56T	;    147    68.56
	DB	68.33T	;    148    68.33
	DB	68.10T	;    149    68.10
	DB	67.87T	;    150    67.87
	DB	67.65T	;    151    67.65
	DB	67.42T	;    152    67.42
	DB	67.20T	;    153    67.20
	DB	66.98T	;    154    66.98
	DB	66.76T	;    155    66.76
	DB	66.54T	;    156    66.54
	DB	66.33T	;    157    66.33
	DB	66.11T	;    158    66.11
	DB	65.90T	;    159    65.90
	DB	65.68T	;    160    65.68
	DB	65.47T	;    161    65.47
	DB	65.27T	;    162    65.27
	DB	65.06T	;    163    65.06
	DB	64.85T	;    164    64.85
	DB	64.64T	;    165    64.64
	DB	64.44T	;    166    64.44
	DB	64.23T	;    167    64.23
	DB	64.03T	;    168    64.03
	DB	63.83T	;    169    63.83
	DB	63.63T	;    170    63.63
	DB	63.43T	;    171    63.43
	DB	63.23T	;    172    63.23
	DB	63.04T	;    173    63.04
	DB	62.84T	;    174    62.84
	DB	62.65T	;    175    62.65
	DB	62.46T	;    176    62.46
	DB	62.26T	;    177    62.26
	DB	62.07T	;    178    62.07
	DB	61.88T	;    179    61.88
	DB	61.69T	;    180    61.69
	DB	61.51T	;    181    61.51
	DB	61.32T	;    182    61.32
	DB	61.13T	;    183    61.13
	DB	60.94T	;    184    60.94
	DB	60.76T	;    185    60.76
	DB	60.58T	;    186    60.58
	DB	60.40T	;    187    60.40
	DB	60.22T	;    188    60.22
	DB	60.04T	;    189    60.04
	DB	59.86T	;    190    59.86
	DB	59.68T	;    191    59.68
	DB	59.50T	;    192    59.50
	DB	59.32T	;    193    59.32
	DB	59.15T	;    194    59.15
	DB	58.97T	;    195    58.97
	DB	58.80T	;    196    58.80
	DB	58.63T	;    197    58.63
	DB	58.46T	;    198    58.46
	DB	58.28T	;    199    58.28
	DB	58.11T	;    200    58.11
	DB	57.94T	;    201    57.94
	DB	57.77T	;    202    57.77
	DB	57.61T	;    203    57.61
	DB	57.44T	;    204    57.44
	DB	57.27T	;    205    57.27
	DB	57.11T	;    206    57.11
	DB	56.94T	;    207    56.94
	DB	56.77T	;    208    56.77
	DB	56.61T	;    209    56.61
	DB	56.44T	;    210    56.44
	DB	56.28T	;    211    56.28
	DB	56.12T	;    212    56.12
	DB	55.96T	;    213    55.96
	DB	55.80T	;    214    55.80
	DB	55.64T	;    215    55.64
	DB	55.48T	;    216    55.48
	DB	55.33T	;    217    55.33
	DB	55.17T	;    218    55.17
	DB	55.01T	;    219    55.01
	DB	54.86T	;    220    54.86
	DB	54.70T	;    221    54.70
	DB	54.54T	;    222    54.54
	DB	54.39T	;    223    54.39
	DB	54.24T	;    224    54.24
	DB	54.08T	;    225    54.08
	DB	53.93T	;    226    53.93
	DB	53.78T	;    227    53.78
	DB	53.63T	;    228    53.63
	DB	53.48T	;    229    53.48
	DB	53.33T	;    230    53.33
	DB	53.18T	;    231    53.18
	DB	53.03T	;    232    53.03
	DB	52.88T	;    233    52.88
	DB	52.73T	;    234    52.73
	DB	52.59T	;    235    52.59
	DB	52.44T	;    236    52.44
	DB	52.29T	;    237    52.29
	DB	52.15T	;    238    52.15
	DB	52.01T	;    239    52.01
	DB	51.86T	;    240    51.86
	DB	51.72T	;    241    51.72
	DB	51.57T	;    242    51.57
	DB	51.43T	;    243    51.43
	DB	51.29T	;    244    51.29
	DB	51.14T	;    245    51.14
	DB	51.01T	;    246    51.01
	DB	50.86T	;    247    50.86
	DB	50.72T	;    248    50.72
	DB	50.58T	;    249    50.58
	DB	50.44T	;    250    50.44
	DB	50.31T	;    251    50.31
	DB	50.17T	;    252    50.17
	DB	50.03T	;    253    50.03
	DB	49.89T	;    254    49.89
	DB	49.76T	;    255    49.76
	DB	49.62T	;    256    49.62
	DB	49.48T	;    257    49.48
	DB	49.35T	;    258    49.35
	DB	49.21T	;    259    49.21
	DB	49.08T	;    260    49.08
	DB	48.94T	;    261    48.94
	DB	48.81T	;    262    48.81
	DB	48.68T	;    263    48.68
	DB	48.54T	;    264    48.54
	DB	48.41T	;    265    48.41
	DB	48.28T	;    266    48.28
	DB	48.15T	;    267    48.15
	DB	48.02T	;    268    48.02
	DB	47.89T	;    269    47.89
	DB	47.76T	;    270    47.76
	DB	47.63T	;    271    47.63
	DB	47.50T	;    272    47.50
	DB	47.37T	;    273    47.37
	DB	47.24T	;    274    47.24
	DB	47.11T	;    275    47.11
	DB	46.98T	;    276    46.98
	DB	46.86T	;    277    46.86
	DB	46.73T	;    278    46.73
	DB	46.60T	;    279    46.60
	DB	46.48T	;    280    46.48
	DB	46.35T	;    281    46.35
	DB	46.22T	;    282    46.22
	DB	46.10T	;    283    46.10
	DB	45.97T	;    284    45.97
	DB	45.85T	;    285    45.85
	DB	45.72T	;    286    45.72
	DB	45.60T	;    287    45.60
	DB	45.48T	;    288    45.48
	DB	45.36T	;    289    45.36
	DB	45.23T	;    290    45.23
	DB	45.11T	;    291    45.11
	DB	44.99T	;    292    44.99
	DB	44.87T	;    293    44.87
	DB	44.74T	;    294    44.74
	DB	44.62T	;    295    44.62
	DB	44.50T	;    296    44.50
	DB	44.38T	;    297    44.38
	DB	44.26T	;    298    44.26
	DB	44.14T	;    299    44.14
	DB	44.02T	;    300    44.02
	DB	43.91T	;    301    43.91
	DB	43.78T	;    302    43.78
	DB	43.67T	;    303    43.67
	DB	43.55T	;    304    43.55
	DB	43.43T	;    305    43.43
	DB	43.31T	;    306    43.31
	DB	43.19T	;    307    43.19
	DB	43.08T	;    308    43.08
	DB	42.96T	;    309    42.96
	DB	42.84T	;    310    42.84
	DB	42.73T	;    311    42.73
	DB	42.61T	;    312    42.61
	DB	42.49T	;    313    42.49
	DB	42.38T	;    314    42.38
	DB	42.27T	;    315    42.27
	DB	42.15T	;    316    42.15
	DB	42.04T	;    317    42.04
	DB	41.92T	;    318    41.92
	DB	41.81T	;    319    41.81
	DB	41.69T	;    320    41.69
	DB	41.58T	;    321    41.58
	DB	41.47T	;    322    41.47
	DB	41.36T	;    323    41.36
	DB	41.24T	;    324    41.24
	DB	41.13T	;    325    41.13
	DB	41.02T	;    326    41.02
	DB	40.91T	;    327    40.91
	DB	40.79T	;    328    40.79
	DB	40.68T	;    329    40.68
	DB	40.57T	;    330    40.57
	DB	40.46T	;    331    40.46
	DB	40.35T	;    332    40.35
	DB	40.24T	;    333    40.24
	DB	40.13T	;    334    40.13
	DB	40.02T	;    335    40.02
	DB	39.91T	;    336    39.91
	DB	39.80T	;    337    39.80
	DB	39.69T	;    338    39.69
	DB	39.58T	;    339    39.58
	DB	39.48T	;    340    39.48
	DB	39.37T	;    341    39.37
	DB	39.26T	;    342    39.26
	DB	39.15T	;    343    39.15
	DB	39.04T	;    344    39.04
	DB	38.93T	;    345    38.93
	DB	38.83T	;    346    38.83
	DB	38.72T	;    347    38.72
	DB	38.62T	;    348    38.62
	DB	38.51T	;    349    38.51
	DB	38.40T	;    350    38.40
	DB	38.29T	;    351    38.29
	DB	38.19T	;    352    38.19
	DB	38.08T	;    353    38.08
	DB	37.98T	;    354    37.98
	DB	37.87T	;    355    37.87
	DB	37.77T	;    356    37.77
	DB	37.66T	;    357    37.66
	DB	37.56T	;    358    37.56
	DB	37.45T	;    359    37.45
	DB	37.35T	;    360    37.35
	DB	37.24T	;    361    37.24
	DB	37.14T	;    362    37.14
	DB	37.03T	;    363    37.03
	DB	36.93T	;    364    36.93
	DB	36.83T	;    365    36.83
	DB	36.73T	;    366    36.73
	DB	36.62T	;    367    36.62
	DB	36.52T	;    368    36.52
	DB	36.42T	;    369    36.42
	DB	36.32T	;    370    36.32
	DB	36.21T	;    371    36.21
	DB	36.11T	;    372    36.11
	DB	36.01T	;    373    36.01
	DB	35.91T	;    374    35.91
	DB	35.81T	;    375    35.81
	DB	35.71T	;    376    35.71
	DB	35.60T	;    377    35.60
	DB	35.50T	;    378    35.50
	DB	35.40T	;    379    35.40
	DB	35.30T	;    380    35.30
	DB	35.20T	;    381    35.20
	DB	35.10T	;    382    35.10
	DB	35.00T	;    383    35.00
	DB	34.90T	;    384    34.90
	DB	34.80T	;    385    34.80
	DB	34.70T	;    386    34.70
	DB	34.60T	;    387    34.60
	DB	34.50T	;    388    34.50
	DB	34.40T	;    389    34.40
	DB	34.30T	;    390    34.30
	DB	34.20T	;    391    34.20
	DB	34.10T	;    392    34.10
	DB	34.01T	;    393    34.01
	DB	33.91T	;    394    33.91
	DB	33.81T	;    395    33.81
	DB	33.71T	;    396    33.71
	DB	33.61T	;    397    33.61
	DB	33.51T	;    398    33.51
	DB	33.42T	;    399    33.42
	DB	33.32T	;    400    33.32
	DB	33.22T	;    401    33.22
	DB	33.12T	;    402    33.12
	DB	33.03T	;    403    33.03
	DB	32.93T	;    404    32.93
	DB	32.83T	;    405    32.83
	DB	32.73T	;    406    32.73
	DB	32.64T	;    407    32.64
	DB	32.54T	;    408    32.54
	DB	32.44T	;    409    32.44
	DB	32.35T	;    410    32.35
	DB	32.25T	;    411    32.25
	DB	32.16T	;    412    32.16
	DB	32.06T	;    413    32.06
	DB	31.97T	;    414    31.97
	DB	31.87T	;    415    31.87
	DB	31.77T	;    416    31.77
	DB	31.68T	;    417    31.68
	DB	31.58T	;    418    31.58
	DB	31.49T	;    419    31.49
	DB	31.39T	;    420    31.39
	DB	31.30T	;    421    31.30
	DB	31.21T	;    422    31.21
	DB	31.11T	;    423    31.11
	DB	31.02T	;    424    31.02
	DB	30.92T	;    425    30.92
	DB	30.83T	;    426    30.83
	DB	30.73T	;    427    30.73
	DB	30.64T	;    428    30.64
	DB	30.54T	;    429    30.54
	DB	30.45T	;    430    30.45
	DB	30.36T	;    431    30.36
	DB	30.26T	;    432    30.26
	DB	30.17T	;    433    30.17
	DB	30.08T	;    434    30.08
	DB	29.98T	;    435    29.98
	DB	29.89T	;    436    29.89
	DB	29.79T	;    437    29.79
	DB	29.71T	;    438    29.71
	DB	29.61T	;    439    29.61
	DB	29.52T	;    440    29.52
	DB	29.43T	;    441    29.43
	DB	29.33T	;    442    29.33
	DB	29.24T	;    443    29.24
	DB	29.15T	;    444    29.15
	DB	29.06T	;    445    29.06
	DB	28.97T	;    446    28.97
	DB	28.87T	;    447    28.87
	DB	28.78T	;    448    28.78
	DB	28.69T	;    449    28.69
	DB	28.59T	;    450    28.59
	DB	28.51T	;    451    28.51
	DB	28.41T	;    452    28.41
	DB	28.32T	;    453    28.32
	DB	28.23T	;    454    28.23
	DB	28.14T	;    455    28.14
	DB	28.05T	;    456    28.05
	DB	27.96T	;    457    27.96
	DB	27.87T	;    458    27.87
	DB	27.78T	;    459    27.78
	DB	27.68T	;    460    27.68
	DB	27.59T	;    461    27.59
	DB	27.51T	;    462    27.51
	DB	27.41T	;    463    27.41
	DB	27.32T	;    464    27.32
	DB	27.23T	;    465    27.23
	DB	27.14T	;    466    27.14
	DB	27.05T	;    467    27.05
	DB	26.96T	;    468    26.96
	DB	26.87T	;    469    26.87
	DB	26.78T	;    470    26.78
	DB	26.69T	;    471    26.69
	DB	26.60T	;    472    26.60
	DB	26.51T	;    473    26.51
	DB	26.42T	;    474    26.42
	DB	26.33T	;    475    26.33
	DB	26.24T	;    476    26.24
	DB	26.16T	;    477    26.16
	DB	26.06T	;    478    26.06
	DB	25.97T	;    479    25.97
	DB	25.88T	;    480    25.88
	DB	25.79T	;    481    25.79
	DB	25.71T	;    482    25.71
	DB	25.62T	;    483    25.62
	DB	25.53T	;    484    25.53
	DB	25.44T	;    485    25.44
	DB	25.35T	;    486    25.35
	DB	25.26T	;    487    25.26
	DB	25.17T	;    488    25.17
	DB	25.08T	;    489    25.08
	DB	24.99T	;    490    24.99
	DB	24.91T	;    491    24.91
	DB	24.82T	;    492    24.82
	DB	24.73T	;    493    24.73
	DB	24.64T	;    494    24.64
	DB	24.56T	;    495    24.56
	DB	24.47T	;    496    24.47
	DB	24.38T	;    497    24.38
	DB	24.29T	;    498    24.29
	DB	24.20T	;    499    24.20
	DB	24.11T	;    500    24.11
	DB	24.03T	;    501    24.03
	DB	23.94T	;    502    23.94
	DB	23.85T	;    503    23.85
	DB	23.76T	;    504    23.76
	DB	23.67T	;    505    23.67
	DB	23.59T	;    506    23.59
	DB	23.50T	;    507    23.50
	DB	23.41T	;    508    23.41
	DB	23.32T	;    509    23.32
	DB	23.24T	;    510    23.24
	DB	23.15T	;    511    23.15
	DB	23.06T	;    512    23.06
	DB	22.97T	;    513    22.97
	DB	22.89T	;    514    22.89
	DB	22.80T	;    515    22.80
	DB	22.71T	;    516    22.71
	DB	22.63T	;    517    22.63
	DB	22.54T	;    518    22.54
	DB	22.45T	;    519    22.45
	DB	22.37T	;    520    22.37
	DB	22.28T	;    521    22.28
	DB	22.19T	;    522    22.19
	DB	22.11T	;    523    22.11
	DB	22.02T	;    524    22.02
	DB	21.93T	;    525    21.93
	DB	21.84T	;    526    21.84
	DB	21.76T	;    527    21.76
	DB	21.67T	;    528    21.67
	DB	21.58T	;    529    21.58
	DB	21.49T	;    530    21.49
	DB	21.41T	;    531    21.41
	DB	21.32T	;    532    21.32
	DB	21.23T	;    533    21.23
	DB	21.15T	;    534    21.15
	DB	21.06T	;    535    21.06
	DB	20.98T	;    536    20.98
	DB	20.89T	;    537    20.89
	DB	20.81T	;    538    20.81
	DB	20.72T	;    539    20.72
	DB	20.63T	;    540    20.63
	DB	20.54T	;    541    20.54
	DB	20.46T	;    542    20.46
	DB	20.37T	;    543    20.37
	DB	20.28T	;    544    20.28
	DB	20.20T	;    545    20.20
	DB	20.11T	;    546    20.11
	DB	20.03T	;    547    20.03
	DB	19.94T	;    548    19.94
	DB	19.86T	;    549    19.86
	DB	19.77T	;    550    19.77
	DB	19.68T	;    551    19.68
	DB	19.59T	;    552    19.59
	DB	19.51T	;    553    19.51
	DB	19.42T	;    554    19.42
	DB	19.34T	;    555    19.34
	DB	19.25T	;    556    19.25
	DB	19.17T	;    557    19.17
	DB	19.08T	;    558    19.08
	DB	18.99T	;    559    18.99
	DB	18.91T	;    560    18.91
	DB	18.82T	;    561    18.82
	DB	18.73T	;    562    18.73
	DB	18.65T	;    563    18.65
	DB	18.57T	;    564    18.57
	DB	18.48T	;    565    18.48
	DB	18.39T	;    566    18.39
	DB	18.31T	;    567    18.31
	DB	18.22T	;    568    18.22
	DB	18.13T	;    569    18.13
	DB	18.05T	;    570    18.05
	DB	17.96T	;    571    17.96
	DB	17.88T	;    572    17.88
	DB	17.79T	;    573    17.79
	DB	17.71T	;    574    17.71
	DB	17.62T	;    575    17.62
	DB	17.53T	;    576    17.53
	DB	17.45T	;    577    17.45
	DB	17.36T	;    578    17.36
	DB	17.28T	;    579    17.28
	DB	17.19T	;    580    17.19
	DB	17.11T	;    581    17.11
	DB	17.02T	;    582    17.02
	DB	16.93T	;    583    16.93
	DB	16.84T	;    584    16.84
	DB	16.76T	;    585    16.76
	DB	16.68T	;    586    16.68
	DB	16.59T	;    587    16.59
	DB	16.51T	;    588    16.51
	DB	16.42T	;    589    16.42
	DB	16.33T	;    590    16.33
	DB	16.24T	;    591    16.24
	DB	16.16T	;    592    16.16
	DB	16.07T	;    593    16.07
	DB	15.99T	;    594    15.99
	DB	15.90T	;    595    15.90
	DB	15.82T	;    596    15.82
	DB	15.73T	;    597    15.73
	DB	15.64T	;    598    15.64
	DB	15.56T	;    599    15.56
	DB	15.47T	;    600    15.47
	DB	15.39T	;    601    15.39
	DB	15.30T	;    602    15.30
	DB	15.22T	;    603    15.22
	DB	15.13T	;    604    15.13
	DB	15.04T	;    605    15.04
	DB	14.96T	;    606    14.96
	DB	14.87T	;    607    14.87
	DB	14.78T	;    608    14.78
	DB	14.70T	;    609    14.70
	DB	14.61T	;    610    14.61
	DB	14.53T	;    611    14.53
	DB	14.44T	;    612    14.44
	DB	14.36T	;    613    14.36
	DB	14.27T	;    614    14.27
	DB	14.18T	;    615    14.18
	DB	14.09T	;    616    14.09
	DB	14.01T	;    617    14.01
	DB	13.92T	;    618    13.92
	DB	13.84T	;    619    13.84
	DB	13.75T	;    620    13.75
	DB	13.66T	;    621    13.66
	DB	13.58T	;    622    13.58
	DB	13.49T	;    623    13.49
	DB	13.41T	;    624    13.41
	DB	13.32T	;    625    13.32
	DB	13.23T	;    626    13.23
	DB	13.14T	;    627    13.14
	DB	13.06T	;    628    13.06
	DB	12.97T	;    629    12.97
	DB	12.88T	;    630    12.88
	DB	12.80T	;    631    12.80
	DB	12.71T	;    632    12.71
	DB	12.62T	;    633    12.62
	DB	12.54T	;    634    12.54
	DB	12.45T	;    635    12.45
	DB	12.36T	;    636    12.36
	DB	12.28T	;    637    12.28
	DB	12.19T	;    638    12.19
	DB	12.10T	;    639    12.10
	DB	12.02T	;    640    12.02
	DB	11.93T	;    641    11.93
	DB	11.84T	;    642    11.84
	DB	11.76T	;    643    11.76
	DB	11.67T	;    644    11.67
	DB	11.58T	;    645    11.58
	DB	11.49T	;    646    11.49
	DB	11.41T	;    647    11.41
	DB	11.32T	;    648    11.32
	DB	11.23T	;    649    11.23
	DB	11.14T	;    650    11.14
	DB	11.06T	;    651    11.06
	DB	10.97T	;    652    10.97
	DB	10.88T	;    653    10.88
	DB	10.79T	;    654    10.79
	DB	10.71T	;    655    10.71
	DB	10.62T	;    656    10.62
	DB	10.53T	;    657    10.53
	DB	10.44T	;    658    10.44
	DB	10.35T	;    659    10.35
	DB	10.26T	;    660    10.26
	DB	10.17T	;    661    10.17
	DB	10.09T	;    662    10.09
	DB	10.00T	;    663    10.00
	DB	9.91T	;    664    9.91
	DB	9.82T	;    665    9.82
	DB	9.73T	;    666    9.73
	DB	9.64T	;    667    9.64
	DB	9.56T	;    668    9.56
	DB	9.47T	;    669    9.47
	DB	9.38T	;    670    9.38
	DB	9.29T	;    671    9.29
	DB	9.20T	;    672    9.20
	DB	9.11T	;    673    9.11
	DB	9.02T	;    674    9.02
	DB	8.93T	;    675    8.93
	DB	8.84T	;    676    8.84
	DB	8.76T	;    677    8.76
	DB	8.67T	;    678    8.67
	DB	8.58T	;    679    8.58
	DB	8.49T	;    680    8.49
	DB	8.39T	;    681    8.39
	DB	8.31T	;    682    8.31
	DB	8.22T	;    683    8.22
	DB	8.13T	;    684    8.13
	DB	8.04T	;    685    8.04
	DB	7.95T	;    686    7.95
	DB	7.86T	;    687    7.86
	DB	7.77T	;    688    7.77
	DB	7.68T	;    689    7.68
	DB	7.59T	;    690    7.59
	DB	7.49T	;    691    7.49
	DB	7.41T	;    692    7.41
	DB	7.32T	;    693    7.32
	DB	7.23T	;    694    7.23
	DB	7.13T	;    695    7.13
	DB	7.04T	;    696    7.04
	DB	6.95T	;    697    6.95
	DB	6.86T	;    698    6.86
	DB	6.77T	;    699    6.77
	DB	6.68T	;    700    6.68
	DB	6.59T	;    701    6.59
	DB	6.49T	;    702    6.49
	DB	6.41T	;    703    6.41
	DB	6.31T	;    704    6.31
	DB	6.22T	;    705    6.22
	DB	6.13T	;    706    6.13
	DB	6.04T	;    707    6.04
	DB	5.94T	;    708    5.94
	DB	5.86T	;    709    5.86
	DB	5.76T	;    710    5.76
	DB	5.67T	;    711    5.67
	DB	5.58T	;    712    5.58
	DB	5.48T	;    713    5.48
	DB	5.39T	;    714    5.39
	DB	5.30T	;    715    5.30
	DB	5.21T	;    716    5.21
	DB	5.11T	;    717    5.11
	DB	5.02T	;    718    5.02
	DB	4.92T	;    719    4.92
	DB	4.83T	;    720    4.83
	DB	4.74T	;    721    4.74
	DB	4.64T	;    722    4.64
	DB	4.55T	;    723    4.55
	DB	4.46T	;    724    4.46
	DB	4.36T	;    725    4.36
	DB	4.27T	;    726    4.27
	DB	4.17T	;    727    4.17
	DB	4.08T	;    728    4.08
	DB	3.98T	;    729    3.98
	DB	3.89T	;    730    3.89
	DB	3.79T	;    731    3.79
	DB	3.70T	;    732    3.70
	DB	3.61T	;    733    3.61
	DB	3.51T	;    734    3.51
	DB	3.41T	;    735    3.41
	DB	3.32T	;    736    3.32
	DB	3.22T	;    737    3.22
	DB	3.13T	;    738    3.13
	DB	3.03T	;    739    3.03
	DB	2.93T	;    740    2.93
	DB	2.84T	;    741    2.84
	DB	2.74T	;    742    2.74
	DB	2.64T	;    743    2.64
	DB	2.55T	;    744    2.55
	DB	2.45T	;    745    2.45
	DB	2.36T	;    746    2.36
	DB	2.26T	;    747    2.26
	DB	2.16T	;    748    2.16
	DB	2.06T	;    749    2.06
	DB	1.96T	;    750    1.96
	DB	1.87T	;    751    1.87
	DB	1.77T	;    752    1.77
	DB	1.67T	;    753    1.67
	DB	1.57T	;    754    1.57
	DB	1.47T	;    755    1.47
	DB	1.37T	;    756    1.37
	DB	1.27T	;    757    1.27
	DB	1.18T	;    758    1.18
	DB	1.08T	;    759    1.08
	DB	0.98T	;    760    0.98
	DB	0.88T	;    761    0.88
	DB	0.78T	;    762    0.78
	DB	0.68T	;    763    0.68
	DB	0.58T	;    764    0.58
	DB	0.48T	;    765    0.48
	DB	0.38T	;    766    0.38
	DB	0.27T	;    767    0.27
	DB	0.17T	;    768    0.17
	DB	0.07T	;    769    0.07
	DB	-0.03T	;    770    -0.03
	DB	-0.13T	;    771    -0.13
	DB	-0.23T	;    772    -0.23
	DB	-0.33T	;    773    -0.33
	DB	-0.44T	;    774    -0.44
	DB	-0.54T	;    775    -0.54
	DB	-0.64T	;    776    -0.64
	DB	-0.74T	;    777    -0.74
	DB	-0.85T	;    778    -0.85
	DB	-0.95T	;    779    -0.95
	DB	-1.06T	;    780    -1.06
	DB	-1.16T	;    781    -1.16
	DB	-1.26T	;    782    -1.26
	DB	-1.37T	;    783    -1.37
	DB	-1.47T	;    784    -1.47
	DB	-1.58T	;    785    -1.58
	DB	-1.68T	;    786    -1.68
	DB	-1.79T	;    787    -1.79
	DB	-1.89T	;    788    -1.89
	DB	-2.00T	;    789    -2.00
	DB	-2.11T	;    790    -2.11
	DB	-2.21T	;    791    -2.21
	DB	-2.32T	;    792    -2.32
	DB	-2.42T	;    793    -2.42
	DB	-2.53T	;    794    -2.53
	DB	-2.64T	;    795    -2.64
	DB	-2.74T	;    796    -2.74
	DB	-2.85T	;    797    -2.85
	DB	-2.96T	;    798    -2.96
	DB	-3.07T	;    799    -3.07
	DB	-3.18T	;    800    -3.18
	DB	-3.28T	;    801    -3.28
	DB	-3.39T	;    802    -3.39
	DB	-3.51T	;    803    -3.51
	DB	-3.61T	;    804    -3.61
	DB	-3.72T	;    805    -3.72
	DB	-3.83T	;    806    -3.83
	DB	-3.94T	;    807    -3.94
	DB	-4.06T	;    808    -4.06
	DB	-4.17T	;    809    -4.17
	DB	-4.28T	;    810    -4.28
	DB	-4.39T	;    811    -4.39
	DB	-4.50T	;    812    -4.50
	DB	-4.61T	;    813    -4.61
	DB	-4.73T	;    814    -4.73
	DB	-4.84T	;    815    -4.84
	DB	-4.95T	;    816    -4.95
	DB	-5.07T	;    817    -5.07
	DB	-5.18T	;    818    -5.18
	DB	-5.29T	;    819    -5.29
	DB	-5.41T	;    820    -5.41
	DB	-5.52T	;    821    -5.52
	DB	-5.64T	;    822    -5.64
	DB	-5.76T	;    823    -5.76
	DB	-5.87T	;    824    -5.87
	DB	-5.98T	;    825    -5.98
	DB	-6.10T	;    826    -6.10
	DB	-6.22T	;    827    -6.22
	DB	-6.34T	;    828    -6.34
	DB	-6.46T	;    829    -6.46
	DB	-6.57T	;    830    -6.57
	DB	-6.69T	;    831    -6.69
	DB	-6.81T	;    832    -6.81
	DB	-6.93T	;    833    -6.93
	DB	-7.05T	;    834    -7.05
	DB	-7.17T	;    835    -7.17
	DB	-7.29T	;    836    -7.29
	DB	-7.41T	;    837    -7.41
	DB	-7.53T	;    838    -7.53
	DB	-7.66T	;    839    -7.66
	DB	-7.78T	;    840    -7.78
	DB	-7.90T	;    841    -7.90
	DB	-8.02T	;    842    -8.02
	DB	-8.14T	;    843    -8.14
	DB	-8.27T	;    844    -8.27
	DB	-8.39T	;    845    -8.39
	DB	-8.52T	;    846    -8.52
	DB	-8.64T	;    847    -8.64
	DB	-8.77T	;    848    -8.77
	DB	-8.89T	;    849    -8.89
	DB	-9.02T	;    850    -9.02
	DB	-9.15T	;    851    -9.15
	DB	-9.28T	;    852    -9.28
	DB	-9.41T	;    853    -9.41
	DB	-9.53T	;    854    -9.53
	DB	-9.66T	;    855    -9.66
	DB	-9.79T	;    856    -9.79
	DB	-9.92T	;    857    -9.92
	DB	-10.05T	;    858    -10.05
	DB	-10.18T	;    859    -10.18
	DB	-10.32T	;    860    -10.32
	DB	-10.44T	;    861    -10.44
	DB	-10.58T	;    862    -10.58
	DB	-10.71T	;    863    -10.71
	DB	-10.84T	;    864    -10.84
	DB	-10.98T	;    865    -10.98
	DB	-11.12T	;    866    -11.12
	DB	-11.25T	;    867    -11.25
	DB	-11.39T	;    868    -11.39
	DB	-11.52T	;    869    -11.52
	DB	-11.66T	;    870    -11.66
	DB	-11.80T	;    871    -11.80
	DB	-11.94T	;    872    -11.94
	DB	-12.08T	;    873    -12.08
	DB	-12.22T	;    874    -12.22
	DB	-12.36T	;    875    -12.36
	DB	-12.50T	;    876    -12.50
	DB	-12.64T	;    877    -12.64
	DB	-12.78T	;    878    -12.78
	DB	-12.93T	;    879    -12.93
	DB	-13.07T	;    880    -13.07
	DB	-13.22T	;    881    -13.22
	DB	-13.36T	;    882    -13.36
	DB	-13.51T	;    883    -13.51
	DB	-13.66T	;    884    -13.66
	DB	-13.80T	;    885    -13.80
	DB	-13.95T	;    886    -13.95
	DB	-14.10T	;    887    -14.10
	DB	-14.25T	;    888    -14.25
	DB	-14.40T	;    889    -14.40
	DB	-14.55T	;    890    -14.55
	DB	-14.70T	;    891    -14.70
	DB	-14.86T	;    892    -14.86
	DB	-15.01T	;    893    -15.01
	DB	-15.17T	;    894    -15.17
	DB	-15.32T	;    895    -15.32
	DB	-15.48T	;    896    -15.48
	DB	-15.63T	;    897    -15.63
	DB	-15.79T	;    898    -15.79
	DB	-15.95T	;    899    -15.95
	DB	-16.11T	;    900    -16.11
	DB	-16.27T	;    901    -16.27
	DB	-16.43T	;    902    -16.43
	DB	-16.60T	;    903    -16.60
	DB	-16.76T	;    904    -16.76
	DB	-16.93T	;    905    -16.93
	DB	-17.09T	;    906    -17.09
	DB	-17.26T	;    907    -17.26
	DB	-17.43T	;    908    -17.43
	DB	-17.60T	;    909    -17.60
	DB	-17.77T	;    910    -17.77
	DB	-17.94T	;    911    -17.94
	DB	-18.11T	;    912    -18.11
	DB	-18.29T	;    913    -18.29
	DB	-18.46T	;    914    -18.46
	DB	-18.64T	;    915    -18.64
	DB	-18.82T	;    916    -18.82
	DB	-18.99T	;    917    -18.99
	DB	-19.18T	;    918    -19.18
	DB	-19.36T	;    919    -19.36
	DB	-19.54T	;    920    -19.54
	DB	-19.72T	;    921    -19.72
	DB	-19.91T	;    922    -19.91
	DB	-20.09T	;    923    -20.09
	DB	-20.28T	;    924    -20.28
	DB	-20.47T	;    925    -20.47
	DB	-20.67T	;    926    -20.67
	DB	-20.86T	;    927    -20.86
	DB	-21.05T	;    928    -21.05
	DB	-21.25T	;    929    -21.25
	DB	-21.44T	;    930    -21.44
	DB	-21.64T	;    931    -21.64
	DB	-21.84T	;    932    -21.84
	DB	-22.05T	;    933    -22.05
	DB	-22.26T	;    934    -22.26
	DB	-22.46T	;    935    -22.46
	DB	-22.67T	;    936    -22.67
	DB	-22.88T	;    937    -22.88
	DB	-23.09T	;    938    -23.09
	DB	-23.30T	;    939    -23.30
	DB	-23.52T	;    940    -23.52
	DB	-23.74T	;    941    -23.74
	DB	-23.96T	;    942    -23.96
	DB	-24.18T	;    943    -24.18
	DB	-24.40T	;    944    -24.40
	DB	-24.63T	;    945    -24.63
	DB	-24.86T	;    946    -24.86
	DB	-25.09T	;    947    -25.09
	DB	-25.32T	;    948    -25.32
	DB	-25.56T	;    949    -25.56
	DB	-25.80T	;    950    -25.80
	DB	-26.04T	;    951    -26.04
	DB	-26.28T	;    952    -26.28
	DB	-26.53T	;    953    -26.53
	DB	-26.78T	;    954    -26.78
	DB	-27.03T	;    955    -27.03
	DB	-27.29T	;    956    -27.29
	DB	-27.55T	;    957    -27.55
	DB	-27.81T	;    958    -27.81
	DB	-28.07T	;    959    -28.07
	DB	-28.34T	;    960    -28.34
	DB	-28.62T	;    961    -28.62
	DB	-28.89T	;    962    -28.89
	DB	-29.17T	;    963    -29.17
	DB	-29.46T	;    964    -29.46
	DB	-29.74T	;    965    -29.74
	DB	-30.03T	;    966    -30.03
	DB	-30.33T	;    967    -30.33
	DB	-30.63T	;    968    -30.63
	DB	-30.93T	;    969    -30.93
	DB	-31.24T	;    970    -31.24
	DB	-31.56T	;    971    -31.56
	DB	-31.88T	;    972    -31.88
	DB	-32.20T	;    973    -32.20
	DB	-32.53T	;    974    -32.53
	DB	-32.87T	;    975    -32.87
	DB	-33.21T	;    976    -33.21
	DB	-33.56T	;    977    -33.56
	DB	-33.91T	;    978    -33.91
	DB	-34.27T	;    979    -34.27
	DB	-34.64T	;    980    -34.64
	DB	-35.02T	;    981    -35.02
	DB	-35.39T	;    982    -35.39
	DB	-35.79T	;    983    -35.79
	DB	-36.19T	;    984    -36.19
	DB	-36.59T	;    985    -36.59
	DB	-37.01T	;    986    -37.01
	DB	-37.44T	;    987    -37.44
	DB	-37.88T	;    988    -37.88
	DB	-38.32T	;    989    -38.32
	DB	-38.78T	;    990    -38.78
	DB	-39.26T	;    991    -39.26
	DB	-39.74T	;    992    -39.74
	DB	80.00T	;    993    80.00
	DB	80.00T	;    994    80.00
	DB	80.00T	;    995    80.00
	DB	80.00T	;    996    80.00
	DB	80.00T	;    997    80.00
	DB	80.00T	;    998    80.00
	DB	80.00T	;    999    80.00
	DB	80.00T	;    1000    80.00
	DB	80.00T	;    1001    80.00
	DB	80.00T	;    1002    80.00
	DB	80.00T	;    1003    80.00
	DB	80.00T	;    1004    80.00
	DB	80.00T	;    1005    80.00
	DB	80.00T	;    1006    80.00
	DB	80.00T	;    1007    80.00
	DB	80.00T	;    1008    80.00
	DB	80.00T	;    1009    80.00
	DB	80.00T	;    1010    80.00
	DB	80.00T	;    1011    80.00
	DB	80.00T	;    1012    80.00
	DB	80.00T	;    1013    80.00
	DB	80.00T	;    1014    80.00
	DB	80.00T	;    1015    80.00
	DB	80.00T	;    1016    80.00
	DB	80.00T	;    1017    80.00
	DB	80.00T	;    1018    80.00
	DB	80.00T	;    1019    80.00
	DB	80.00T	;    1020    80.00
	DB	80.00T	;    1021    80.00
	DB	80.00T	;    1022    80.00
	DB	80.00T	;    1023    Sensor Failure - use 80 degC as default

