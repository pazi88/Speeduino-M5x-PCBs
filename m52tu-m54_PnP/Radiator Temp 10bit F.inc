; Generated using EasyTherm4.exe
;
; M54/M52tu Radiator Temp Sensor
;
; File generated for use with stock 2490 ohm resistor
;
;
; Input Data     Temp. degC     Resistance
;		   -48		   141931
;		    20		    2826
;		   140		     115
;

THERMFACTOR:
            ;    ADC  Temp. degF
	DB	180T	;    0    Sensor Failure - use 180 degF as default
	DB	180T	;    1    180
	DB	180T	;    2    180
	DB	180T	;    3    180
	DB	180T	;    4    180
	DB	180T	;    5    180
	DB	180T	;    6    180
	DB	180T	;    7    180
	DB	180T	;    8    180
	DB	180T	;    9    180
	DB	346.84T	;    10    346.84
	DB	338.49T	;    11    338.49
	DB	331.01T	;    12    331.01
	DB	324.23T	;    13    324.23
	DB	318.06T	;    14    318.06
	DB	312.39T	;    15    312.39
	DB	307.15T	;    16    307.15
	DB	302.28T	;    17    302.28
	DB	297.75T	;    18    297.75
	DB	293.5T	;    19    293.5
	DB	289.51T	;    20    289.51
	DB	285.75T	;    21    285.75
	DB	282.19T	;    22    282.19
	DB	278.82T	;    23    278.82
	DB	275.61T	;    24    275.61
	DB	272.56T	;    25    272.56
	DB	269.65T	;    26    269.65
	DB	266.86T	;    27    266.86
	DB	264.2T	;    28    264.2
	DB	261.64T	;    29    261.64
	DB	259.18T	;    30    259.18
	DB	256.82T	;    31    256.82
	DB	254.54T	;    32    254.54
	DB	252.35T	;    33    252.35
	DB	250.23T	;    34    250.23
	DB	248.18T	;    35    248.18
	DB	246.2T	;    36    246.2
	DB	244.27T	;    37    244.27
	DB	242.41T	;    38    242.41
	DB	240.61T	;    39    240.61
	DB	238.85T	;    40    238.85
	DB	237.15T	;    41    237.15
	DB	235.49T	;    42    235.49
	DB	233.88T	;    43    233.88
	DB	232.31T	;    44    232.31
	DB	230.78T	;    45    230.78
	DB	229.29T	;    46    229.29
	DB	227.84T	;    47    227.84
	DB	226.42T	;    48    226.42
	DB	225.03T	;    49    225.03
	DB	223.68T	;    50    223.68
	DB	222.35T	;    51    222.35
	DB	221.06T	;    52    221.06
	DB	219.79T	;    53    219.79
	DB	218.55T	;    54    218.55
	DB	217.33T	;    55    217.33
	DB	216.14T	;    56    216.14
	DB	214.98T	;    57    214.98
	DB	213.83T	;    58    213.83
	DB	212.71T	;    59    212.71
	DB	211.61T	;    60    211.61
	DB	210.53T	;    61    210.53
	DB	209.47T	;    62    209.47
	DB	208.43T	;    63    208.43
	DB	207.4T	;    64    207.4
	DB	206.4T	;    65    206.4
	DB	205.41T	;    66    205.41
	DB	204.44T	;    67    204.44
	DB	203.48T	;    68    203.48
	DB	202.54T	;    69    202.54
	DB	201.61T	;    70    201.61
	DB	200.7T	;    71    200.7
	DB	199.81T	;    72    199.81
	DB	198.92T	;    73    198.92
	DB	198.05T	;    74    198.05
	DB	197.2T	;    75    197.2
	DB	196.35T	;    76    196.35
	DB	195.52T	;    77    195.52
	DB	194.7T	;    78    194.7
	DB	193.89T	;    79    193.89
	DB	193.09T	;    80    193.09
	DB	192.31T	;    81    192.31
	DB	191.53T	;    82    191.53
	DB	190.76T	;    83    190.76
	DB	190.01T	;    84    190.01
	DB	189.26T	;    85    189.26
	DB	188.53T	;    86    188.53
	DB	187.8T	;    87    187.8
	DB	187.08T	;    88    187.08
	DB	186.37T	;    89    186.37
	DB	185.67T	;    90    185.67
	DB	184.98T	;    91    184.98
	DB	184.29T	;    92    184.29
	DB	183.62T	;    93    183.62
	DB	182.95T	;    94    182.95
	DB	182.29T	;    95    182.29
	DB	181.63T	;    96    181.63
	DB	180.99T	;    97    180.99
	DB	180.35T	;    98    180.35
	DB	179.72T	;    99    179.72
	DB	179.09T	;    100    179.09
	DB	178.47T	;    101    178.47
	DB	177.86T	;    102    177.86
	DB	177.26T	;    103    177.26
	DB	176.66T	;    104    176.66
	DB	176.07T	;    105    176.07
	DB	175.48T	;    106    175.48
	DB	174.9T	;    107    174.9
	DB	174.32T	;    108    174.32
	DB	173.75T	;    109    173.75
	DB	173.19T	;    110    173.19
	DB	172.63T	;    111    172.63
	DB	172.08T	;    112    172.08
	DB	171.53T	;    113    171.53
	DB	170.98T	;    114    170.98
	DB	170.45T	;    115    170.45
	DB	169.91T	;    116    169.91
	DB	169.38T	;    117    169.38
	DB	168.86T	;    118    168.86
	DB	168.34T	;    119    168.34
	DB	167.83T	;    120    167.83
	DB	167.32T	;    121    167.32
	DB	166.81T	;    122    166.81
	DB	166.31T	;    123    166.31
	DB	165.81T	;    124    165.81
	DB	165.32T	;    125    165.32
	DB	164.83T	;    126    164.83
	DB	164.35T	;    127    164.35
	DB	163.87T	;    128    163.87
	DB	163.39T	;    129    163.39
	DB	162.92T	;    130    162.92
	DB	162.45T	;    131    162.45
	DB	161.98T	;    132    161.98
	DB	161.52T	;    133    161.52
	DB	161.06T	;    134    161.06
	DB	160.61T	;    135    160.61
	DB	160.16T	;    136    160.16
	DB	159.71T	;    137    159.71
	DB	159.26T	;    138    159.26
	DB	158.82T	;    139    158.82
	DB	158.38T	;    140    158.38
	DB	157.95T	;    141    157.95
	DB	157.52T	;    142    157.52
	DB	157.09T	;    143    157.09
	DB	156.66T	;    144    156.66
	DB	156.24T	;    145    156.24
	DB	155.82T	;    146    155.82
	DB	155.4T	;    147    155.4
	DB	154.99T	;    148    154.99
	DB	154.58T	;    149    154.58
	DB	154.17T	;    150    154.17
	DB	153.77T	;    151    153.77
	DB	153.36T	;    152    153.36
	DB	152.96T	;    153    152.96
	DB	152.57T	;    154    152.57
	DB	152.17T	;    155    152.17
	DB	151.78T	;    156    151.78
	DB	151.39T	;    157    151.39
	DB	151T	;    158    151
	DB	150.62T	;    159    150.62
	DB	150.23T	;    160    150.23
	DB	149.85T	;    161    149.85
	DB	149.48T	;    162    149.48
	DB	149.1T	;    163    149.1
	DB	148.73T	;    164    148.73
	DB	148.36T	;    165    148.36
	DB	147.99T	;    166    147.99
	DB	147.62T	;    167    147.62
	DB	147.26T	;    168    147.26
	DB	146.9T	;    169    146.9
	DB	146.54T	;    170    146.54
	DB	146.18T	;    171    146.18
	DB	145.82T	;    172    145.82
	DB	145.47T	;    173    145.47
	DB	145.12T	;    174    145.12
	DB	144.77T	;    175    144.77
	DB	144.42T	;    176    144.42
	DB	144.07T	;    177    144.07
	DB	143.73T	;    178    143.73
	DB	143.39T	;    179    143.39
	DB	143.05T	;    180    143.05
	DB	142.71T	;    181    142.71
	DB	142.37T	;    182    142.37
	DB	142.04T	;    183    142.04
	DB	141.7T	;    184    141.7
	DB	141.37T	;    185    141.37
	DB	141.04T	;    186    141.04
	DB	140.72T	;    187    140.72
	DB	140.39T	;    188    140.39
	DB	140.07T	;    189    140.07
	DB	139.74T	;    190    139.74
	DB	139.42T	;    191    139.42
	DB	139.1T	;    192    139.1
	DB	138.78T	;    193    138.78
	DB	138.47T	;    194    138.47
	DB	138.15T	;    195    138.15
	DB	137.84T	;    196    137.84
	DB	137.53T	;    197    137.53
	DB	137.22T	;    198    137.22
	DB	136.91T	;    199    136.91
	DB	136.6T	;    200    136.6
	DB	136.29T	;    201    136.29
	DB	135.99T	;    202    135.99
	DB	135.69T	;    203    135.69
	DB	135.39T	;    204    135.39
	DB	135.09T	;    205    135.09
	DB	134.79T	;    206    134.79
	DB	134.49T	;    207    134.49
	DB	134.19T	;    208    134.19
	DB	133.9T	;    209    133.9
	DB	133.6T	;    210    133.6
	DB	133.31T	;    211    133.31
	DB	133.02T	;    212    133.02
	DB	132.73T	;    213    132.73
	DB	132.44T	;    214    132.44
	DB	132.16T	;    215    132.16
	DB	131.87T	;    216    131.87
	DB	131.59T	;    217    131.59
	DB	131.3T	;    218    131.3
	DB	131.02T	;    219    131.02
	DB	130.74T	;    220    130.74
	DB	130.46T	;    221    130.46
	DB	130.18T	;    222    130.18
	DB	129.9T	;    223    129.9
	DB	129.63T	;    224    129.63
	DB	129.35T	;    225    129.35
	DB	129.08T	;    226    129.08
	DB	128.8T	;    227    128.8
	DB	128.53T	;    228    128.53
	DB	128.26T	;    229    128.26
	DB	127.99T	;    230    127.99
	DB	127.72T	;    231    127.72
	DB	127.45T	;    232    127.45
	DB	127.19T	;    233    127.19
	DB	126.92T	;    234    126.92
	DB	126.66T	;    235    126.66
	DB	126.39T	;    236    126.39
	DB	126.13T	;    237    126.13
	DB	125.87T	;    238    125.87
	DB	125.61T	;    239    125.61
	DB	125.35T	;    240    125.35
	DB	125.09T	;    241    125.09
	DB	124.83T	;    242    124.83
	DB	124.57T	;    243    124.57
	DB	124.32T	;    244    124.32
	DB	124.06T	;    245    124.06
	DB	123.81T	;    246    123.81
	DB	123.55T	;    247    123.55
	DB	123.3T	;    248    123.3
	DB	123.05T	;    249    123.05
	DB	122.8T	;    250    122.8
	DB	122.55T	;    251    122.55
	DB	122.3T	;    252    122.3
	DB	122.05T	;    253    122.05
	DB	121.81T	;    254    121.81
	DB	121.56T	;    255    121.56
	DB	121.31T	;    256    121.31
	DB	121.07T	;    257    121.07
	DB	120.83T	;    258    120.83
	DB	120.58T	;    259    120.58
	DB	120.34T	;    260    120.34
	DB	120.1T	;    261    120.1
	DB	119.86T	;    262    119.86
	DB	119.62T	;    263    119.62
	DB	119.38T	;    264    119.38
	DB	119.14T	;    265    119.14
	DB	118.9T	;    266    118.9
	DB	118.67T	;    267    118.67
	DB	118.43T	;    268    118.43
	DB	118.2T	;    269    118.2
	DB	117.96T	;    270    117.96
	DB	117.73T	;    271    117.73
	DB	117.5T	;    272    117.5
	DB	117.26T	;    273    117.26
	DB	117.03T	;    274    117.03
	DB	116.8T	;    275    116.8
	DB	116.57T	;    276    116.57
	DB	116.34T	;    277    116.34
	DB	116.11T	;    278    116.11
	DB	115.88T	;    279    115.88
	DB	115.66T	;    280    115.66
	DB	115.43T	;    281    115.43
	DB	115.2T	;    282    115.2
	DB	114.98T	;    283    114.98
	DB	114.75T	;    284    114.75
	DB	114.53T	;    285    114.53
	DB	114.3T	;    286    114.3
	DB	114.08T	;    287    114.08
	DB	113.86T	;    288    113.86
	DB	113.64T	;    289    113.64
	DB	113.42T	;    290    113.42
	DB	113.2T	;    291    113.2
	DB	112.98T	;    292    112.98
	DB	112.76T	;    293    112.76
	DB	112.54T	;    294    112.54
	DB	112.32T	;    295    112.32
	DB	112.1T	;    296    112.1
	DB	111.89T	;    297    111.89
	DB	111.67T	;    298    111.67
	DB	111.45T	;    299    111.45
	DB	111.24T	;    300    111.24
	DB	111.03T	;    301    111.03
	DB	110.81T	;    302    110.81
	DB	110.6T	;    303    110.6
	DB	110.39T	;    304    110.39
	DB	110.17T	;    305    110.17
	DB	109.96T	;    306    109.96
	DB	109.75T	;    307    109.75
	DB	109.54T	;    308    109.54
	DB	109.33T	;    309    109.33
	DB	109.12T	;    310    109.12
	DB	108.91T	;    311    108.91
	DB	108.7T	;    312    108.7
	DB	108.49T	;    313    108.49
	DB	108.29T	;    314    108.29
	DB	108.08T	;    315    108.08
	DB	107.87T	;    316    107.87
	DB	107.67T	;    317    107.67
	DB	107.46T	;    318    107.46
	DB	107.26T	;    319    107.26
	DB	107.05T	;    320    107.05
	DB	106.85T	;    321    106.85
	DB	106.64T	;    322    106.64
	DB	106.44T	;    323    106.44
	DB	106.24T	;    324    106.24
	DB	106.04T	;    325    106.04
	DB	105.83T	;    326    105.83
	DB	105.63T	;    327    105.63
	DB	105.43T	;    328    105.43
	DB	105.23T	;    329    105.23
	DB	105.03T	;    330    105.03
	DB	104.83T	;    331    104.83
	DB	104.63T	;    332    104.63
	DB	104.43T	;    333    104.43
	DB	104.24T	;    334    104.24
	DB	104.04T	;    335    104.04
	DB	103.84T	;    336    103.84
	DB	103.64T	;    337    103.64
	DB	103.45T	;    338    103.45
	DB	103.25T	;    339    103.25
	DB	103.06T	;    340    103.06
	DB	102.86T	;    341    102.86
	DB	102.67T	;    342    102.67
	DB	102.47T	;    343    102.47
	DB	102.28T	;    344    102.28
	DB	102.08T	;    345    102.08
	DB	101.89T	;    346    101.89
	DB	101.7T	;    347    101.7
	DB	101.51T	;    348    101.51
	DB	101.31T	;    349    101.31
	DB	101.12T	;    350    101.12
	DB	100.93T	;    351    100.93
	DB	100.74T	;    352    100.74
	DB	100.55T	;    353    100.55
	DB	100.36T	;    354    100.36
	DB	100.17T	;    355    100.17
	DB	99.98T	;    356    99.98
	DB	99.79T	;    357    99.79
	DB	99.6T	;    358    99.6
	DB	99.41T	;    359    99.41
	DB	99.23T	;    360    99.23
	DB	99.04T	;    361    99.04
	DB	98.85T	;    362    98.85
	DB	98.66T	;    363    98.66
	DB	98.48T	;    364    98.48
	DB	98.29T	;    365    98.29
	DB	98.11T	;    366    98.11
	DB	97.92T	;    367    97.92
	DB	97.73T	;    368    97.73
	DB	97.55T	;    369    97.55
	DB	97.37T	;    370    97.37
	DB	97.18T	;    371    97.18
	DB	97T	;    372    97
	DB	96.81T	;    373    96.81
	DB	96.63T	;    374    96.63
	DB	96.45T	;    375    96.45
	DB	96.27T	;    376    96.27
	DB	96.08T	;    377    96.08
	DB	95.9T	;    378    95.9
	DB	95.72T	;    379    95.72
	DB	95.54T	;    380    95.54
	DB	95.36T	;    381    95.36
	DB	95.18T	;    382    95.18
	DB	95T	;    383    95
	DB	94.82T	;    384    94.82
	DB	94.64T	;    385    94.64
	DB	94.46T	;    386    94.46
	DB	94.28T	;    387    94.28
	DB	94.1T	;    388    94.1
	DB	93.92T	;    389    93.92
	DB	93.74T	;    390    93.74
	DB	93.56T	;    391    93.56
	DB	93.38T	;    392    93.38
	DB	93.21T	;    393    93.21
	DB	93.03T	;    394    93.03
	DB	92.85T	;    395    92.85
	DB	92.68T	;    396    92.68
	DB	92.5T	;    397    92.5
	DB	92.32T	;    398    92.32
	DB	92.15T	;    399    92.15
	DB	91.97T	;    400    91.97
	DB	91.8T	;    401    91.8
	DB	91.62T	;    402    91.62
	DB	91.45T	;    403    91.45
	DB	91.27T	;    404    91.27
	DB	91.1T	;    405    91.1
	DB	90.92T	;    406    90.92
	DB	90.75T	;    407    90.75
	DB	90.57T	;    408    90.57
	DB	90.4T	;    409    90.4
	DB	90.23T	;    410    90.23
	DB	90.05T	;    411    90.05
	DB	89.88T	;    412    89.88
	DB	89.71T	;    413    89.71
	DB	89.54T	;    414    89.54
	DB	89.36T	;    415    89.36
	DB	89.19T	;    416    89.19
	DB	89.02T	;    417    89.02
	DB	88.85T	;    418    88.85
	DB	88.68T	;    419    88.68
	DB	88.51T	;    420    88.51
	DB	88.34T	;    421    88.34
	DB	88.17T	;    422    88.17
	DB	88T	;    423    88
	DB	87.83T	;    424    87.83
	DB	87.66T	;    425    87.66
	DB	87.49T	;    426    87.49
	DB	87.32T	;    427    87.32
	DB	87.15T	;    428    87.15
	DB	86.98T	;    429    86.98
	DB	86.81T	;    430    86.81
	DB	86.64T	;    431    86.64
	DB	86.47T	;    432    86.47
	DB	86.3T	;    433    86.3
	DB	86.14T	;    434    86.14
	DB	85.97T	;    435    85.97
	DB	85.8T	;    436    85.8
	DB	85.63T	;    437    85.63
	DB	85.47T	;    438    85.47
	DB	85.3T	;    439    85.3
	DB	85.13T	;    440    85.13
	DB	84.97T	;    441    84.97
	DB	84.8T	;    442    84.8
	DB	84.63T	;    443    84.63
	DB	84.47T	;    444    84.47
	DB	84.3T	;    445    84.3
	DB	84.14T	;    446    84.14
	DB	83.97T	;    447    83.97
	DB	83.8T	;    448    83.8
	DB	83.64T	;    449    83.64
	DB	83.47T	;    450    83.47
	DB	83.31T	;    451    83.31
	DB	83.14T	;    452    83.14
	DB	82.98T	;    453    82.98
	DB	82.82T	;    454    82.82
	DB	82.65T	;    455    82.65
	DB	82.49T	;    456    82.49
	DB	82.32T	;    457    82.32
	DB	82.16T	;    458    82.16
	DB	82T	;    459    82
	DB	81.83T	;    460    81.83
	DB	81.67T	;    461    81.67
	DB	81.51T	;    462    81.51
	DB	81.34T	;    463    81.34
	DB	81.18T	;    464    81.18
	DB	81.02T	;    465    81.02
	DB	80.85T	;    466    80.85
	DB	80.69T	;    467    80.69
	DB	80.53T	;    468    80.53
	DB	80.37T	;    469    80.37
	DB	80.21T	;    470    80.21
	DB	80.04T	;    471    80.04
	DB	79.88T	;    472    79.88
	DB	79.72T	;    473    79.72
	DB	79.56T	;    474    79.56
	DB	79.4T	;    475    79.4
	DB	79.24T	;    476    79.24
	DB	79.08T	;    477    79.08
	DB	78.91T	;    478    78.91
	DB	78.75T	;    479    78.75
	DB	78.59T	;    480    78.59
	DB	78.43T	;    481    78.43
	DB	78.27T	;    482    78.27
	DB	78.11T	;    483    78.11
	DB	77.95T	;    484    77.95
	DB	77.79T	;    485    77.79
	DB	77.63T	;    486    77.63
	DB	77.47T	;    487    77.47
	DB	77.31T	;    488    77.31
	DB	77.15T	;    489    77.15
	DB	76.99T	;    490    76.99
	DB	76.83T	;    491    76.83
	DB	76.67T	;    492    76.67
	DB	76.52T	;    493    76.52
	DB	76.36T	;    494    76.36
	DB	76.2T	;    495    76.2
	DB	76.04T	;    496    76.04
	DB	75.88T	;    497    75.88
	DB	75.72T	;    498    75.72
	DB	75.56T	;    499    75.56
	DB	75.4T	;    500    75.4
	DB	75.25T	;    501    75.25
	DB	75.09T	;    502    75.09
	DB	74.93T	;    503    74.93
	DB	74.77T	;    504    74.77
	DB	74.61T	;    505    74.61
	DB	74.46T	;    506    74.46
	DB	74.3T	;    507    74.3
	DB	74.14T	;    508    74.14
	DB	73.98T	;    509    73.98
	DB	73.83T	;    510    73.83
	DB	73.67T	;    511    73.67
	DB	73.51T	;    512    73.51
	DB	73.35T	;    513    73.35
	DB	73.2T	;    514    73.2
	DB	73.04T	;    515    73.04
	DB	72.88T	;    516    72.88
	DB	72.73T	;    517    72.73
	DB	72.57T	;    518    72.57
	DB	72.41T	;    519    72.41
	DB	72.26T	;    520    72.26
	DB	72.1T	;    521    72.1
	DB	71.94T	;    522    71.94
	DB	71.79T	;    523    71.79
	DB	71.63T	;    524    71.63
	DB	71.47T	;    525    71.47
	DB	71.32T	;    526    71.32
	DB	71.16T	;    527    71.16
	DB	71T	;    528    71
	DB	70.85T	;    529    70.85
	DB	70.69T	;    530    70.69
	DB	70.54T	;    531    70.54
	DB	70.38T	;    532    70.38
	DB	70.22T	;    533    70.22
	DB	70.07T	;    534    70.07
	DB	69.91T	;    535    69.91
	DB	69.76T	;    536    69.76
	DB	69.6T	;    537    69.6
	DB	69.45T	;    538    69.45
	DB	69.29T	;    539    69.29
	DB	69.13T	;    540    69.13
	DB	68.98T	;    541    68.98
	DB	68.82T	;    542    68.82
	DB	68.67T	;    543    68.67
	DB	68.51T	;    544    68.51
	DB	68.36T	;    545    68.36
	DB	68.2T	;    546    68.2
	DB	68.05T	;    547    68.05
	DB	67.89T	;    548    67.89
	DB	67.74T	;    549    67.74
	DB	67.58T	;    550    67.58
	DB	67.43T	;    551    67.43
	DB	67.27T	;    552    67.27
	DB	67.12T	;    553    67.12
	DB	66.96T	;    554    66.96
	DB	66.81T	;    555    66.81
	DB	66.65T	;    556    66.65
	DB	66.5T	;    557    66.5
	DB	66.34T	;    558    66.34
	DB	66.19T	;    559    66.19
	DB	66.03T	;    560    66.03
	DB	65.88T	;    561    65.88
	DB	65.72T	;    562    65.72
	DB	65.57T	;    563    65.57
	DB	65.42T	;    564    65.42
	DB	65.26T	;    565    65.26
	DB	65.11T	;    566    65.11
	DB	64.95T	;    567    64.95
	DB	64.8T	;    568    64.8
	DB	64.64T	;    569    64.64
	DB	64.49T	;    570    64.49
	DB	64.33T	;    571    64.33
	DB	64.18T	;    572    64.18
	DB	64.02T	;    573    64.02
	DB	63.87T	;    574    63.87
	DB	63.72T	;    575    63.72
	DB	63.56T	;    576    63.56
	DB	63.41T	;    577    63.41
	DB	63.25T	;    578    63.25
	DB	63.1T	;    579    63.1
	DB	62.94T	;    580    62.94
	DB	62.79T	;    581    62.79
	DB	62.63T	;    582    62.63
	DB	62.48T	;    583    62.48
	DB	62.32T	;    584    62.32
	DB	62.17T	;    585    62.17
	DB	62.02T	;    586    62.02
	DB	61.86T	;    587    61.86
	DB	61.71T	;    588    61.71
	DB	61.55T	;    589    61.55
	DB	61.4T	;    590    61.4
	DB	61.24T	;    591    61.24
	DB	61.09T	;    592    61.09
	DB	60.93T	;    593    60.93
	DB	60.78T	;    594    60.78
	DB	60.62T	;    595    60.62
	DB	60.47T	;    596    60.47
	DB	60.32T	;    597    60.32
	DB	60.16T	;    598    60.16
	DB	60.01T	;    599    60.01
	DB	59.85T	;    600    59.85
	DB	59.7T	;    601    59.7
	DB	59.54T	;    602    59.54
	DB	59.39T	;    603    59.39
	DB	59.23T	;    604    59.23
	DB	59.08T	;    605    59.08
	DB	58.92T	;    606    58.92
	DB	58.77T	;    607    58.77
	DB	58.61T	;    608    58.61
	DB	58.46T	;    609    58.46
	DB	58.3T	;    610    58.3
	DB	58.15T	;    611    58.15
	DB	57.99T	;    612    57.99
	DB	57.84T	;    613    57.84
	DB	57.68T	;    614    57.68
	DB	57.53T	;    615    57.53
	DB	57.37T	;    616    57.37
	DB	57.22T	;    617    57.22
	DB	57.06T	;    618    57.06
	DB	56.91T	;    619    56.91
	DB	56.75T	;    620    56.75
	DB	56.59T	;    621    56.59
	DB	56.44T	;    622    56.44
	DB	56.28T	;    623    56.28
	DB	56.13T	;    624    56.13
	DB	55.97T	;    625    55.97
	DB	55.82T	;    626    55.82
	DB	55.66T	;    627    55.66
	DB	55.5T	;    628    55.5
	DB	55.35T	;    629    55.35
	DB	55.19T	;    630    55.19
	DB	55.04T	;    631    55.04
	DB	54.88T	;    632    54.88
	DB	54.72T	;    633    54.72
	DB	54.57T	;    634    54.57
	DB	54.41T	;    635    54.41
	DB	54.25T	;    636    54.25
	DB	54.1T	;    637    54.1
	DB	53.94T	;    638    53.94
	DB	53.78T	;    639    53.78
	DB	53.63T	;    640    53.63
	DB	53.47T	;    641    53.47
	DB	53.31T	;    642    53.31
	DB	53.16T	;    643    53.16
	DB	53T	;    644    53
	DB	52.84T	;    645    52.84
	DB	52.69T	;    646    52.69
	DB	52.53T	;    647    52.53
	DB	52.37T	;    648    52.37
	DB	52.21T	;    649    52.21
	DB	52.06T	;    650    52.06
	DB	51.9T	;    651    51.9
	DB	51.74T	;    652    51.74
	DB	51.58T	;    653    51.58
	DB	51.42T	;    654    51.42
	DB	51.27T	;    655    51.27
	DB	51.11T	;    656    51.11
	DB	50.95T	;    657    50.95
	DB	50.79T	;    658    50.79
	DB	50.63T	;    659    50.63
	DB	50.47T	;    660    50.47
	DB	50.31T	;    661    50.31
	DB	50.16T	;    662    50.16
	DB	50T	;    663    50
	DB	49.84T	;    664    49.84
	DB	49.68T	;    665    49.68
	DB	49.52T	;    666    49.52
	DB	49.36T	;    667    49.36
	DB	49.2T	;    668    49.2
	DB	49.04T	;    669    49.04
	DB	48.88T	;    670    48.88
	DB	48.72T	;    671    48.72
	DB	48.56T	;    672    48.56
	DB	48.4T	;    673    48.4
	DB	48.24T	;    674    48.24
	DB	48.08T	;    675    48.08
	DB	47.92T	;    676    47.92
	DB	47.76T	;    677    47.76
	DB	47.6T	;    678    47.6
	DB	47.44T	;    679    47.44
	DB	47.28T	;    680    47.28
	DB	47.11T	;    681    47.11
	DB	46.95T	;    682    46.95
	DB	46.79T	;    683    46.79
	DB	46.63T	;    684    46.63
	DB	46.47T	;    685    46.47
	DB	46.31T	;    686    46.31
	DB	46.14T	;    687    46.14
	DB	45.98T	;    688    45.98
	DB	45.82T	;    689    45.82
	DB	45.66T	;    690    45.66
	DB	45.49T	;    691    45.49
	DB	45.33T	;    692    45.33
	DB	45.17T	;    693    45.17
	DB	45.01T	;    694    45.01
	DB	44.84T	;    695    44.84
	DB	44.68T	;    696    44.68
	DB	44.51T	;    697    44.51
	DB	44.35T	;    698    44.35
	DB	44.19T	;    699    44.19
	DB	44.02T	;    700    44.02
	DB	43.86T	;    701    43.86
	DB	43.69T	;    702    43.69
	DB	43.53T	;    703    43.53
	DB	43.36T	;    704    43.36
	DB	43.2T	;    705    43.2
	DB	43.03T	;    706    43.03
	DB	42.87T	;    707    42.87
	DB	42.7T	;    708    42.7
	DB	42.54T	;    709    42.54
	DB	42.37T	;    710    42.37
	DB	42.2T	;    711    42.2
	DB	42.04T	;    712    42.04
	DB	41.87T	;    713    41.87
	DB	41.7T	;    714    41.7
	DB	41.54T	;    715    41.54
	DB	41.37T	;    716    41.37
	DB	41.2T	;    717    41.2
	DB	41.03T	;    718    41.03
	DB	40.86T	;    719    40.86
	DB	40.7T	;    720    40.7
	DB	40.53T	;    721    40.53
	DB	40.36T	;    722    40.36
	DB	40.19T	;    723    40.19
	DB	40.02T	;    724    40.02
	DB	39.85T	;    725    39.85
	DB	39.68T	;    726    39.68
	DB	39.51T	;    727    39.51
	DB	39.34T	;    728    39.34
	DB	39.17T	;    729    39.17
	DB	39T	;    730    39
	DB	38.83T	;    731    38.83
	DB	38.66T	;    732    38.66
	DB	38.49T	;    733    38.49
	DB	38.32T	;    734    38.32
	DB	38.14T	;    735    38.14
	DB	37.97T	;    736    37.97
	DB	37.8T	;    737    37.8
	DB	37.63T	;    738    37.63
	DB	37.45T	;    739    37.45
	DB	37.28T	;    740    37.28
	DB	37.11T	;    741    37.11
	DB	36.93T	;    742    36.93
	DB	36.76T	;    743    36.76
	DB	36.59T	;    744    36.59
	DB	36.41T	;    745    36.41
	DB	36.24T	;    746    36.24
	DB	36.06T	;    747    36.06
	DB	35.89T	;    748    35.89
	DB	35.71T	;    749    35.71
	DB	35.53T	;    750    35.53
	DB	35.36T	;    751    35.36
	DB	35.18T	;    752    35.18
	DB	35T	;    753    35
	DB	34.83T	;    754    34.83
	DB	34.65T	;    755    34.65
	DB	34.47T	;    756    34.47
	DB	34.29T	;    757    34.29
	DB	34.12T	;    758    34.12
	DB	33.94T	;    759    33.94
	DB	33.76T	;    760    33.76
	DB	33.58T	;    761    33.58
	DB	33.4T	;    762    33.4
	DB	33.22T	;    763    33.22
	DB	33.04T	;    764    33.04
	DB	32.86T	;    765    32.86
	DB	32.68T	;    766    32.68
	DB	32.49T	;    767    32.49
	DB	32.31T	;    768    32.31
	DB	32.13T	;    769    32.13
	DB	31.95T	;    770    31.95
	DB	31.76T	;    771    31.76
	DB	31.58T	;    772    31.58
	DB	31.4T	;    773    31.4
	DB	31.21T	;    774    31.21
	DB	31.03T	;    775    31.03
	DB	30.84T	;    776    30.84
	DB	30.66T	;    777    30.66
	DB	30.47T	;    778    30.47
	DB	30.29T	;    779    30.29
	DB	30.1T	;    780    30.1
	DB	29.91T	;    781    29.91
	DB	29.73T	;    782    29.73
	DB	29.54T	;    783    29.54
	DB	29.35T	;    784    29.35
	DB	29.16T	;    785    29.16
	DB	28.97T	;    786    28.97
	DB	28.78T	;    787    28.78
	DB	28.6T	;    788    28.6
	DB	28.4T	;    789    28.4
	DB	28.21T	;    790    28.21
	DB	28.02T	;    791    28.02
	DB	27.83T	;    792    27.83
	DB	27.64T	;    793    27.64
	DB	27.45T	;    794    27.45
	DB	27.25T	;    795    27.25
	DB	27.06T	;    796    27.06
	DB	26.87T	;    797    26.87
	DB	26.67T	;    798    26.67
	DB	26.48T	;    799    26.48
	DB	26.28T	;    800    26.28
	DB	26.09T	;    801    26.09
	DB	25.89T	;    802    25.89
	DB	25.69T	;    803    25.69
	DB	25.5T	;    804    25.5
	DB	25.3T	;    805    25.3
	DB	25.1T	;    806    25.1
	DB	24.9T	;    807    24.9
	DB	24.7T	;    808    24.7
	DB	24.5T	;    809    24.5
	DB	24.3T	;    810    24.3
	DB	24.1T	;    811    24.1
	DB	23.9T	;    812    23.9
	DB	23.7T	;    813    23.7
	DB	23.49T	;    814    23.49
	DB	23.29T	;    815    23.29
	DB	23.09T	;    816    23.09
	DB	22.88T	;    817    22.88
	DB	22.68T	;    818    22.68
	DB	22.47T	;    819    22.47
	DB	22.27T	;    820    22.27
	DB	22.06T	;    821    22.06
	DB	21.85T	;    822    21.85
	DB	21.64T	;    823    21.64
	DB	21.43T	;    824    21.43
	DB	21.23T	;    825    21.23
	DB	21.02T	;    826    21.02
	DB	20.8T	;    827    20.8
	DB	20.59T	;    828    20.59
	DB	20.38T	;    829    20.38
	DB	20.17T	;    830    20.17
	DB	19.96T	;    831    19.96
	DB	19.74T	;    832    19.74
	DB	19.53T	;    833    19.53
	DB	19.31T	;    834    19.31
	DB	19.1T	;    835    19.1
	DB	18.88T	;    836    18.88
	DB	18.66T	;    837    18.66
	DB	18.44T	;    838    18.44
	DB	18.22T	;    839    18.22
	DB	18T	;    840    18
	DB	17.78T	;    841    17.78
	DB	17.56T	;    842    17.56
	DB	17.34T	;    843    17.34
	DB	17.12T	;    844    17.12
	DB	16.89T	;    845    16.89
	DB	16.67T	;    846    16.67
	DB	16.44T	;    847    16.44
	DB	16.22T	;    848    16.22
	DB	15.99T	;    849    15.99
	DB	15.76T	;    850    15.76
	DB	15.53T	;    851    15.53
	DB	15.3T	;    852    15.3
	DB	15.07T	;    853    15.07
	DB	14.84T	;    854    14.84
	DB	14.61T	;    855    14.61
	DB	14.38T	;    856    14.38
	DB	14.14T	;    857    14.14
	DB	13.91T	;    858    13.91
	DB	13.67T	;    859    13.67
	DB	13.43T	;    860    13.43
	DB	13.2T	;    861    13.2
	DB	12.96T	;    862    12.96
	DB	12.72T	;    863    12.72
	DB	12.48T	;    864    12.48
	DB	12.23T	;    865    12.23
	DB	11.99T	;    866    11.99
	DB	11.75T	;    867    11.75
	DB	11.5T	;    868    11.5
	DB	11.26T	;    869    11.26
	DB	11.01T	;    870    11.01
	DB	10.76T	;    871    10.76
	DB	10.51T	;    872    10.51
	DB	10.26T	;    873    10.26
	DB	10.01T	;    874    10.01
	DB	9.76T	;    875    9.76
	DB	9.5T	;    876    9.5
	DB	9.25T	;    877    9.25
	DB	8.99T	;    878    8.99
	DB	8.73T	;    879    8.73
	DB	8.47T	;    880    8.47
	DB	8.21T	;    881    8.21
	DB	7.95T	;    882    7.95
	DB	7.69T	;    883    7.69
	DB	7.42T	;    884    7.42
	DB	7.16T	;    885    7.16
	DB	6.89T	;    886    6.89
	DB	6.62T	;    887    6.62
	DB	6.35T	;    888    6.35
	DB	6.08T	;    889    6.08
	DB	5.81T	;    890    5.81
	DB	5.54T	;    891    5.54
	DB	5.26T	;    892    5.26
	DB	4.98T	;    893    4.98
	DB	4.7T	;    894    4.7
	DB	4.42T	;    895    4.42
	DB	4.14T	;    896    4.14
	DB	3.86T	;    897    3.86
	DB	3.57T	;    898    3.57
	DB	3.29T	;    899    3.29
	DB	3T	;    900    3
	DB	2.71T	;    901    2.71
	DB	2.42T	;    902    2.42
	DB	2.12T	;    903    2.12
	DB	1.83T	;    904    1.83
	DB	1.53T	;    905    1.53
	DB	1.23T	;    906    1.23
	DB	0.93T	;    907    0.93
	DB	0.63T	;    908    0.63
	DB	0.32T	;    909    0.32
	DB	0.02T	;    910    0.02
	DB	-0.29T	;    911    -0.29
	DB	-0.6T	;    912    -0.6
	DB	-0.92T	;    913    -0.92
	DB	-1.23T	;    914    -1.23
	DB	-1.55T	;    915    -1.55
	DB	-1.87T	;    916    -1.87
	DB	-2.19T	;    917    -2.19
	DB	-2.52T	;    918    -2.52
	DB	-2.84T	;    919    -2.84
	DB	-3.17T	;    920    -3.17
	DB	-3.5T	;    921    -3.5
	DB	-3.84T	;    922    -3.84
	DB	-4.17T	;    923    -4.17
	DB	-4.51T	;    924    -4.51
	DB	-4.85T	;    925    -4.85
	DB	-5.2T	;    926    -5.2
	DB	-5.55T	;    927    -5.55
	DB	-5.89T	;    928    -5.89
	DB	-6.25T	;    929    -6.25
	DB	-6.6T	;    930    -6.6
	DB	-6.96T	;    931    -6.96
	DB	-7.32T	;    932    -7.32
	DB	-7.69T	;    933    -7.69
	DB	-8.06T	;    934    -8.06
	DB	-8.43T	;    935    -8.43
	DB	-8.8T	;    936    -8.8
	DB	-9.18T	;    937    -9.18
	DB	-9.56T	;    938    -9.56
	DB	-9.94T	;    939    -9.94
	DB	-10.33T	;    940    -10.33
	DB	-10.73T	;    941    -10.73
	DB	-11.12T	;    942    -11.12
	DB	-11.52T	;    943    -11.52
	DB	-11.92T	;    944    -11.92
	DB	-12.33T	;    945    -12.33
	DB	-12.74T	;    946    -12.74
	DB	-13.16T	;    947    -13.16
	DB	-13.58T	;    948    -13.58
	DB	-14.01T	;    949    -14.01
	DB	-14.44T	;    950    -14.44
	DB	-14.87T	;    951    -14.87
	DB	-15.31T	;    952    -15.31
	DB	-15.75T	;    953    -15.75
	DB	-16.2T	;    954    -16.2
	DB	-16.66T	;    955    -16.66
	DB	-17.12T	;    956    -17.12
	DB	-17.59T	;    957    -17.59
	DB	-18.06T	;    958    -18.06
	DB	-18.53T	;    959    -18.53
	DB	-19.02T	;    960    -19.02
	DB	-19.51T	;    961    -19.51
	DB	-20T	;    962    -20
	DB	-20.51T	;    963    -20.51
	DB	-21.02T	;    964    -21.02
	DB	-21.54T	;    965    -21.54
	DB	-22.06T	;    966    -22.06
	DB	-22.59T	;    967    -22.59
	DB	-23.13T	;    968    -23.13
	DB	-23.68T	;    969    -23.68
	DB	-24.24T	;    970    -24.24
	DB	-24.8T	;    971    -24.8
	DB	-25.38T	;    972    -25.38
	DB	-25.96T	;    973    -25.96
	DB	-26.56T	;    974    -26.56
	DB	-27.16T	;    975    -27.16
	DB	-27.78T	;    976    -27.78
	DB	-28.4T	;    977    -28.4
	DB	-29.04T	;    978    -29.04
	DB	-29.69T	;    979    -29.69
	DB	-30.35T	;    980    -30.35
	DB	-31.03T	;    981    -31.03
	DB	-31.71T	;    982    -31.71
	DB	-32.42T	;    983    -32.42
	DB	-33.14T	;    984    -33.14
	DB	-33.87T	;    985    -33.87
	DB	-34.62T	;    986    -34.62
	DB	-35.39T	;    987    -35.39
	DB	-36.18T	;    988    -36.18
	DB	-36.98T	;    989    -36.98
	DB	-37.81T	;    990    -37.81
	DB	-38.66T	;    991    -38.66
	DB	-39.53T	;    992    -39.53
	DB	180T	;    993    180
	DB	180T	;    994    180
	DB	180T	;    995    180
	DB	180T	;    996    180
	DB	180T	;    997    180
	DB	180T	;    998    180
	DB	180T	;    999    180
	DB	180T	;    1000    180
	DB	180T	;    1001    180
	DB	180T	;    1002    180
	DB	180T	;    1003    180
	DB	180T	;    1004    180
	DB	180T	;    1005    180
	DB	180T	;    1006    180
	DB	180T	;    1007    180
	DB	180T	;    1008    180
	DB	180T	;    1009    180
	DB	180T	;    1010    180
	DB	180T	;    1011    180
	DB	180T	;    1012    180
	DB	180T	;    1013    180
	DB	180T	;    1014    180
	DB	180T	;    1015    180
	DB	180T	;    1016    180
	DB	180T	;    1017    180
	DB	180T	;    1018    180
	DB	180T	;    1019    180
	DB	180T	;    1020    180
	DB	180T	;    1021    180
	DB	180T	;    1022    180
	DB	180T	;    1023    Sensor Failure - use 180 degF as default

