; Generated using EasyTherm4.exe
;
; M54/M52tu Oil Temp Sensor
;
; File generated for use with stock 2490 ohm resistor
;
;
; Input Data     Temp. degC     Resistance
;		   -48		   102672
;		    20		    2804
;		   140		     51
;

THERMFACTOR:
            ;    ADC  Temp. degF
	DB	180T	;    0    Sensor Failure - use 180 degF as default
	DB	180T	;    1    180
	DB	180T	;    2    180
	DB	180T	;    3    180
	DB	180T	;    4    180
	DB	180T	;    5    180
	DB	180T	;    6    180
	DB	180T	;    7    180
	DB	180T	;    8    180
	DB	348.63T	;    9    348.63
	DB	339.86T	;    10    339.86
	DB	332.06T	;    11    332.06
	DB	325.05T	;    12    325.05
	DB	318.7T	;    13    318.7
	DB	312.9T	;    14    312.9
	DB	307.56T	;    15    307.56
	DB	302.62T	;    16    302.62
	DB	298.02T	;    17    298.02
	DB	293.73T	;    18    293.73
	DB	289.71T	;    19    289.71
	DB	285.93T	;    20    285.93
	DB	282.35T	;    21    282.35
	DB	278.97T	;    22    278.97
	DB	275.76T	;    23    275.76
	DB	272.71T	;    24    272.71
	DB	269.8T	;    25    269.8
	DB	267.02T	;    26    267.02
	DB	264.36T	;    27    264.36
	DB	261.81T	;    28    261.81
	DB	259.37T	;    29    259.37
	DB	257.01T	;    30    257.01
	DB	254.75T	;    31    254.75
	DB	252.57T	;    32    252.57
	DB	250.46T	;    33    250.46
	DB	248.42T	;    34    248.42
	DB	246.45T	;    35    246.45
	DB	244.54T	;    36    244.54
	DB	242.7T	;    37    242.7
	DB	240.9T	;    38    240.9
	DB	239.16T	;    39    239.16
	DB	237.47T	;    40    237.47
	DB	235.83T	;    41    235.83
	DB	234.23T	;    42    234.23
	DB	232.67T	;    43    232.67
	DB	231.15T	;    44    231.15
	DB	229.68T	;    45    229.68
	DB	228.23T	;    46    228.23
	DB	226.82T	;    47    226.82
	DB	225.45T	;    48    225.45
	DB	224.11T	;    49    224.11
	DB	222.79T	;    50    222.79
	DB	221.51T	;    51    221.51
	DB	220.25T	;    52    220.25
	DB	219.02T	;    53    219.02
	DB	217.81T	;    54    217.81
	DB	216.63T	;    55    216.63
	DB	215.48T	;    56    215.48
	DB	214.34T	;    57    214.34
	DB	213.23T	;    58    213.23
	DB	212.14T	;    59    212.14
	DB	211.06T	;    60    211.06
	DB	210.01T	;    61    210.01
	DB	208.98T	;    62    208.98
	DB	207.96T	;    63    207.96
	DB	206.97T	;    64    206.97
	DB	205.98T	;    65    205.98
	DB	205.02T	;    66    205.02
	DB	204.07T	;    67    204.07
	DB	203.14T	;    68    203.14
	DB	202.22T	;    69    202.22
	DB	201.31T	;    70    201.31
	DB	200.42T	;    71    200.42
	DB	199.55T	;    72    199.55
	DB	198.68T	;    73    198.68
	DB	197.83T	;    74    197.83
	DB	196.99T	;    75    196.99
	DB	196.17T	;    76    196.17
	DB	195.35T	;    77    195.35
	DB	194.55T	;    78    194.55
	DB	193.75T	;    79    193.75
	DB	192.97T	;    80    192.97
	DB	192.2T	;    81    192.2
	DB	191.44T	;    82    191.44
	DB	190.69T	;    83    190.69
	DB	189.95T	;    84    189.95
	DB	189.21T	;    85    189.21
	DB	188.49T	;    86    188.49
	DB	187.77T	;    87    187.77
	DB	187.07T	;    88    187.07
	DB	186.37T	;    89    186.37
	DB	185.68T	;    90    185.68
	DB	185T	;    91    185
	DB	184.33T	;    92    184.33
	DB	183.66T	;    93    183.66
	DB	183.01T	;    94    183.01
	DB	182.35T	;    95    182.35
	DB	181.71T	;    96    181.71
	DB	181.08T	;    97    181.08
	DB	180.45T	;    98    180.45
	DB	179.82T	;    99    179.82
	DB	179.21T	;    100    179.21
	DB	178.6T	;    101    178.6
	DB	177.99T	;    102    177.99
	DB	177.4T	;    103    177.4
	DB	176.81T	;    104    176.81
	DB	176.22T	;    105    176.22
	DB	175.64T	;    106    175.64
	DB	175.07T	;    107    175.07
	DB	174.5T	;    108    174.5
	DB	173.94T	;    109    173.94
	DB	173.38T	;    110    173.38
	DB	172.83T	;    111    172.83
	DB	172.28T	;    112    172.28
	DB	171.74T	;    113    171.74
	DB	171.2T	;    114    171.2
	DB	170.67T	;    115    170.67
	DB	170.14T	;    116    170.14
	DB	169.62T	;    117    169.62
	DB	169.1T	;    118    169.1
	DB	168.59T	;    119    168.59
	DB	168.08T	;    120    168.08
	DB	167.57T	;    121    167.57
	DB	167.07T	;    122    167.07
	DB	166.57T	;    123    166.57
	DB	166.08T	;    124    166.08
	DB	165.59T	;    125    165.59
	DB	165.11T	;    126    165.11
	DB	164.63T	;    127    164.63
	DB	164.15T	;    128    164.15
	DB	163.68T	;    129    163.68
	DB	163.21T	;    130    163.21
	DB	162.74T	;    131    162.74
	DB	162.28T	;    132    162.28
	DB	161.82T	;    133    161.82
	DB	161.37T	;    134    161.37
	DB	160.92T	;    135    160.92
	DB	160.47T	;    136    160.47
	DB	160.02T	;    137    160.02
	DB	159.58T	;    138    159.58
	DB	159.14T	;    139    159.14
	DB	158.71T	;    140    158.71
	DB	158.28T	;    141    158.28
	DB	157.85T	;    142    157.85
	DB	157.42T	;    143    157.42
	DB	157T	;    144    157
	DB	156.58T	;    145    156.58
	DB	156.16T	;    146    156.16
	DB	155.75T	;    147    155.75
	DB	155.33T	;    148    155.33
	DB	154.93T	;    149    154.93
	DB	154.52T	;    150    154.52
	DB	154.12T	;    151    154.12
	DB	153.71T	;    152    153.71
	DB	153.32T	;    153    153.32
	DB	152.92T	;    154    152.92
	DB	152.53T	;    155    152.53
	DB	152.14T	;    156    152.14
	DB	151.75T	;    157    151.75
	DB	151.36T	;    158    151.36
	DB	150.98T	;    159    150.98
	DB	150.6T	;    160    150.6
	DB	150.22T	;    161    150.22
	DB	149.84T	;    162    149.84
	DB	149.47T	;    163    149.47
	DB	149.09T	;    164    149.09
	DB	148.72T	;    165    148.72
	DB	148.36T	;    166    148.36
	DB	147.99T	;    167    147.99
	DB	147.63T	;    168    147.63
	DB	147.27T	;    169    147.27
	DB	146.91T	;    170    146.91
	DB	146.55T	;    171    146.55
	DB	146.19T	;    172    146.19
	DB	145.84T	;    173    145.84
	DB	145.49T	;    174    145.49
	DB	145.14T	;    175    145.14
	DB	144.79T	;    176    144.79
	DB	144.45T	;    177    144.45
	DB	144.1T	;    178    144.1
	DB	143.76T	;    179    143.76
	DB	143.42T	;    180    143.42
	DB	143.08T	;    181    143.08
	DB	142.74T	;    182    142.74
	DB	142.41T	;    183    142.41
	DB	142.08T	;    184    142.08
	DB	141.74T	;    185    141.74
	DB	141.41T	;    186    141.41
	DB	141.09T	;    187    141.09
	DB	140.76T	;    188    140.76
	DB	140.44T	;    189    140.44
	DB	140.11T	;    190    140.11
	DB	139.79T	;    191    139.79
	DB	139.47T	;    192    139.47
	DB	139.15T	;    193    139.15
	DB	138.83T	;    194    138.83
	DB	138.52T	;    195    138.52
	DB	138.2T	;    196    138.2
	DB	137.89T	;    197    137.89
	DB	137.58T	;    198    137.58
	DB	137.27T	;    199    137.27
	DB	136.96T	;    200    136.96
	DB	136.66T	;    201    136.66
	DB	136.35T	;    202    136.35
	DB	136.05T	;    203    136.05
	DB	135.74T	;    204    135.74
	DB	135.44T	;    205    135.44
	DB	135.14T	;    206    135.14
	DB	134.84T	;    207    134.84
	DB	134.55T	;    208    134.55
	DB	134.25T	;    209    134.25
	DB	133.96T	;    210    133.96
	DB	133.66T	;    211    133.66
	DB	133.37T	;    212    133.37
	DB	133.08T	;    213    133.08
	DB	132.79T	;    214    132.79
	DB	132.5T	;    215    132.5
	DB	132.21T	;    216    132.21
	DB	131.93T	;    217    131.93
	DB	131.64T	;    218    131.64
	DB	131.36T	;    219    131.36
	DB	131.08T	;    220    131.08
	DB	130.8T	;    221    130.8
	DB	130.51T	;    222    130.51
	DB	130.24T	;    223    130.24
	DB	129.96T	;    224    129.96
	DB	129.68T	;    225    129.68
	DB	129.4T	;    226    129.4
	DB	129.13T	;    227    129.13
	DB	128.86T	;    228    128.86
	DB	128.58T	;    229    128.58
	DB	128.31T	;    230    128.31
	DB	128.04T	;    231    128.04
	DB	127.77T	;    232    127.77
	DB	127.5T	;    233    127.5
	DB	127.24T	;    234    127.24
	DB	126.97T	;    235    126.97
	DB	126.7T	;    236    126.7
	DB	126.44T	;    237    126.44
	DB	126.17T	;    238    126.17
	DB	125.91T	;    239    125.91
	DB	125.65T	;    240    125.65
	DB	125.39T	;    241    125.39
	DB	125.13T	;    242    125.13
	DB	124.87T	;    243    124.87
	DB	124.61T	;    244    124.61
	DB	124.36T	;    245    124.36
	DB	124.1T	;    246    124.1
	DB	123.84T	;    247    123.84
	DB	123.59T	;    248    123.59
	DB	123.34T	;    249    123.34
	DB	123.08T	;    250    123.08
	DB	122.83T	;    251    122.83
	DB	122.58T	;    252    122.58
	DB	122.33T	;    253    122.33
	DB	122.08T	;    254    122.08
	DB	121.83T	;    255    121.83
	DB	121.58T	;    256    121.58
	DB	121.34T	;    257    121.34
	DB	121.09T	;    258    121.09
	DB	120.85T	;    259    120.85
	DB	120.6T	;    260    120.6
	DB	120.36T	;    261    120.36
	DB	120.11T	;    262    120.11
	DB	119.87T	;    263    119.87
	DB	119.63T	;    264    119.63
	DB	119.39T	;    265    119.39
	DB	119.15T	;    266    119.15
	DB	118.91T	;    267    118.91
	DB	118.67T	;    268    118.67
	DB	118.43T	;    269    118.43
	DB	118.2T	;    270    118.2
	DB	117.96T	;    271    117.96
	DB	117.73T	;    272    117.73
	DB	117.49T	;    273    117.49
	DB	117.26T	;    274    117.26
	DB	117.02T	;    275    117.02
	DB	116.79T	;    276    116.79
	DB	116.56T	;    277    116.56
	DB	116.33T	;    278    116.33
	DB	116.1T	;    279    116.1
	DB	115.87T	;    280    115.87
	DB	115.64T	;    281    115.64
	DB	115.41T	;    282    115.41
	DB	115.18T	;    283    115.18
	DB	114.95T	;    284    114.95
	DB	114.72T	;    285    114.72
	DB	114.5T	;    286    114.5
	DB	114.27T	;    287    114.27
	DB	114.05T	;    288    114.05
	DB	113.82T	;    289    113.82
	DB	113.6T	;    290    113.6
	DB	113.38T	;    291    113.38
	DB	113.15T	;    292    113.15
	DB	112.93T	;    293    112.93
	DB	112.71T	;    294    112.71
	DB	112.49T	;    295    112.49
	DB	112.27T	;    296    112.27
	DB	112.05T	;    297    112.05
	DB	111.83T	;    298    111.83
	DB	111.61T	;    299    111.61
	DB	111.39T	;    300    111.39
	DB	111.18T	;    301    111.18
	DB	110.96T	;    302    110.96
	DB	110.74T	;    303    110.74
	DB	110.53T	;    304    110.53
	DB	110.31T	;    305    110.31
	DB	110.1T	;    306    110.1
	DB	109.88T	;    307    109.88
	DB	109.67T	;    308    109.67
	DB	109.45T	;    309    109.45
	DB	109.24T	;    310    109.24
	DB	109.03T	;    311    109.03
	DB	108.82T	;    312    108.82
	DB	108.61T	;    313    108.61
	DB	108.4T	;    314    108.4
	DB	108.19T	;    315    108.19
	DB	107.98T	;    316    107.98
	DB	107.77T	;    317    107.77
	DB	107.56T	;    318    107.56
	DB	107.35T	;    319    107.35
	DB	107.14T	;    320    107.14
	DB	106.93T	;    321    106.93
	DB	106.73T	;    322    106.73
	DB	106.52T	;    323    106.52
	DB	106.32T	;    324    106.32
	DB	106.11T	;    325    106.11
	DB	105.91T	;    326    105.91
	DB	105.7T	;    327    105.7
	DB	105.5T	;    328    105.5
	DB	105.29T	;    329    105.29
	DB	105.09T	;    330    105.09
	DB	104.89T	;    331    104.89
	DB	104.68T	;    332    104.68
	DB	104.48T	;    333    104.48
	DB	104.28T	;    334    104.28
	DB	104.08T	;    335    104.08
	DB	103.88T	;    336    103.88
	DB	103.68T	;    337    103.68
	DB	103.48T	;    338    103.48
	DB	103.28T	;    339    103.28
	DB	103.08T	;    340    103.08
	DB	102.88T	;    341    102.88
	DB	102.68T	;    342    102.68
	DB	102.49T	;    343    102.49
	DB	102.29T	;    344    102.29
	DB	102.09T	;    345    102.09
	DB	101.89T	;    346    101.89
	DB	101.7T	;    347    101.7
	DB	101.5T	;    348    101.5
	DB	101.31T	;    349    101.31
	DB	101.11T	;    350    101.11
	DB	100.92T	;    351    100.92
	DB	100.72T	;    352    100.72
	DB	100.53T	;    353    100.53
	DB	100.33T	;    354    100.33
	DB	100.14T	;    355    100.14
	DB	99.95T	;    356    99.95
	DB	99.76T	;    357    99.76
	DB	99.56T	;    358    99.56
	DB	99.37T	;    359    99.37
	DB	99.18T	;    360    99.18
	DB	98.99T	;    361    98.99
	DB	98.8T	;    362    98.8
	DB	98.61T	;    363    98.61
	DB	98.42T	;    364    98.42
	DB	98.23T	;    365    98.23
	DB	98.04T	;    366    98.04
	DB	97.85T	;    367    97.85
	DB	97.66T	;    368    97.66
	DB	97.47T	;    369    97.47
	DB	97.28T	;    370    97.28
	DB	97.1T	;    371    97.1
	DB	96.91T	;    372    96.91
	DB	96.72T	;    373    96.72
	DB	96.53T	;    374    96.53
	DB	96.35T	;    375    96.35
	DB	96.16T	;    376    96.16
	DB	95.97T	;    377    95.97
	DB	95.79T	;    378    95.79
	DB	95.6T	;    379    95.6
	DB	95.42T	;    380    95.42
	DB	95.23T	;    381    95.23
	DB	95.05T	;    382    95.05
	DB	94.86T	;    383    94.86
	DB	94.68T	;    384    94.68
	DB	94.5T	;    385    94.5
	DB	94.31T	;    386    94.31
	DB	94.13T	;    387    94.13
	DB	93.95T	;    388    93.95
	DB	93.76T	;    389    93.76
	DB	93.58T	;    390    93.58
	DB	93.4T	;    391    93.4
	DB	93.22T	;    392    93.22
	DB	93.04T	;    393    93.04
	DB	92.86T	;    394    92.86
	DB	92.67T	;    395    92.67
	DB	92.49T	;    396    92.49
	DB	92.31T	;    397    92.31
	DB	92.13T	;    398    92.13
	DB	91.95T	;    399    91.95
	DB	91.77T	;    400    91.77
	DB	91.59T	;    401    91.59
	DB	91.41T	;    402    91.41
	DB	91.24T	;    403    91.24
	DB	91.06T	;    404    91.06
	DB	90.88T	;    405    90.88
	DB	90.7T	;    406    90.7
	DB	90.52T	;    407    90.52
	DB	90.34T	;    408    90.34
	DB	90.17T	;    409    90.17
	DB	89.99T	;    410    89.99
	DB	89.81T	;    411    89.81
	DB	89.64T	;    412    89.64
	DB	89.46T	;    413    89.46
	DB	89.28T	;    414    89.28
	DB	89.11T	;    415    89.11
	DB	88.93T	;    416    88.93
	DB	88.75T	;    417    88.75
	DB	88.58T	;    418    88.58
	DB	88.4T	;    419    88.4
	DB	88.23T	;    420    88.23
	DB	88.05T	;    421    88.05
	DB	87.88T	;    422    87.88
	DB	87.7T	;    423    87.7
	DB	87.53T	;    424    87.53
	DB	87.36T	;    425    87.36
	DB	87.18T	;    426    87.18
	DB	87.01T	;    427    87.01
	DB	86.84T	;    428    86.84
	DB	86.66T	;    429    86.66
	DB	86.49T	;    430    86.49
	DB	86.32T	;    431    86.32
	DB	86.14T	;    432    86.14
	DB	85.97T	;    433    85.97
	DB	85.8T	;    434    85.8
	DB	85.63T	;    435    85.63
	DB	85.45T	;    436    85.45
	DB	85.28T	;    437    85.28
	DB	85.11T	;    438    85.11
	DB	84.94T	;    439    84.94
	DB	84.77T	;    440    84.77
	DB	84.6T	;    441    84.6
	DB	84.43T	;    442    84.43
	DB	84.26T	;    443    84.26
	DB	84.09T	;    444    84.09
	DB	83.92T	;    445    83.92
	DB	83.75T	;    446    83.75
	DB	83.58T	;    447    83.58
	DB	83.41T	;    448    83.41
	DB	83.24T	;    449    83.24
	DB	83.07T	;    450    83.07
	DB	82.9T	;    451    82.9
	DB	82.73T	;    452    82.73
	DB	82.56T	;    453    82.56
	DB	82.39T	;    454    82.39
	DB	82.22T	;    455    82.22
	DB	82.05T	;    456    82.05
	DB	81.88T	;    457    81.88
	DB	81.72T	;    458    81.72
	DB	81.55T	;    459    81.55
	DB	81.38T	;    460    81.38
	DB	81.21T	;    461    81.21
	DB	81.04T	;    462    81.04
	DB	80.88T	;    463    80.88
	DB	80.71T	;    464    80.71
	DB	80.54T	;    465    80.54
	DB	80.38T	;    466    80.38
	DB	80.21T	;    467    80.21
	DB	80.04T	;    468    80.04
	DB	79.87T	;    469    79.87
	DB	79.71T	;    470    79.71
	DB	79.54T	;    471    79.54
	DB	79.38T	;    472    79.38
	DB	79.21T	;    473    79.21
	DB	79.04T	;    474    79.04
	DB	78.88T	;    475    78.88
	DB	78.71T	;    476    78.71
	DB	78.55T	;    477    78.55
	DB	78.38T	;    478    78.38
	DB	78.21T	;    479    78.21
	DB	78.05T	;    480    78.05
	DB	77.88T	;    481    77.88
	DB	77.72T	;    482    77.72
	DB	77.55T	;    483    77.55
	DB	77.39T	;    484    77.39
	DB	77.22T	;    485    77.22
	DB	77.06T	;    486    77.06
	DB	76.9T	;    487    76.9
	DB	76.73T	;    488    76.73
	DB	76.57T	;    489    76.57
	DB	76.4T	;    490    76.4
	DB	76.24T	;    491    76.24
	DB	76.07T	;    492    76.07
	DB	75.91T	;    493    75.91
	DB	75.75T	;    494    75.75
	DB	75.58T	;    495    75.58
	DB	75.42T	;    496    75.42
	DB	75.26T	;    497    75.26
	DB	75.09T	;    498    75.09
	DB	74.93T	;    499    74.93
	DB	74.77T	;    500    74.77
	DB	74.6T	;    501    74.6
	DB	74.44T	;    502    74.44
	DB	74.28T	;    503    74.28
	DB	74.11T	;    504    74.11
	DB	73.95T	;    505    73.95
	DB	73.79T	;    506    73.79
	DB	73.63T	;    507    73.63
	DB	73.46T	;    508    73.46
	DB	73.3T	;    509    73.3
	DB	73.14T	;    510    73.14
	DB	72.98T	;    511    72.98
	DB	72.81T	;    512    72.81
	DB	72.65T	;    513    72.65
	DB	72.49T	;    514    72.49
	DB	72.33T	;    515    72.33
	DB	72.17T	;    516    72.17
	DB	72T	;    517    72
	DB	71.84T	;    518    71.84
	DB	71.68T	;    519    71.68
	DB	71.52T	;    520    71.52
	DB	71.36T	;    521    71.36
	DB	71.19T	;    522    71.19
	DB	71.03T	;    523    71.03
	DB	70.87T	;    524    70.87
	DB	70.71T	;    525    70.71
	DB	70.55T	;    526    70.55
	DB	70.39T	;    527    70.39
	DB	70.23T	;    528    70.23
	DB	70.07T	;    529    70.07
	DB	69.9T	;    530    69.9
	DB	69.74T	;    531    69.74
	DB	69.58T	;    532    69.58
	DB	69.42T	;    533    69.42
	DB	69.26T	;    534    69.26
	DB	69.1T	;    535    69.1
	DB	68.94T	;    536    68.94
	DB	68.78T	;    537    68.78
	DB	68.62T	;    538    68.62
	DB	68.46T	;    539    68.46
	DB	68.3T	;    540    68.3
	DB	68.13T	;    541    68.13
	DB	67.97T	;    542    67.97
	DB	67.81T	;    543    67.81
	DB	67.65T	;    544    67.65
	DB	67.49T	;    545    67.49
	DB	67.33T	;    546    67.33
	DB	67.17T	;    547    67.17
	DB	67.01T	;    548    67.01
	DB	66.85T	;    549    66.85
	DB	66.69T	;    550    66.69
	DB	66.53T	;    551    66.53
	DB	66.37T	;    552    66.37
	DB	66.21T	;    553    66.21
	DB	66.05T	;    554    66.05
	DB	65.89T	;    555    65.89
	DB	65.73T	;    556    65.73
	DB	65.57T	;    557    65.57
	DB	65.41T	;    558    65.41
	DB	65.25T	;    559    65.25
	DB	65.09T	;    560    65.09
	DB	64.93T	;    561    64.93
	DB	64.77T	;    562    64.77
	DB	64.61T	;    563    64.61
	DB	64.45T	;    564    64.45
	DB	64.29T	;    565    64.29
	DB	64.13T	;    566    64.13
	DB	63.97T	;    567    63.97
	DB	63.81T	;    568    63.81
	DB	63.65T	;    569    63.65
	DB	63.49T	;    570    63.49
	DB	63.33T	;    571    63.33
	DB	63.17T	;    572    63.17
	DB	63.01T	;    573    63.01
	DB	62.85T	;    574    62.85
	DB	62.69T	;    575    62.69
	DB	62.53T	;    576    62.53
	DB	62.37T	;    577    62.37
	DB	62.21T	;    578    62.21
	DB	62.05T	;    579    62.05
	DB	61.89T	;    580    61.89
	DB	61.73T	;    581    61.73
	DB	61.57T	;    582    61.57
	DB	61.4T	;    583    61.4
	DB	61.24T	;    584    61.24
	DB	61.08T	;    585    61.08
	DB	60.92T	;    586    60.92
	DB	60.76T	;    587    60.76
	DB	60.6T	;    588    60.6
	DB	60.44T	;    589    60.44
	DB	60.28T	;    590    60.28
	DB	60.12T	;    591    60.12
	DB	59.96T	;    592    59.96
	DB	59.8T	;    593    59.8
	DB	59.64T	;    594    59.64
	DB	59.48T	;    595    59.48
	DB	59.32T	;    596    59.32
	DB	59.16T	;    597    59.16
	DB	59T	;    598    59
	DB	58.84T	;    599    58.84
	DB	58.68T	;    600    58.68
	DB	58.52T	;    601    58.52
	DB	58.36T	;    602    58.36
	DB	58.2T	;    603    58.2
	DB	58.04T	;    604    58.04
	DB	57.87T	;    605    57.87
	DB	57.71T	;    606    57.71
	DB	57.55T	;    607    57.55
	DB	57.39T	;    608    57.39
	DB	57.23T	;    609    57.23
	DB	57.07T	;    610    57.07
	DB	56.91T	;    611    56.91
	DB	56.75T	;    612    56.75
	DB	56.59T	;    613    56.59
	DB	56.42T	;    614    56.42
	DB	56.26T	;    615    56.26
	DB	56.1T	;    616    56.1
	DB	55.94T	;    617    55.94
	DB	55.78T	;    618    55.78
	DB	55.62T	;    619    55.62
	DB	55.46T	;    620    55.46
	DB	55.29T	;    621    55.29
	DB	55.13T	;    622    55.13
	DB	54.97T	;    623    54.97
	DB	54.81T	;    624    54.81
	DB	54.65T	;    625    54.65
	DB	54.48T	;    626    54.48
	DB	54.32T	;    627    54.32
	DB	54.16T	;    628    54.16
	DB	54T	;    629    54
	DB	53.83T	;    630    53.83
	DB	53.67T	;    631    53.67
	DB	53.51T	;    632    53.51
	DB	53.35T	;    633    53.35
	DB	53.18T	;    634    53.18
	DB	53.02T	;    635    53.02
	DB	52.86T	;    636    52.86
	DB	52.7T	;    637    52.7
	DB	52.53T	;    638    52.53
	DB	52.37T	;    639    52.37
	DB	52.21T	;    640    52.21
	DB	52.04T	;    641    52.04
	DB	51.88T	;    642    51.88
	DB	51.72T	;    643    51.72
	DB	51.55T	;    644    51.55
	DB	51.39T	;    645    51.39
	DB	51.22T	;    646    51.22
	DB	51.06T	;    647    51.06
	DB	50.9T	;    648    50.9
	DB	50.73T	;    649    50.73
	DB	50.57T	;    650    50.57
	DB	50.4T	;    651    50.4
	DB	50.24T	;    652    50.24
	DB	50.07T	;    653    50.07
	DB	49.91T	;    654    49.91
	DB	49.75T	;    655    49.75
	DB	49.58T	;    656    49.58
	DB	49.42T	;    657    49.42
	DB	49.25T	;    658    49.25
	DB	49.08T	;    659    49.08
	DB	48.92T	;    660    48.92
	DB	48.75T	;    661    48.75
	DB	48.59T	;    662    48.59
	DB	48.42T	;    663    48.42
	DB	48.26T	;    664    48.26
	DB	48.09T	;    665    48.09
	DB	47.92T	;    666    47.92
	DB	47.76T	;    667    47.76
	DB	47.59T	;    668    47.59
	DB	47.42T	;    669    47.42
	DB	47.26T	;    670    47.26
	DB	47.09T	;    671    47.09
	DB	46.92T	;    672    46.92
	DB	46.76T	;    673    46.76
	DB	46.59T	;    674    46.59
	DB	46.42T	;    675    46.42
	DB	46.25T	;    676    46.25
	DB	46.09T	;    677    46.09
	DB	45.92T	;    678    45.92
	DB	45.75T	;    679    45.75
	DB	45.58T	;    680    45.58
	DB	45.41T	;    681    45.41
	DB	45.24T	;    682    45.24
	DB	45.08T	;    683    45.08
	DB	44.91T	;    684    44.91
	DB	44.74T	;    685    44.74
	DB	44.57T	;    686    44.57
	DB	44.4T	;    687    44.4
	DB	44.23T	;    688    44.23
	DB	44.06T	;    689    44.06
	DB	43.89T	;    690    43.89
	DB	43.72T	;    691    43.72
	DB	43.55T	;    692    43.55
	DB	43.38T	;    693    43.38
	DB	43.21T	;    694    43.21
	DB	43.04T	;    695    43.04
	DB	42.87T	;    696    42.87
	DB	42.69T	;    697    42.69
	DB	42.52T	;    698    42.52
	DB	42.35T	;    699    42.35
	DB	42.18T	;    700    42.18
	DB	42.01T	;    701    42.01
	DB	41.84T	;    702    41.84
	DB	41.66T	;    703    41.66
	DB	41.49T	;    704    41.49
	DB	41.32T	;    705    41.32
	DB	41.14T	;    706    41.14
	DB	40.97T	;    707    40.97
	DB	40.8T	;    708    40.8
	DB	40.62T	;    709    40.62
	DB	40.45T	;    710    40.45
	DB	40.27T	;    711    40.27
	DB	40.1T	;    712    40.1
	DB	39.93T	;    713    39.93
	DB	39.75T	;    714    39.75
	DB	39.58T	;    715    39.58
	DB	39.4T	;    716    39.4
	DB	39.22T	;    717    39.22
	DB	39.05T	;    718    39.05
	DB	38.87T	;    719    38.87
	DB	38.7T	;    720    38.7
	DB	38.52T	;    721    38.52
	DB	38.34T	;    722    38.34
	DB	38.17T	;    723    38.17
	DB	37.99T	;    724    37.99
	DB	37.81T	;    725    37.81
	DB	37.63T	;    726    37.63
	DB	37.45T	;    727    37.45
	DB	37.28T	;    728    37.28
	DB	37.1T	;    729    37.1
	DB	36.92T	;    730    36.92
	DB	36.74T	;    731    36.74
	DB	36.56T	;    732    36.56
	DB	36.38T	;    733    36.38
	DB	36.2T	;    734    36.2
	DB	36.02T	;    735    36.02
	DB	35.84T	;    736    35.84
	DB	35.66T	;    737    35.66
	DB	35.48T	;    738    35.48
	DB	35.3T	;    739    35.3
	DB	35.11T	;    740    35.11
	DB	34.93T	;    741    34.93
	DB	34.75T	;    742    34.75
	DB	34.57T	;    743    34.57
	DB	34.38T	;    744    34.38
	DB	34.2T	;    745    34.2
	DB	34.02T	;    746    34.02
	DB	33.83T	;    747    33.83
	DB	33.65T	;    748    33.65
	DB	33.46T	;    749    33.46
	DB	33.28T	;    750    33.28
	DB	33.09T	;    751    33.09
	DB	32.91T	;    752    32.91
	DB	32.72T	;    753    32.72
	DB	32.54T	;    754    32.54
	DB	32.35T	;    755    32.35
	DB	32.16T	;    756    32.16
	DB	31.98T	;    757    31.98
	DB	31.79T	;    758    31.79
	DB	31.6T	;    759    31.6
	DB	31.41T	;    760    31.41
	DB	31.22T	;    761    31.22
	DB	31.03T	;    762    31.03
	DB	30.84T	;    763    30.84
	DB	30.65T	;    764    30.65
	DB	30.46T	;    765    30.46
	DB	30.27T	;    766    30.27
	DB	30.08T	;    767    30.08
	DB	29.89T	;    768    29.89
	DB	29.7T	;    769    29.7
	DB	29.51T	;    770    29.51
	DB	29.31T	;    771    29.31
	DB	29.12T	;    772    29.12
	DB	28.93T	;    773    28.93
	DB	28.73T	;    774    28.73
	DB	28.54T	;    775    28.54
	DB	28.35T	;    776    28.35
	DB	28.15T	;    777    28.15
	DB	27.96T	;    778    27.96
	DB	27.76T	;    779    27.76
	DB	27.56T	;    780    27.56
	DB	27.37T	;    781    27.37
	DB	27.17T	;    782    27.17
	DB	26.97T	;    783    26.97
	DB	26.77T	;    784    26.77
	DB	26.57T	;    785    26.57
	DB	26.37T	;    786    26.37
	DB	26.18T	;    787    26.18
	DB	25.98T	;    788    25.98
	DB	25.77T	;    789    25.77
	DB	25.57T	;    790    25.57
	DB	25.37T	;    791    25.37
	DB	25.17T	;    792    25.17
	DB	24.97T	;    793    24.97
	DB	24.76T	;    794    24.76
	DB	24.56T	;    795    24.56
	DB	24.36T	;    796    24.36
	DB	24.15T	;    797    24.15
	DB	23.95T	;    798    23.95
	DB	23.74T	;    799    23.74
	DB	23.54T	;    800    23.54
	DB	23.33T	;    801    23.33
	DB	23.12T	;    802    23.12
	DB	22.91T	;    803    22.91
	DB	22.71T	;    804    22.71
	DB	22.5T	;    805    22.5
	DB	22.29T	;    806    22.29
	DB	22.08T	;    807    22.08
	DB	21.87T	;    808    21.87
	DB	21.66T	;    809    21.66
	DB	21.44T	;    810    21.44
	DB	21.23T	;    811    21.23
	DB	21.02T	;    812    21.02
	DB	20.8T	;    813    20.8
	DB	20.59T	;    814    20.59
	DB	20.37T	;    815    20.37
	DB	20.16T	;    816    20.16
	DB	19.94T	;    817    19.94
	DB	19.73T	;    818    19.73
	DB	19.51T	;    819    19.51
	DB	19.29T	;    820    19.29
	DB	19.07T	;    821    19.07
	DB	18.85T	;    822    18.85
	DB	18.63T	;    823    18.63
	DB	18.41T	;    824    18.41
	DB	18.19T	;    825    18.19
	DB	17.97T	;    826    17.97
	DB	17.74T	;    827    17.74
	DB	17.52T	;    828    17.52
	DB	17.3T	;    829    17.3
	DB	17.07T	;    830    17.07
	DB	16.85T	;    831    16.85
	DB	16.62T	;    832    16.62
	DB	16.39T	;    833    16.39
	DB	16.16T	;    834    16.16
	DB	15.93T	;    835    15.93
	DB	15.7T	;    836    15.7
	DB	15.47T	;    837    15.47
	DB	15.24T	;    838    15.24
	DB	15.01T	;    839    15.01
	DB	14.78T	;    840    14.78
	DB	14.54T	;    841    14.54
	DB	14.31T	;    842    14.31
	DB	14.07T	;    843    14.07
	DB	13.84T	;    844    13.84
	DB	13.6T	;    845    13.6
	DB	13.36T	;    846    13.36
	DB	13.12T	;    847    13.12
	DB	12.88T	;    848    12.88
	DB	12.64T	;    849    12.64
	DB	12.4T	;    850    12.4
	DB	12.16T	;    851    12.16
	DB	11.91T	;    852    11.91
	DB	11.67T	;    853    11.67
	DB	11.42T	;    854    11.42
	DB	11.18T	;    855    11.18
	DB	10.93T	;    856    10.93
	DB	10.68T	;    857    10.68
	DB	10.43T	;    858    10.43
	DB	10.18T	;    859    10.18
	DB	9.93T	;    860    9.93
	DB	9.67T	;    861    9.67
	DB	9.42T	;    862    9.42
	DB	9.17T	;    863    9.17
	DB	8.91T	;    864    8.91
	DB	8.65T	;    865    8.65
	DB	8.39T	;    866    8.39
	DB	8.13T	;    867    8.13
	DB	7.87T	;    868    7.87
	DB	7.61T	;    869    7.61
	DB	7.35T	;    870    7.35
	DB	7.08T	;    871    7.08
	DB	6.82T	;    872    6.82
	DB	6.55T	;    873    6.55
	DB	6.28T	;    874    6.28
	DB	6.01T	;    875    6.01
	DB	5.74T	;    876    5.74
	DB	5.47T	;    877    5.47
	DB	5.2T	;    878    5.2
	DB	4.92T	;    879    4.92
	DB	4.65T	;    880    4.65
	DB	4.37T	;    881    4.37
	DB	4.09T	;    882    4.09
	DB	3.81T	;    883    3.81
	DB	3.53T	;    884    3.53
	DB	3.25T	;    885    3.25
	DB	2.96T	;    886    2.96
	DB	2.68T	;    887    2.68
	DB	2.39T	;    888    2.39
	DB	2.1T	;    889    2.1
	DB	1.81T	;    890    1.81
	DB	1.52T	;    891    1.52
	DB	1.22T	;    892    1.22
	DB	0.93T	;    893    0.93
	DB	0.63T	;    894    0.63
	DB	0.33T	;    895    0.33
	DB	0.03T	;    896    0.03
	DB	-0.27T	;    897    -0.27
	DB	-0.58T	;    898    -0.58
	DB	-0.88T	;    899    -0.88
	DB	-1.19T	;    900    -1.19
	DB	-1.5T	;    901    -1.5
	DB	-1.81T	;    902    -1.81
	DB	-2.13T	;    903    -2.13
	DB	-2.44T	;    904    -2.44
	DB	-2.76T	;    905    -2.76
	DB	-3.08T	;    906    -3.08
	DB	-3.4T	;    907    -3.4
	DB	-3.73T	;    908    -3.73
	DB	-4.05T	;    909    -4.05
	DB	-4.38T	;    910    -4.38
	DB	-4.71T	;    911    -4.71
	DB	-5.05T	;    912    -5.05
	DB	-5.38T	;    913    -5.38
	DB	-5.72T	;    914    -5.72
	DB	-6.06T	;    915    -6.06
	DB	-6.4T	;    916    -6.4
	DB	-6.75T	;    917    -6.75
	DB	-7.09T	;    918    -7.09
	DB	-7.44T	;    919    -7.44
	DB	-7.8T	;    920    -7.8
	DB	-8.15T	;    921    -8.15
	DB	-8.51T	;    922    -8.51
	DB	-8.87T	;    923    -8.87
	DB	-9.23T	;    924    -9.23
	DB	-9.6T	;    925    -9.6
	DB	-9.97T	;    926    -9.97
	DB	-10.34T	;    927    -10.34
	DB	-10.72T	;    928    -10.72
	DB	-11.09T	;    929    -11.09
	DB	-11.48T	;    930    -11.48
	DB	-11.86T	;    931    -11.86
	DB	-12.25T	;    932    -12.25
	DB	-12.64T	;    933    -12.64
	DB	-13.04T	;    934    -13.04
	DB	-13.44T	;    935    -13.44
	DB	-13.84T	;    936    -13.84
	DB	-14.24T	;    937    -14.24
	DB	-14.65T	;    938    -14.65
	DB	-15.07T	;    939    -15.07
	DB	-15.49T	;    940    -15.49
	DB	-15.91T	;    941    -15.91
	DB	-16.33T	;    942    -16.33
	DB	-16.76T	;    943    -16.76
	DB	-17.2T	;    944    -17.2
	DB	-17.64T	;    945    -17.64
	DB	-18.08T	;    946    -18.08
	DB	-18.53T	;    947    -18.53
	DB	-18.98T	;    948    -18.98
	DB	-19.44T	;    949    -19.44
	DB	-19.9T	;    950    -19.9
	DB	-20.37T	;    951    -20.37
	DB	-20.85T	;    952    -20.85
	DB	-21.33T	;    953    -21.33
	DB	-21.81T	;    954    -21.81
	DB	-22.3T	;    955    -22.3
	DB	-22.8T	;    956    -22.8
	DB	-23.3T	;    957    -23.3
	DB	-23.81T	;    958    -23.81
	DB	-24.33T	;    959    -24.33
	DB	-24.85T	;    960    -24.85
	DB	-25.38T	;    961    -25.38
	DB	-25.92T	;    962    -25.92
	DB	-26.46T	;    963    -26.46
	DB	-27.01T	;    964    -27.01
	DB	-27.57T	;    965    -27.57
	DB	-28.14T	;    966    -28.14
	DB	-28.72T	;    967    -28.72
	DB	-29.3T	;    968    -29.3
	DB	-29.9T	;    969    -29.9
	DB	-30.5T	;    970    -30.5
	DB	-31.11T	;    971    -31.11
	DB	-31.73T	;    972    -31.73
	DB	-32.37T	;    973    -32.37
	DB	-33.01T	;    974    -33.01
	DB	-33.67T	;    975    -33.67
	DB	-34.34T	;    976    -34.34
	DB	-35.02T	;    977    -35.02
	DB	-35.71T	;    978    -35.71
	DB	-36.41T	;    979    -36.41
	DB	-37.13T	;    980    -37.13
	DB	-37.87T	;    981    -37.87
	DB	-38.62T	;    982    -38.62
	DB	-39.38T	;    983    -39.38
	DB	180T	;    984    180
	DB	180T	;    985    180
	DB	180T	;    986    180
	DB	180T	;    987    180
	DB	180T	;    988    180
	DB	180T	;    989    180
	DB	180T	;    990    180
	DB	180T	;    991    180
	DB	180T	;    992    180
	DB	180T	;    993    180
	DB	180T	;    994    180
	DB	180T	;    995    180
	DB	180T	;    996    180
	DB	180T	;    997    180
	DB	180T	;    998    180
	DB	180T	;    999    180
	DB	180T	;    1000    180
	DB	180T	;    1001    180
	DB	180T	;    1002    180
	DB	180T	;    1003    180
	DB	180T	;    1004    180
	DB	180T	;    1005    180
	DB	180T	;    1006    180
	DB	180T	;    1007    180
	DB	180T	;    1008    180
	DB	180T	;    1009    180
	DB	180T	;    1010    180
	DB	180T	;    1011    180
	DB	180T	;    1012    180
	DB	180T	;    1013    180
	DB	180T	;    1014    180
	DB	180T	;    1015    180
	DB	180T	;    1016    180
	DB	180T	;    1017    180
	DB	180T	;    1018    180
	DB	180T	;    1019    180
	DB	180T	;    1020    180
	DB	180T	;    1021    180
	DB	180T	;    1022    180
	DB	180T	;    1023    Sensor Failure - use 180 degF as default

